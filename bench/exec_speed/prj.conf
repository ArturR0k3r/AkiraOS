## CMakeLists.txt
```
cmake_minimum_required(VERSION 3.20.0)
find_package(Zephyr REQUIRED HINTS $ENV{ZEPHYR_BASE})
project(exec_speed)

target_sources(app PRIVATE src/main.c)
target_include_directories(app PRIVATE
    ${CMAKE_CURRENT_LIST_DIR}/src
    ${ZEPHYR_WASM_MICRO_RUNTIME_MODULE_DIR}/core/iwasm/include
)

# ── WAMR (classic interpreter; AOT toggled by -DEXEC_SPEED_AOT=y) ─────────────
set(WAMR_ROOT_DIR ${ZEPHYR_WASM_MICRO_RUNTIME_MODULE_DIR})
set(WAMR_BUILD_PLATFORM "zephyr")
string(TOLOWER "${CMAKE_C_COMPILER}" _cc)
if(_cc MATCHES "xtensa")
    set(WAMR_BUILD_TARGET "XTENSA_32")
elseif(_cc MATCHES "riscv")
    set(WAMR_BUILD_TARGET "RISCV32")
elseif(CMAKE_SIZEOF_VOID_P EQUAL 8)
    set(WAMR_BUILD_TARGET "X86_64")
else()
    set(WAMR_BUILD_TARGET "X86_32")
endif()
set(WAMR_BUILD_INTERP        1)
set(WAMR_BUILD_MINI_LOADER   0)   # full loader so it can also load .aot
# AOT: run the embedded ESP32-S3 .aot (exec_aot.h) alongside interp+native.
# Auto-enabled on ESP32-S3 + PSRAM (the board conf that makes AOT exec memory
# available); can also be forced with -DEXEC_SPEED_AOT=y. Never on native_sim
# (exec_aot.h is Xtensa machine code).
if(NOT DEFINED EXEC_SPEED_AOT AND CONFIG_SOC_SERIES_ESP32S3 AND CONFIG_ESP_SPIRAM)
    set(EXEC_SPEED_AOT y)
endif()
if(EXEC_SPEED_AOT)
    set(WAMR_BUILD_AOT 1)
    target_compile_definitions(app PRIVATE EXEC_SPEED_AOT=1)
    message(STATUS "exec_speed: AOT path ENABLED")
    # ESP32-S3: .aot native code lives in PSRAM and executes through the
    # instruction-bus alias; the loader must write/relocate via the data-bus
    # mirror (see zephyr_platform.c aot_exec_alloc + os_get_dbus_mirror).
    # Mirror the production zephyr/CMakeLists.txt AOT block exactly.
    if(CONFIG_SOC_SERIES_ESP32S3 AND CONFIG_ESP_SPIRAM)
        add_definitions(-DWASM_MEM_DUAL_BUS_MIRROR=1)
        message(STATUS "exec_speed: WAMR dual-bus mirror ENABLED (PSRAM instruction cache)")
    endif()
else()
    set(WAMR_BUILD_AOT 0)
endif()
set(WAMR_BUILD_LIBC_BUILTIN  1)
set(WAMR_BUILD_LIBC_WASI     0)
set(WAMR_BUILD_GLOBAL_HEAP_POOL 0)
set(WAMR_BUILD_REF_TYPES     1)
include(${WAMR_ROOT_DIR}/build-scripts/runtime_lib.cmake)
# ESP32-S3 on-device AOT needs the WAMR dual-bus cache-coherency fix in
# os_dcache_flush() (ESP ROM Cache_WriteBack_All + Cache_Invalidate_ICache_All).
# That fix now lives upstream in the WAMR module (AkiraOS_Patch), so the bench
# uses the module's zephyr_platform.c directly — no local patch needed.
target_sources(app PRIVATE ${WAMR_RUNTIME_LIB_SOURCE})
foreach(_wamr_src ${WAMR_RUNTIME_LIB_SOURCE})
    if(_wamr_src MATCHES "\\.(c|cc|cpp|cxx)$")
        set_source_files_properties(${_wamr_src} PROPERTIES COMPILE_OPTIONS "-include;zephyr/fs/fs.h")
    endif()
endforeach()
target_include_directories(app PRIVATE
    ${WAMR_ROOT_DIR}/core/iwasm/include
    ${WAMR_ROOT_DIR}/core/shared
    ${WAMR_ROOT_DIR}/core/deps
)
```

## prj.conf
```kconfig
# exec_speed — interpreter vs AOT vs native. WAMR added by CMakeLists.
CONFIG_LOG=y
CONFIG_LOG_MODE_DEFERRED=y
CONFIG_LOG_BUFFER_SIZE=8192
CONFIG_MP_MAX_NUM_CPUS=2
CONFIG_SCHED_CPU_MASK=y
CONFIG_FILE_SYSTEM=y
CONFIG_HEAP_MEM_POOL_SIZE=131072
CONFIG_MAIN_STACK_SIZE=16384
```

## boards/akiraconsole_prod_esp32s3_procpu.conf
```kconfig
# exec_speed — ESP32-S3 board config for the AOT variant (auto-merged by Zephyr
# for board akiraconsole_prod/esp32s3/procpu). Active only when built with
# -Dexec_speed_EXEC_SPEED_AOT=y; harmless (PSRAM just unused) otherwise.
#
# AOT native code must live in executable memory. On ESP32-S3 the WAMR Zephyr
# platform (zephyr_platform.c os_mmap -> aot_exec_alloc) allocates it from the
# shared-multi-heap EXTERNAL region (PSRAM), writes/relocates it through the
# data-bus mirror, and executes it via the instruction-bus alias. That requires
# PSRAM + the shared multi heap + PSRAM instruction fetch — the same options the
# production board uses (snippets/akira-reference/.../akiraconsole_prod*.conf).

# ── PSRAM (ESP32-S3-WROOM-1-N16R8: 8 MB OPI PSRAM) ──────────────────────────
CONFIG_ESP_SPIRAM=y
CONFIG_ESP_SPIRAM_SIZE=8388608
CONFIG_ESP_SPIRAM_HEAP_SIZE=4194304
CONFIG_SPIRAM_MODE_OCT=y
CONFIG_SPIRAM_TYPE_ESPPSRAM64=y
CONFIG_SPIRAM_SPEED_80M=y
CONFIG_MEMC=y
# Map PSRAM into the instruction bus so AOT code can be fetched/executed from it.
CONFIG_SPIRAM_RODATA=y
CONFIG_SPIRAM_FETCH_INSTRUCTIONS=y
CONFIG_ESP_SPIRAM_MEMTEST=n

# ── Shared multi heap: the SoC layer registers PSRAM as SMH_REG_ATTR_EXTERNAL
#    (zephyr/soc/espressif/common/esp_psram.c), which aot_exec_alloc() draws from.
CONFIG_SHARED_MULTI_HEAP=y
```

## src/main.c
```c
/*
 * exec_speed — WebAssembly execution speed: classic interpreter vs. (AOT vs.)
 * native C, for an identical compute kernel (src/kernel.h).
 *
 * Native: the kernel is compiled into the firmware and timed directly with
 * CCOUNT. WASM: the same kernel, compiled to wasm32, is run by WAMR and times
 * itself with the same CCOUNT host native (the few host calls are outside the
 * timed compute loop). Results from both paths must match bit-for-bit — a built
 * in correctness check that they really ran the same algorithm.
 *
 * Prints JSON between <<BENCH_JSON_START>>/<<BENCH_JSON_END>> (collect.py).
 */
#include <zephyr/kernel.h>
#include <zephyr/sys/printk.h>
#include <stdint.h>
#include <string.h>
#ifdef CONFIG_SHARED_MULTI_HEAP
#include <zephyr/multi_heap/shared_multi_heap.h>
#endif

#include <wasm_export.h>
#include "kernel.h"
#include "exec_wasm.h"   /* exec_wasm[], exec_wasm_len */
#ifdef EXEC_SPEED_AOT
#include "exec_aot.h"    /* exec_aot[], exec_aot_len (ESP32-S3 .aot) */
#endif

static inline uint32_t ccount_now(void)
{
#if defined(CONFIG_SOC_SERIES_ESP32S3) || defined(CONFIG_SOC_SERIES_ESP32)
    uint32_t c; __asm__ volatile("rsr %0, CCOUNT" : "=r"(c) : : "memory"); return c;
#else
    return k_cycle_get_32();
#endif
}
#if defined(CONFIG_SOC_SERIES_ESP32S3) || defined(CONFIG_SOC_SERIES_ESP32)
#define BENCH_CPU_MHZ 240U
#else
#define BENCH_CPU_MHZ (sys_clock_hw_cycles_per_sec() / 1000000U)
#endif

/* WASM run result, filled by bench_report_exec(). */
static volatile uint32_t g_wasm_cycles;
static volatile uint32_t g_wasm_result;
static volatile int      g_wasm_reported;

/* WAMR installs a console hook; provide a weak no-op for standalone builds
 * (e.g. native_sim) that do not supply one. We print via printk. */
__attribute__((weak)) void __stdout_hook_install(int (*hook)(int)) { (void)hook; }

static int32_t  native_printf(wasm_exec_env_t e, const char *s){ (void)e; if (s) printk("%s", s); return 0; }
static uint32_t native_ccount(wasm_exec_env_t e){ (void)e; return ccount_now(); }
static void     native_pin_core(wasm_exec_env_t e, int32_t c){ (void)e; (void)c; }
static void     native_report_exec(wasm_exec_env_t e, uint32_t cycles, uint32_t result)
{
    (void)e; g_wasm_cycles = cycles; g_wasm_result = result; g_wasm_reported = 1;
}

static NativeSymbol g_natives[] = {
    { "printf_native",    (void *)native_printf,      "($)i", NULL },
    { "bench_ccount_get", (void *)native_ccount,      "()i",  NULL },
    { "bench_pin_core",   (void *)native_pin_core,    "(i)",  NULL },
    { "bench_report_exec",(void *)native_report_exec, "(ii)", NULL },
};

#define WASM_STACK 8192
#define WASM_HEAP  16384

/* Run an embedded module (interp or AOT; WAMR detects from the magic) and return
 * the cycles it reported, or 0 on failure. */
static uint32_t run_module(const uint8_t *bytes, uint32_t len, uint32_t *result_out)
{
    /* The .aot must be staged exactly as production does: into a 16-byte-aligned
     * PSRAM (shared-multi-heap EXTERNAL) buffer. On ESP32-S3 the AOT loader's
     * Xtensa relocations are computed relative to this buffer, and the dual-bus
     * path only works when it lives in the PSRAM region (akira_malloc_buffer is
     * PSRAM-first for the same reason). A DRAM buffer makes l32r offsets/literal
     * slots land out of range / unaligned. Fall back to an aligned static buffer
     * on hosts without PSRAM (native_sim, interp .wasm). */
    uint8_t *buf = NULL;
    bool buf_is_psram = false;
#ifdef CONFIG_SHARED_MULTI_HEAP
    buf = shared_multi_heap_aligned_alloc(SMH_REG_ATTR_EXTERNAL, 16, len);
    if (buf) buf_is_psram = true;
#endif
    static uint8_t __aligned(16) fallback_buf[4096];
    if (!buf) {
        if (len > sizeof(fallback_buf)) { printk("module too big\n"); return 0; }
        buf = fallback_buf;
    }
    memcpy(buf, bytes, len);   /* loader rewrites in place; copy to staged RAM */

    char err[128] = {0};
    wasm_module_t mod = wasm_runtime_load(buf, len, err, sizeof(err));
    if (!mod) {
        printk("load failed: %s\n", err);
#ifdef CONFIG_SHARED_MULTI_HEAP
        if (buf_is_psram) shared_multi_heap_free(buf);
#endif
        return 0;
    }
    wasm_module_inst_t inst = wasm_runtime_instantiate(mod, WASM_STACK, WASM_HEAP, err, sizeof(err));
    if (!inst) { printk("instantiate failed: %s\n", err); wasm_runtime_unload(mod); return 0; }
    wasm_exec_env_t env = wasm_runtime_create_exec_env(inst, WASM_STACK);
    wasm_function_inst_t fn = wasm_runtime_lookup_function(inst, "main");
    if (!fn) fn = wasm_runtime_lookup_function(inst, "__main_argc_argv");
    g_wasm_reported = 0;
    uint32_t argv[1] = {0};
    if (fn) wasm_runtime_call_wasm(env, fn, 0, argv);
    if (!g_wasm_reported) printk("module did not report: %s\n", wasm_runtime_get_exception(inst));
    wasm_runtime_destroy_exec_env(env);
    wasm_runtime_deinstantiate(inst);
    wasm_runtime_unload(mod);   /* WAMR held pointers into buf until here */
#ifdef CONFIG_SHARED_MULTI_HEAP
    if (buf_is_psram) shared_multi_heap_free(buf);
#endif
    if (result_out) *result_out = g_wasm_result;
    return g_wasm_cycles;
}

int main(void)
{
    printk("\n==== exec_speed (interpreter vs native) ====\n");
#ifdef CONFIG_SCHED_CPU_MASK
    k_thread_cpu_mask_clear(k_current_get());
    k_thread_cpu_mask_enable(k_current_get(), 1);
#endif

    /* ── Native C ────────────────────────────────────────────────────────── */
    volatile uint32_t warm = compute_kernel(1u, 10000u); (void)warm;
    uint32_t n0 = ccount_now();
    uint32_t nat_res = compute_kernel(EXEC_KERNEL_SEED, EXEC_KERNEL_ITERS);
    uint32_t n1 = ccount_now();
    uint32_t nat_cycles = n1 - n0;

    RuntimeInitArgs init = {0};
    init.mem_alloc_type = Alloc_With_System_Allocator;
    if (!wasm_runtime_full_init(&init)) { printk("wamr init failed\n"); return -1; }
    wasm_runtime_register_natives("env", g_natives, ARRAY_SIZE(g_natives));

    /* ── WASM classic interpreter ────────────────────────────────────────── */
    uint32_t interp_res = 0;
    uint32_t interp_cycles = run_module(exec_wasm, exec_wasm_len, &interp_res);

    uint32_t mhz = BENCH_CPU_MHZ ? BENCH_CPU_MHZ : 1;
    uint64_t ratio_x1000 = nat_cycles ? ((uint64_t)interp_cycles * 1000ULL / nat_cycles) : 0;

#ifdef EXEC_SPEED_AOT
    /* ── WASM AOT (wamrc, native machine code) ───────────────────────────── */
    uint32_t aot_res = 0;
    uint32_t aot_cycles = run_module(exec_aot, exec_aot_len, &aot_res);
    uint64_t aot_vs_native_x1000 = nat_cycles ? ((uint64_t)aot_cycles * 1000ULL / nat_cycles) : 0;
    uint64_t interp_vs_aot_x1000 = aot_cycles ? ((uint64_t)interp_cycles * 1000ULL / aot_cycles) : 0;

    printk("<<BENCH_JSON_START>>\n");
    printk("{\"bench\":\"B7_exec_speed\",\"board\":\"%s\",\"cpu_mhz\":%u,\"iters\":%u,"
           "\"native_cycles\":%u,\"interp_cycles\":%u,\"aot_cycles\":%u,"
           "\"native_us\":%u,\"interp_us\":%u,\"aot_us\":%u,"
           "\"interp_vs_native_x1000\":%llu,\"aot_vs_native_x1000\":%llu,"
           "\"interp_vs_aot_x1000\":%llu,"
           "\"native_result\":%u,\"interp_result\":%u,\"aot_result\":%u,"
           "\"results_match\":%s,"
           "\"mock_mode\":false}\n",
           CONFIG_BOARD, (unsigned)mhz, EXEC_KERNEL_ITERS,
           nat_cycles, interp_cycles, aot_cycles,
           (unsigned)(nat_cycles / mhz), (unsigned)(interp_cycles / mhz),
           (unsigned)(aot_cycles / mhz),
           (unsigned long long)ratio_x1000, (unsigned long long)aot_vs_native_x1000,
           (unsigned long long)interp_vs_aot_x1000,
           nat_res, interp_res, aot_res,
           (nat_res == interp_res && nat_res == aot_res) ? "true" : "false");
    printk("<<BENCH_JSON_END>>\n");
#else
    printk("<<BENCH_JSON_START>>\n");
    printk("{\"bench\":\"B7_exec_speed\",\"board\":\"%s\",\"cpu_mhz\":%u,\"iters\":%u,"
           "\"native_cycles\":%u,\"interp_cycles\":%u,"
           "\"native_us\":%u,\"interp_us\":%u,"
           "\"interp_vs_native_x1000\":%llu,"
           "\"native_result\":%u,\"interp_result\":%u,\"results_match\":%s,"
           "\"mock_mode\":false}\n",
           CONFIG_BOARD, (unsigned)mhz, EXEC_KERNEL_ITERS,
           nat_cycles, interp_cycles,
           (unsigned)(nat_cycles / mhz), (unsigned)(interp_cycles / mhz),
           (unsigned long long)ratio_x1000,
           nat_res, interp_res, (nat_res == interp_res) ? "true" : "false");
    printk("<<BENCH_JSON_END>>\n");
#endif
    printk("==== exec_speed done ====\n");
    return 0;
}
```

## src/exec_aot.h
```c
/* Auto-generated: wamrc --target=xtensa --cpu=esp32s3 --opt-level=3 --size-level=3
   from exec_wasm.wasm (ESP32-S3 AOT, literal-island l32r layout). Do not edit. */
static const unsigned char exec_aot[] = {
      0x00, 0x61, 0x6f, 0x74, 0x05, 0x00, 0x00, 0x00, 0x00, 0x00, 0x00, 0x00,
      0x30, 0x00, 0x00, 0x00, 0x00, 0x00, 0x00, 0x00, 0x01, 0x00, 0x5e, 0x00,
      0x01, 0x00, 0x00, 0x00, 0x00, 0x00, 0x00, 0x00, 0x00, 0x00, 0x00, 0x00,
      0x00, 0x00, 0x00, 0x00, 0x00, 0x00, 0x00, 0x00, 0x00, 0x00, 0x00, 0x00,
      0x78, 0x74, 0x65, 0x6e, 0x73, 0x61, 0x00, 0x00, 0x00, 0x00, 0x00, 0x00,
      0x00, 0x00, 0x00, 0x00, 0x01, 0x00, 0x00, 0x00, 0x20, 0x01, 0x00, 0x00,
      0x00, 0x00, 0x00, 0x00, 0x01, 0x00, 0x00, 0x00, 0x01, 0x00, 0x00, 0x00,
      0x00, 0x00, 0x01, 0x00, 0x01, 0x00, 0x00, 0x00, 0x01, 0x00, 0x00, 0x00,
      0x00, 0x00, 0x00, 0x00, 0x00, 0x00, 0x00, 0x00, 0x01, 0x00, 0x00, 0x00,
      0x70, 0x01, 0x00, 0x00, 0x01, 0x00, 0x00, 0x00, 0x01, 0x00, 0x00, 0x00,
      0x00, 0x00, 0x00, 0x00, 0x04, 0x00, 0x00, 0x00, 0x00, 0x00, 0x01, 0x00,
      0x00, 0x00, 0x7f, 0x00, 0x00, 0x00, 0x00, 0x00, 0x01, 0x00, 0x7f, 0x00,
      0x00, 0x00, 0x02, 0x00, 0x00, 0x00, 0x7f, 0x7f, 0x00, 0x00, 0x02, 0x00,
      0x01, 0x00, 0x7f, 0x7f, 0x7f, 0x00, 0x00, 0x00, 0x00, 0x00, 0x00, 0x00,
      0x01, 0x00, 0x00, 0x00, 0x7f, 0x01, 0x00, 0x00, 0x41, 0x00, 0x00, 0x00,
      0x00, 0x18, 0x00, 0x00, 0x03, 0x00, 0x00, 0x00, 0x00, 0x00, 0x04, 0x00,
      0x65, 0x6e, 0x76, 0x00, 0x0f, 0x00, 0x62, 0x65, 0x6e, 0x63, 0x68, 0x5f,
      0x70, 0x69, 0x6e, 0x5f, 0x63, 0x6f, 0x72, 0x65, 0x00, 0x00, 0x01, 0x00,
      0x04, 0x00, 0x65, 0x6e, 0x76, 0x00, 0x11, 0x00, 0x62, 0x65, 0x6e, 0x63,
      0x68, 0x5f, 0x63, 0x63, 0x6f, 0x75, 0x6e, 0x74, 0x5f, 0x67, 0x65, 0x74,
      0x00, 0x00, 0x02, 0x00, 0x04, 0x00, 0x65, 0x6e, 0x76, 0x00, 0x12, 0x00,
      0x62, 0x65, 0x6e, 0x63, 0x68, 0x5f, 0x72, 0x65, 0x70, 0x6f, 0x72, 0x74,
      0x5f, 0x65, 0x78, 0x65, 0x63, 0x00, 0x00, 0x00, 0x03, 0x00, 0x00, 0x00,
      0xff, 0xff, 0xff, 0xff, 0xff, 0xff, 0xff, 0xff, 0x00, 0x00, 0x00, 0x00,
      0x00, 0x00, 0x00, 0x00, 0xff, 0xff, 0xff, 0xff, 0x00, 0x00, 0x00, 0x00,
      0x00, 0x00, 0x00, 0x00, 0xff, 0xff, 0xff, 0xff, 0x00, 0x00, 0x00, 0x00,
      0x00, 0x00, 0x00, 0x00, 0x00, 0x00, 0x00, 0x00, 0x01, 0x00, 0x00, 0x00,
      0x11, 0x00, 0x2e, 0x61, 0x6f, 0x74, 0x5f, 0x73, 0x74, 0x61, 0x63, 0x6b,
      0x5f, 0x73, 0x69, 0x7a, 0x65, 0x73, 0x00, 0x00, 0x0c, 0x00, 0x00, 0x00,
      0x40, 0x00, 0x00, 0x00, 0x20, 0x00, 0x00, 0x00, 0x20, 0x00, 0x00, 0x00,
      0x02, 0x00, 0x00, 0x00, 0x80, 0x04, 0x00, 0x00, 0x64, 0x00, 0x00, 0x00,
      0x00, 0x00, 0x00, 0x00, 0x00, 0x00, 0x00, 0x00, 0x00, 0x00, 0x00, 0x00,
      0x29, 0xd0, 0x6b, 0xb0, 0x62, 0xf3, 0x6e, 0x3c, 0xb1, 0x79, 0x37, 0x9e,
      0x4f, 0x86, 0xc8, 0x61, 0xc4, 0xe6, 0xdd, 0x78, 0x0c, 0x08, 0x00, 0x00,
      0x10, 0x27, 0x00, 0x00, 0x00, 0x00, 0x00, 0x00, 0x78, 0x56, 0x34, 0x12,
      0x80, 0x84, 0x1e, 0x00, 0x00, 0x00, 0x00, 0x00, 0x00, 0x00, 0x00, 0x00,
      0x00, 0x00, 0x00, 0x00, 0xfe, 0xff, 0x1f, 0x00, 0x62, 0xf3, 0x6e, 0x3c,
      0xb1, 0x79, 0x37, 0x9e, 0x0d, 0x66, 0x19, 0x00, 0x5f, 0xf3, 0x6e, 0x3c,
      0x4f, 0x86, 0xc8, 0x61, 0x00, 0x00, 0x00, 0x00, 0x00, 0x00, 0x00, 0x00,
      0x00, 0x00, 0x00, 0x00, 0x36, 0x61, 0x00, 0x81, 0xff, 0xff, 0x88, 0x08,
      0x92, 0xc1, 0x00, 0x87, 0x39, 0x10, 0x80, 0x89, 0xc0, 0x98, 0x42, 0x97,
      0x38, 0x08, 0xad, 0x02, 0x65, 0x01, 0x00, 0x0c, 0x02, 0x1d, 0xf0, 0xa8,
      0x22, 0x0c, 0xbb, 0x81, 0xff, 0xff, 0xe0, 0x08, 0x00, 0x0c, 0x02, 0x1d,
      0xf0, 0xf0, 0x20, 0x00, 0x36, 0x81, 0x00, 0xad, 0x02, 0xd8, 0x3a, 0x98,
      0x2a, 0x82, 0x29, 0x74, 0x89, 0x41, 0x82, 0xc8, 0xf0, 0x82, 0x69, 0x74,
      0x72, 0x29, 0x6e, 0x99, 0x51, 0x22, 0x29, 0x5e, 0x0c, 0x05, 0x52, 0x4d,
      0x03, 0x52, 0x4d, 0x02, 0x52, 0x4d, 0x01, 0x0c, 0x1c, 0xc2, 0x4d, 0x00,
      0x81, 0x00, 0x00, 0xa9, 0x31, 0xbd, 0x05, 0xd9, 0x21, 0x89, 0x11, 0xe0,
      0x08, 0x00, 0x92, 0xa0, 0xff, 0x90, 0x8a, 0x10, 0x16, 0xe8, 0x1e, 0x99,
      0x01, 0x81, 0xff, 0xff, 0x92, 0xa4, 0x0c, 0xa1, 0xff, 0xff, 0xb1, 0xff,
      0xff, 0x1c, 0x83, 0x97, 0xb7, 0x02, 0x86, 0x73, 0x00, 0x9a, 0xc2, 0xaa,
      0xd8, 0xd2, 0x4c, 0x00, 0xba, 0xe8, 0x00, 0x03, 0x40, 0xe0, 0xf0, 0x91,
      0x0b, 0x4c, 0xf2, 0x44, 0x00, 0x1c, 0x04, 0x00, 0x04, 0x40, 0xe0, 0xf0,
      0x91, 0x62, 0xcc, 0xfe, 0xf2, 0x46, 0x00, 0xf2, 0xcc, 0xfd, 0xe0, 0x68,
      0x41, 0x62, 0x4f, 0x00, 0xf2, 0xcc, 0xfc, 0xe2, 0x4f, 0x00, 0x00, 0x03,
      0x40, 0xd0, 0xe0, 0x91, 0xe2, 0x4c, 0x03, 0x00, 0x04, 0x40, 0xd0, 0xe0,
      0x91, 0xe2, 0x4c, 0x02, 0xd0, 0xd8, 0x41, 0xd2, 0x4c, 0x01, 0x00, 0x03,
      0x40, 0x80, 0xd0, 0x91, 0xe2, 0xcc, 0xfb, 0xd2, 0x4e, 0x00, 0x00, 0x04,
      0x40, 0x80, 0xd0, 0x91, 0xe2, 0xcc, 0xfa, 0xd2, 0x4e, 0x00, 0xd2, 0xcc,
      0xf9, 0x80, 0xe8, 0x41, 0xe2, 0x4d, 0x00, 0xd2, 0xcc, 0xf8, 0x82, 0x4d,
      0x00, 0xd1, 0xff, 0xff, 0xda, 0xd8, 0x00, 0x03, 0x40, 0xd0, 0xe0, 0x91,
      0xf2, 0xcc, 0xf7, 0xe2, 0x4f, 0x00, 0x00, 0x04, 0x40, 0xd0, 0xe0, 0x91,
      0xf2, 0xcc, 0xf6, 0xe2, 0x4f, 0x00, 0xe2, 0xcc, 0xf5, 0xd0, 0xf8, 0x41,
      0xf2, 0x4e, 0x00, 0xc2, 0xcc, 0xf4, 0xd2, 0x4c, 0x00, 0xc1, 0xff, 0xff,
      0xca, 0x88, 0x92, 0xc9, 0x10, 0xc1, 0xff, 0xff, 0xc7, 0x19, 0x02, 0x06,
      0xd3, 0xff, 0x92, 0xa3, 0xf8, 0xa2, 0xa4, 0x00, 0x8d, 0x05, 0x8b, 0xb5,
      0x90, 0xcb, 0x10, 0xa0, 0xcc, 0x20, 0xc7, 0xb7, 0x02, 0xc6, 0x42, 0x00,
      0xd2, 0xa4, 0x04, 0xda, 0xe5, 0xe7, 0xb7, 0x02, 0x06, 0x40, 0x00, 0xca,
      0xc2, 0xe2, 0x0c, 0x00, 0xf2, 0x0c, 0x01, 0x80, 0xff, 0x11, 0xe0, 0xef,
      0x20, 0xf2, 0x0c, 0x02, 0x00, 0xff, 0x11, 0xc2, 0x0c, 0x03, 0x80, 0xcc,
      0x01, 0xf0, 0xcc, 0x20, 0xe0, 0xec, 0x20, 0x5a, 0xc2, 0xda, 0xdc, 0xd2,
      0x0d, 0x00, 0xf2, 0xa4, 0x05, 0xfa, 0xfc, 0xf2, 0x0f, 0x00, 0x80, 0xff,
      0x11, 0xd0, 0xdf, 0x20, 0xf2, 0xa4, 0x06, 0xfa, 0xfc, 0xf2, 0x0f, 0x00,
      0x00, 0xff, 0x11, 0x62, 0xa4, 0x07, 0x6a, 0x6c, 0x62, 0x06, 0x00, 0x80,
      0x66, 0x01, 0xf0, 0xf6, 0x20, 0xd0, 0xdf, 0x20, 0xd0, 0xee, 0x90, 0xf2,
      0xdc, 0x04, 0xf2, 0x0f, 0x00, 0x62, 0xa4, 0x01, 0x6a, 0x6c, 0x62, 0x06,
      0x00, 0x80, 0x66, 0x11, 0xf0, 0xf6, 0x20, 0x62, 0xa4, 0x02, 0x6a, 0x6c,
      0x62, 0x06, 0x00, 0x00, 0x66, 0x11, 0x52, 0xa4, 0x03, 0x5a, 0xcc, 0xc2,
      0x0c, 0x00, 0x80, 0xcc, 0x01, 0x60, 0xcc, 0x20, 0xf0, 0xcc, 0x20, 0xc0,
      0xcd, 0x90, 0x80, 0x8c, 0x30, 0x80, 0x8e, 0x30, 0x5d, 0x0b, 0xa7, 0x1b,
      0x02, 0x46, 0xd4, 0xff, 0x98, 0x41, 0x92, 0xc9, 0xfc, 0xb6, 0xa9, 0x63,
      0x97, 0x37, 0x60, 0x9a, 0x92, 0x00, 0x03, 0x40, 0x80, 0xa0, 0x91, 0xa2,
      0x49, 0x03, 0x00, 0x04, 0x40, 0x80, 0xa0, 0x91, 0xa2, 0x49, 0x02, 0x80,
      0xa8, 0x41, 0xa2, 0x49, 0x01, 0x82, 0x49, 0x00, 0x0c, 0x1b, 0xc1, 0xff,
      0xff, 0x51, 0xff, 0xff, 0xa8, 0x31, 0xe0, 0x05, 0x00, 0x88, 0x51, 0x82,
      0x08, 0x68, 0x56, 0x88, 0x03, 0x88, 0x41, 0x82, 0xc8, 0xf8, 0x87, 0x37,
      0x26, 0x8a, 0x82, 0x00, 0x03, 0x40, 0xa0, 0x90, 0x91, 0x92, 0x48, 0x03,
      0x00, 0x04, 0x40, 0xa0, 0x90, 0x91, 0x92, 0x48, 0x02, 0xa0, 0x98, 0x41,
      0x92, 0x48, 0x01, 0xa2, 0x48, 0x00, 0x7c, 0x88, 0x98, 0x41, 0x80, 0x89,
      0x10, 0x66, 0x88, 0x0b, 0x0c, 0x2b, 0x81, 0xff, 0xff, 0xa8, 0x51, 0xe0,
      0x08, 0x00, 0x1d, 0xf0, 0x0c, 0x1b, 0x0c, 0x0c, 0xa8, 0x31, 0xd8, 0x21,
      0x88, 0x11, 0xe0, 0x08, 0x00, 0x88, 0x01, 0x80, 0x8a, 0x10, 0x16, 0x88,
      0xfe, 0x88, 0x21, 0x78, 0x08, 0xb1, 0xff, 0xff, 0xc1, 0x00, 0x00, 0xa8,
      0x31, 0xe0, 0x05, 0x00, 0x88, 0x51, 0x82, 0x08, 0x68, 0x56, 0x18, 0xfd,
      0x0c, 0x1b, 0x0c, 0x0c, 0x5d, 0x0a, 0xa8, 0x31, 0xd8, 0x21, 0x88, 0x11,
      0xe0, 0x08, 0x00, 0xb8, 0x01, 0x8d, 0x05, 0xb0, 0x9a, 0x10, 0x16, 0x89,
      0xfb, 0xd8, 0x21, 0x82, 0x4d, 0x04, 0x00, 0x03, 0x40, 0x80, 0x90, 0x91,
      0x92, 0x4d, 0x07, 0x00, 0x04, 0x40, 0x80, 0x90, 0x91, 0x92, 0x4d, 0x06,
      0x80, 0x88, 0x41, 0x82, 0x4d, 0x05, 0x88, 0x0d, 0x70, 0x88, 0xc0, 0x82,
      0x4d, 0x00, 0x00, 0x03, 0x40, 0x80, 0x90, 0x91, 0x92, 0x4d, 0x03, 0x00,
      0x04, 0x40, 0x80, 0x90, 0x91, 0x92, 0x4d, 0x02, 0x80, 0x88, 0x41, 0x82,
      0x4d, 0x01, 0x7d, 0x0b, 0x0c, 0x2b, 0xa8, 0x31, 0xcd, 0x0b, 0x88, 0x11,
      0xe0, 0x08, 0x00, 0x70, 0x8a, 0x10, 0x16, 0x88, 0xf6, 0x88, 0x51, 0x98,
      0x41, 0x92, 0x68, 0x74, 0x1d, 0xf0, 0x3d, 0xf0, 0x36, 0x61, 0x00, 0x81,
      0xff, 0xff, 0x88, 0x18, 0x92, 0xc1, 0x00, 0x87, 0x39, 0x12, 0x80, 0x89,
      0xc0, 0x98, 0x42, 0x97, 0x38, 0x0a, 0xad, 0x03, 0xbd, 0x04, 0x65, 0x01,
      0x00, 0x2d, 0x0a, 0x1d, 0xf0, 0xa8, 0x22, 0x0c, 0xbb, 0x81, 0xff, 0xff,
      0xe0, 0x08, 0x00, 0x0c, 0x02, 0x1d, 0xf0, 0x00, 0x36, 0x41, 0x00, 0x81,
      0xff, 0xff, 0x80, 0xa3, 0x10, 0x82, 0xca, 0xfe, 0x80, 0x91, 0x41, 0x81,
      0xff, 0xff, 0x80, 0x99, 0x82, 0xa0, 0xd0, 0x60, 0xe1, 0x00, 0x00, 0x1c,
      0x1c, 0xa1, 0xff, 0xff, 0xb1, 0x00, 0x00, 0xf1, 0xff, 0xff, 0x30, 0x72,
      0x11, 0x20, 0x77, 0x30, 0x00, 0x0c, 0x40, 0x70, 0x60, 0x91, 0x70, 0x76,
      0x30, 0xb0, 0x67, 0x11, 0x70, 0x76, 0x30, 0xa0, 0x77, 0x82, 0xba, 0x77,
      0x70, 0x67, 0x41, 0xfa, 0x5e, 0x50, 0x66, 0x30, 0x7a, 0x76, 0x30, 0x67,
      0x11, 0x70, 0x76, 0x30, 0x00, 0x0c, 0x40, 0x70, 0x60, 0x91, 0x70, 0x76,
      0x30, 0xb0, 0x67, 0x11, 0x70, 0x76, 0x30, 0xa0, 0x77, 0x82, 0xba, 0x77,
      0x70, 0x67, 0x41, 0xe0, 0x66, 0x30, 0x7a, 0x26, 0x8a, 0xee, 0x2b, 0xdd,
      0x56, 0x2d, 0xfb, 0x0c, 0x1d, 0xd0, 0xd3, 0x10, 0x16, 0x3d, 0x02, 0x30,
      0xd2, 0x11, 0x20, 0xdd, 0x30, 0x00, 0x0c, 0x40, 0xd0, 0xc0, 0x91, 0xd0,
      0xcc, 0x30, 0xb0, 0xdc, 0x11, 0xc0, 0xcd, 0x30, 0xa0, 0xac, 0x82, 0xba,
      0xaa, 0xa0, 0xb7, 0x41, 0x8a, 0x89, 0x80, 0x8b, 0x30, 0xaa, 0x28, 0x1d,
      0xf0, 0xf0, 0x20, 0x00, 0x36, 0x61, 0x00, 0x81, 0xff, 0xff, 0x88, 0x28,
      0x92, 0xc1, 0x00, 0x87, 0x39, 0x10, 0x80, 0x89, 0xc0, 0x98, 0x42, 0x97,
      0x38, 0x08, 0xad, 0x02, 0x65, 0x01, 0x00, 0x0c, 0x02, 0x1d, 0xf0, 0xa8,
      0x22, 0x0c, 0xbb, 0x81, 0xff, 0xff, 0xe0, 0x08, 0x00, 0x0c, 0x02, 0x1d,
      0xf0, 0xf0, 0x20, 0x00, 0x36, 0x41, 0x00, 0x81, 0xff, 0xff, 0xad, 0x02,
      0xe0, 0x08, 0x00, 0x1d, 0xf0, 0x00, 0x00, 0x00, 0x03, 0x00, 0x00, 0x00,
      0x30, 0x00, 0x00, 0x00, 0x00, 0x00, 0x00, 0x00, 0x04, 0x03, 0x00, 0x00,
      0xd8, 0x03, 0x00, 0x00, 0x01, 0x00, 0x00, 0x00, 0x03, 0x00, 0x00, 0x00,
      0x03, 0x00, 0x00, 0x00, 0x05, 0x00, 0x00, 0x00, 0x04, 0x00, 0x00, 0x00,
      0x02, 0x00, 0x00, 0x00, 0x03, 0x00, 0x00, 0x00, 0x03, 0x00, 0x00, 0x00,
      0x01, 0x00, 0x00, 0x00, 0x04, 0x00, 0x00, 0x00, 0x21, 0x00, 0x00, 0x00,
      0x02, 0x00, 0x00, 0x00, 0x00, 0x00, 0x00, 0x00, 0x02, 0x00, 0x07, 0x00,
      0x6d, 0x65, 0x6d, 0x6f, 0x72, 0x79, 0x00, 0x00, 0x05, 0x00, 0x00, 0x00,
      0x00, 0x00, 0x05, 0x00, 0x6d, 0x61, 0x69, 0x6e, 0x00, 0x00, 0x00, 0x00,
      0x05, 0x00, 0x00, 0x00, 0xf8, 0x02, 0x00, 0x00, 0x08, 0x00, 0x00, 0x00,
      0x00, 0x00, 0x00, 0x00, 0x0e, 0x00, 0x00, 0x00, 0x1a, 0x00, 0x00, 0x00,
      0x2a, 0x00, 0x00, 0x00, 0x3e, 0x00, 0x00, 0x00, 0x5a, 0x00, 0x00, 0x00,
      0x6e, 0x00, 0x00, 0x00, 0x7c, 0x00, 0x00, 0x00, 0x8a, 0x00, 0x00, 0x00,
      0x0b, 0x00, 0x2e, 0x72, 0x65, 0x6c, 0x61, 0x2e, 0x74, 0x65, 0x78, 0x74,
      0x00, 0x00, 0x09, 0x00, 0x2e, 0x6c, 0x69, 0x74, 0x65, 0x72, 0x61, 0x6c,
      0x00, 0x00, 0x0e, 0x00, 0x2e, 0x72, 0x65, 0x6c, 0x61, 0x2e, 0x6c, 0x69,
      0x74, 0x65, 0x72, 0x61, 0x6c, 0x00, 0x11, 0x00, 0x2e, 0x61, 0x6f, 0x74,
      0x5f, 0x73, 0x74, 0x61, 0x63, 0x6b, 0x5f, 0x73, 0x69, 0x7a, 0x65, 0x73,
      0x00, 0x00, 0x1a, 0x00, 0x61, 0x6f, 0x74, 0x5f, 0x73, 0x65, 0x74, 0x5f,
      0x65, 0x78, 0x63, 0x65, 0x70, 0x74, 0x69, 0x6f, 0x6e, 0x5f, 0x77, 0x69,
      0x74, 0x68, 0x5f, 0x69, 0x64, 0x00, 0x12, 0x00, 0x61, 0x6f, 0x74, 0x5f,
      0x69, 0x6e, 0x76, 0x6f, 0x6b, 0x65, 0x5f, 0x6e, 0x61, 0x74, 0x69, 0x76,
      0x65, 0x00, 0x0b, 0x00, 0x61, 0x6f, 0x74, 0x5f, 0x66, 0x75, 0x6e, 0x63,
      0x23, 0x31, 0x00, 0x00, 0x0b, 0x00, 0x61, 0x6f, 0x74, 0x5f, 0x66, 0x75,
      0x6e, 0x63, 0x23, 0x30, 0x00, 0x00, 0x00, 0x00, 0x02, 0x00, 0x00, 0x00,
      0x00, 0x00, 0x00, 0x00, 0x19, 0x00, 0x00, 0x00, 0x03, 0x00, 0x00, 0x00,
      0x00, 0x00, 0x00, 0x00, 0x14, 0x00, 0x00, 0x00, 0x01, 0x00, 0x00, 0x00,
      0x23, 0x00, 0x00, 0x00, 0x04, 0x00, 0x00, 0x00, 0x14, 0x00, 0x00, 0x00,
      0x01, 0x00, 0x00, 0x00, 0x5c, 0x00, 0x00, 0x00, 0x08, 0x00, 0x00, 0x00,
      0x14, 0x00, 0x00, 0x00, 0x01, 0x00, 0x00, 0x00, 0x75, 0x00, 0x00, 0x00,
      0x0c, 0x00, 0x00, 0x00, 0x14, 0x00, 0x00, 0x00, 0x01, 0x00, 0x00, 0x00,
      0x7b, 0x00, 0x00, 0x00, 0x10, 0x00, 0x00, 0x00, 0x14, 0x00, 0x00, 0x00,
      0x01, 0x00, 0x00, 0x00, 0x7e, 0x00, 0x00, 0x00, 0x14, 0x00, 0x00, 0x00,
      0x14, 0x00, 0x00, 0x00, 0x01, 0x00, 0x00, 0x00, 0xf9, 0x00, 0x00, 0x00,
      0x18, 0x00, 0x00, 0x00, 0x14, 0x00, 0x00, 0x00, 0x01, 0x00, 0x00, 0x00,
      0x25, 0x01, 0x00, 0x00, 0x1c, 0x00, 0x00, 0x00, 0x14, 0x00, 0x00, 0x00,
      0x01, 0x00, 0x00, 0x00, 0x2d, 0x01, 0x00, 0x00, 0x20, 0x00, 0x00, 0x00,
      0x14, 0x00, 0x00, 0x00, 0x01, 0x00, 0x00, 0x00, 0x16, 0x02, 0x00, 0x00,
      0x24, 0x00, 0x00, 0x00, 0x14, 0x00, 0x00, 0x00, 0x01, 0x00, 0x00, 0x00,
      0x19, 0x02, 0x00, 0x00, 0x28, 0x00, 0x00, 0x00, 0x14, 0x00, 0x00, 0x00,
      0x01, 0x00, 0x00, 0x00, 0x5a, 0x02, 0x00, 0x00, 0x34, 0x00, 0x00, 0x00,
      0x14, 0x00, 0x00, 0x00, 0x01, 0x00, 0x00, 0x00, 0x7d, 0x02, 0x00, 0x00,
      0x2c, 0x00, 0x00, 0x00, 0x14, 0x00, 0x00, 0x00, 0x01, 0x00, 0x00, 0x00,
      0x80, 0x02, 0x00, 0x00, 0x30, 0x00, 0x00, 0x00, 0x14, 0x00, 0x00, 0x00,
      0x01, 0x00, 0x00, 0x00, 0x07, 0x03, 0x00, 0x00, 0x38, 0x00, 0x00, 0x00,
      0x14, 0x00, 0x00, 0x00, 0x01, 0x00, 0x00, 0x00, 0x29, 0x03, 0x00, 0x00,
      0x3c, 0x00, 0x00, 0x00, 0x14, 0x00, 0x00, 0x00, 0x01, 0x00, 0x00, 0x00,
      0x37, 0x03, 0x00, 0x00, 0x40, 0x00, 0x00, 0x00, 0x14, 0x00, 0x00, 0x00,
      0x01, 0x00, 0x00, 0x00, 0x43, 0x03, 0x00, 0x00, 0x44, 0x00, 0x00, 0x00,
      0x14, 0x00, 0x00, 0x00, 0x01, 0x00, 0x00, 0x00, 0x4c, 0x03, 0x00, 0x00,
      0x48, 0x00, 0x00, 0x00, 0x14, 0x00, 0x00, 0x00, 0x01, 0x00, 0x00, 0x00,
      0x51, 0x03, 0x00, 0x00, 0x4c, 0x00, 0x00, 0x00, 0x14, 0x00, 0x00, 0x00,
      0x01, 0x00, 0x00, 0x00, 0x54, 0x03, 0x00, 0x00, 0x50, 0x00, 0x00, 0x00,
      0x14, 0x00, 0x00, 0x00, 0x01, 0x00, 0x00, 0x00, 0x57, 0x03, 0x00, 0x00,
      0x54, 0x00, 0x00, 0x00, 0x14, 0x00, 0x00, 0x00, 0x01, 0x00, 0x00, 0x00,
      0xdb, 0x03, 0x00, 0x00, 0x58, 0x00, 0x00, 0x00, 0x14, 0x00, 0x00, 0x00,
      0x01, 0x00, 0x00, 0x00, 0xfb, 0x03, 0x00, 0x00, 0x5c, 0x00, 0x00, 0x00,
      0x14, 0x00, 0x00, 0x00, 0x01, 0x00, 0x00, 0x00, 0x0b, 0x04, 0x00, 0x00,
      0x60, 0x00, 0x00, 0x00, 0x14, 0x00, 0x00, 0x00, 0x01, 0x00, 0x00, 0x00,
      0x02, 0x00, 0x00, 0x00, 0x0a, 0x00, 0x00, 0x00, 0x00, 0x00, 0x00, 0x00,
      0x00, 0x00, 0x00, 0x00, 0x01, 0x00, 0x00, 0x00, 0x03, 0x00, 0x00, 0x00,
      0x04, 0x00, 0x00, 0x00, 0x00, 0x00, 0x00, 0x00, 0x01, 0x00, 0x00, 0x00,
      0x04, 0x00, 0x00, 0x00, 0x08, 0x00, 0x00, 0x00, 0x00, 0x00, 0x00, 0x00,
      0x01, 0x00, 0x00, 0x00, 0x05, 0x00, 0x00, 0x00, 0x28, 0x00, 0x00, 0x00,
      0x00, 0x00, 0x00, 0x00, 0x01, 0x00, 0x00, 0x00, 0x06, 0x00, 0x00, 0x00,
      0x34, 0x00, 0x00, 0x00, 0x00, 0x00, 0x00, 0x00, 0x01, 0x00, 0x00, 0x00,
      0x04, 0x00, 0x00, 0x00, 0x38, 0x00, 0x00, 0x00, 0x00, 0x00, 0x00, 0x00,
      0x01, 0x00, 0x00, 0x00, 0x03, 0x00, 0x00, 0x00, 0x3c, 0x00, 0x00, 0x00,
      0x00, 0x00, 0x00, 0x00, 0x01, 0x00, 0x00, 0x00, 0x04, 0x00, 0x00, 0x00,
      0x58, 0x00, 0x00, 0x00, 0x00, 0x00, 0x00, 0x00, 0x01, 0x00, 0x00, 0x00,
      0x03, 0x00, 0x00, 0x00, 0x5c, 0x00, 0x00, 0x00, 0x00, 0x00, 0x00, 0x00,
      0x01, 0x00, 0x00, 0x00, 0x04, 0x00, 0x00, 0x00, 0x60, 0x00, 0x00, 0x00,
      0x00, 0x00, 0x00, 0x00, 0x01, 0x00, 0x00, 0x00, 0x07, 0x00, 0x00, 0x00
};
static const unsigned int exec_aot_len = 2388;
```

## src/exec_wasm.h
```c
/* Auto-generated from wasm/exec_wasm.c — do not edit. */
static const unsigned char exec_wasm[] = {
      0x00, 0x61, 0x73, 0x6d, 0x01, 0x00, 0x00, 0x00, 0x01, 0x14, 0x04, 0x60,
      0x01, 0x7f, 0x00, 0x60, 0x00, 0x01, 0x7f, 0x60, 0x02, 0x7f, 0x7f, 0x00,
      0x60, 0x02, 0x7f, 0x7f, 0x01, 0x7f, 0x02, 0x45, 0x03, 0x03, 0x65, 0x6e,
      0x76, 0x0e, 0x62, 0x65, 0x6e, 0x63, 0x68, 0x5f, 0x70, 0x69, 0x6e, 0x5f,
      0x63, 0x6f, 0x72, 0x65, 0x00, 0x00, 0x03, 0x65, 0x6e, 0x76, 0x10, 0x62,
      0x65, 0x6e, 0x63, 0x68, 0x5f, 0x63, 0x63, 0x6f, 0x75, 0x6e, 0x74, 0x5f,
      0x67, 0x65, 0x74, 0x00, 0x01, 0x03, 0x65, 0x6e, 0x76, 0x11, 0x62, 0x65,
      0x6e, 0x63, 0x68, 0x5f, 0x72, 0x65, 0x70, 0x6f, 0x72, 0x74, 0x5f, 0x65,
      0x78, 0x65, 0x63, 0x00, 0x02, 0x03, 0x04, 0x03, 0x01, 0x03, 0x03, 0x04,
      0x05, 0x01, 0x70, 0x01, 0x01, 0x01, 0x05, 0x04, 0x01, 0x01, 0x01, 0x01,
      0x06, 0x07, 0x01, 0x7f, 0x01, 0x41, 0x80, 0x30, 0x0b, 0x07, 0x11, 0x02,
      0x06, 0x6d, 0x65, 0x6d, 0x6f, 0x72, 0x79, 0x02, 0x00, 0x04, 0x6d, 0x61,
      0x69, 0x6e, 0x00, 0x05, 0x0a, 0xaf, 0x04, 0x03, 0xc1, 0x02, 0x01, 0x05,
      0x7f, 0x23, 0x80, 0x80, 0x80, 0x80, 0x00, 0x41, 0x10, 0x6b, 0x22, 0x00,
      0x24, 0x80, 0x80, 0x80, 0x80, 0x00, 0x41, 0x01, 0x10, 0x80, 0x80, 0x80,
      0x80, 0x00, 0x41, 0xa9, 0xa0, 0xaf, 0x83, 0x7b, 0x21, 0x01, 0x41, 0x80,
      0x78, 0x21, 0x02, 0x03, 0x40, 0x20, 0x02, 0x41, 0x8c, 0x90, 0x80, 0x80,
      0x00, 0x6a, 0x20, 0x01, 0x41, 0xe2, 0xe6, 0xbb, 0xe3, 0x03, 0x6a, 0x36,
      0x02, 0x00, 0x20, 0x02, 0x41, 0x88, 0x90, 0x80, 0x80, 0x00, 0x6a, 0x20,
      0x01, 0x41, 0xb1, 0xf3, 0xdd, 0xf1, 0x79, 0x6a, 0x36, 0x02, 0x00, 0x20,
      0x02, 0x41, 0x84, 0x90, 0x80, 0x80, 0x00, 0x6a, 0x20, 0x01, 0x36, 0x02,
      0x00, 0x20, 0x02, 0x41, 0x80, 0x90, 0x80, 0x80, 0x00, 0x6a, 0x20, 0x01,
      0x41, 0xcf, 0x8c, 0xa2, 0x8e, 0x06, 0x6a, 0x36, 0x02, 0x00, 0x20, 0x01,
      0x41, 0xc4, 0xcd, 0xf7, 0xc6, 0x07, 0x6a, 0x21, 0x01, 0x20, 0x02, 0x41,
      0x10, 0x6a, 0x22, 0x02, 0x0d, 0x00, 0x0b, 0x41, 0x00, 0x21, 0x03, 0x41,
      0x80, 0x88, 0x80, 0x80, 0x00, 0x21, 0x01, 0x41, 0x02, 0x21, 0x02, 0x03,
      0x40, 0x20, 0x02, 0x41, 0xfe, 0x01, 0x71, 0x41, 0x02, 0x74, 0x28, 0x02,
      0x80, 0x88, 0x80, 0x80, 0x00, 0x41, 0x01, 0x74, 0x20, 0x01, 0x41, 0x04,
      0x6a, 0x28, 0x02, 0x00, 0x22, 0x04, 0x6a, 0x20, 0x04, 0x41, 0x01, 0x74,
      0x20, 0x01, 0x28, 0x02, 0x00, 0x6a, 0x20, 0x03, 0x73, 0x73, 0x21, 0x03,
      0x20, 0x01, 0x41, 0x08, 0x6a, 0x21, 0x01, 0x20, 0x02, 0x41, 0x02, 0x6a,
      0x22, 0x02, 0x41, 0x82, 0x02, 0x47, 0x0d, 0x00, 0x0b, 0x20, 0x00, 0x20,
      0x03, 0x36, 0x02, 0x0c, 0x20, 0x00, 0x41, 0x01, 0x41, 0x90, 0xce, 0x00,
      0x10, 0x84, 0x80, 0x80, 0x80, 0x00, 0x36, 0x02, 0x08, 0x20, 0x00, 0x28,
      0x02, 0x0c, 0x1a, 0x20, 0x00, 0x28, 0x02, 0x08, 0x1a, 0x10, 0x81, 0x80,
      0x80, 0x80, 0x00, 0x21, 0x01, 0x41, 0xf8, 0xac, 0xd1, 0x91, 0x01, 0x41,
      0x80, 0x89, 0xfa, 0x00, 0x10, 0x84, 0x80, 0x80, 0x80, 0x00, 0x21, 0x02,
      0x10, 0x81, 0x80, 0x80, 0x80, 0x00, 0x20, 0x01, 0x6b, 0x20, 0x02, 0x10,
      0x82, 0x80, 0x80, 0x80, 0x00, 0x20, 0x00, 0x41, 0x10, 0x6a, 0x24, 0x80,
      0x80, 0x80, 0x80, 0x00, 0x41, 0x00, 0x0b, 0xe0, 0x01, 0x01, 0x02, 0x7f,
      0x20, 0x01, 0x41, 0xfe, 0xff, 0xff, 0x00, 0x71, 0x21, 0x02, 0x20, 0x01,
      0x41, 0x01, 0x71, 0x21, 0x03, 0x41, 0xb1, 0xf3, 0xdd, 0xf1, 0x79, 0x21,
      0x01, 0x03, 0x40, 0x20, 0x00, 0x41, 0x0d, 0x74, 0x20, 0x00, 0x73, 0x22,
      0x00, 0x41, 0x11, 0x76, 0x20, 0x00, 0x73, 0x22, 0x00, 0x41, 0x05, 0x74,
      0x20, 0x00, 0x73, 0x41, 0x8d, 0xcc, 0xe5, 0x00, 0x6c, 0x41, 0xdf, 0xe6,
      0xbb, 0xe3, 0x03, 0x6a, 0x22, 0x00, 0x41, 0x07, 0x76, 0x20, 0x01, 0x41,
      0xcf, 0x8c, 0xa2, 0x8e, 0x06, 0x6a, 0x73, 0x20, 0x00, 0x6a, 0x22, 0x00,
      0x41, 0x0d, 0x74, 0x20, 0x00, 0x73, 0x22, 0x00, 0x41, 0x11, 0x76, 0x20,
      0x00, 0x73, 0x22, 0x00, 0x41, 0x05, 0x74, 0x20, 0x00, 0x73, 0x41, 0x8d,
      0xcc, 0xe5, 0x00, 0x6c, 0x41, 0xdf, 0xe6, 0xbb, 0xe3, 0x03, 0x6a, 0x22,
      0x00, 0x41, 0x07, 0x76, 0x20, 0x01, 0x73, 0x20, 0x00, 0x6a, 0x21, 0x00,
      0x20, 0x01, 0x41, 0xe2, 0xe6, 0xbb, 0xe3, 0x03, 0x6a, 0x21, 0x01, 0x20,
      0x02, 0x41, 0x7e, 0x6a, 0x22, 0x02, 0x0d, 0x00, 0x0b, 0x02, 0x40, 0x20,
      0x03, 0x45, 0x0d, 0x00, 0x20, 0x00, 0x41, 0x0d, 0x74, 0x20, 0x00, 0x73,
      0x22, 0x00, 0x41, 0x11, 0x76, 0x20, 0x00, 0x73, 0x22, 0x00, 0x41, 0x05,
      0x74, 0x20, 0x00, 0x73, 0x41, 0x8d, 0xcc, 0xe5, 0x00, 0x6c, 0x41, 0xdf,
      0xe6, 0xbb, 0xe3, 0x03, 0x6a, 0x22, 0x00, 0x41, 0x07, 0x76, 0x20, 0x01,
      0x41, 0xcf, 0x8c, 0xa2, 0x8e, 0x06, 0x6a, 0x73, 0x20, 0x00, 0x6a, 0x21,
      0x00, 0x0b, 0x20, 0x00, 0x0b, 0x08, 0x00, 0x10, 0x83, 0x80, 0x80, 0x80,
      0x00, 0x0b
};
static const unsigned int exec_wasm_len = 710;
```

## src/kernel.h
```c
/* Shared compute kernel — compiled natively (xtensa-gcc) AND to WASM (wasi-clang)
 * from the same source, so interpreter/AOT/native run byte-for-byte the same
 * algorithm. Pure 32-bit integer ALU work (xorshift + LCG), register-only, no
 * host calls in the loop: measures raw execution speed, not call dispatch. */
#pragma once
#include <stdint.h>

static inline uint32_t compute_kernel(uint32_t seed, uint32_t iters)
{
    uint32_t x = seed;
    for (uint32_t i = 0; i < iters; i++) {
        x ^= x << 13;
        x ^= x >> 17;
        x ^= x << 5;
        x = x * 1664525u + 1013904223u;
        x += (x >> 7) ^ (i * 2654435761u);
    }
    return x;
}

#define EXEC_KERNEL_SEED  0x12345678u
#define EXEC_KERNEL_ITERS 2000000u
```
