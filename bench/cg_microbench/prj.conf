## CMakeLists.txt
```
cmake_minimum_required(VERSION 3.20.0)
find_package(Zephyr REQUIRED HINTS $ENV{ZEPHYR_BASE})
project(cg_microbench)

# Capability registry iterable section (_akira_capability_list_start/end).
zephyr_linker_sources(SECTIONS ${CMAKE_CURRENT_LIST_DIR}/../../zephyr/linker/akira_sections.ld)

set(AKIRA_SRC ${CMAKE_CURRENT_LIST_DIR}/../../src)

target_sources(app PRIVATE
    src/main.c
    # The real Capability Guard under test.
    ${AKIRA_SRC}/runtime/security.c
)

target_include_directories(app PRIVATE
    ${CMAKE_CURRENT_LIST_DIR}/src
    ${AKIRA_SRC}
    ${AKIRA_SRC}/runtime
    ${AKIRA_SRC}/runtime/security
    ${AKIRA_SRC}/api
    ${CMAKE_CURRENT_LIST_DIR}/../../include
    ${ZEPHYR_WASM_MICRO_RUNTIME_MODULE_DIR}/core/iwasm/include
)

# security.c is part of the AkiraOS module normally; built standalone here, so
# turn on the switches its real (non-stub) code path needs.
target_compile_definitions(app PRIVATE
    CONFIG_AKIRA_WASM_RUNTIME=1
    CONFIG_AKIRA_CAPABILITY_SYSTEM=1
    CONFIG_AKIRA_LOG_LEVEL=3
    CONFIG_AKIRA_UNSIGNED_APP_CAP_MASK=0xFFFFFFFFFFFFFFFFULL
)

# ── WAMR (classic interpreter, mini-loader), mirroring akiraclaw_bench ───────
set(WAMR_ROOT_DIR ${ZEPHYR_WASM_MICRO_RUNTIME_MODULE_DIR})
set(WAMR_BUILD_PLATFORM "zephyr")
string(TOLOWER "${CMAKE_C_COMPILER}" _cc)
if(_cc MATCHES "xtensa")
    set(WAMR_BUILD_TARGET "XTENSA_32")
elseif(_cc MATCHES "riscv")
    set(WAMR_BUILD_TARGET "RISCV32")
elseif(CMAKE_SIZEOF_VOID_P EQUAL 8)
    set(WAMR_BUILD_TARGET "X86_64")   # native_sim on a 64-bit host
else()
    set(WAMR_BUILD_TARGET "X86_32")
endif()
set(WAMR_BUILD_INTERP        1)
set(WAMR_BUILD_MINI_LOADER   1)
set(WAMR_BUILD_AOT           0)
set(WAMR_BUILD_LIBC_BUILTIN  1)
set(WAMR_BUILD_LIBC_WASI     0)
set(WAMR_BUILD_GLOBAL_HEAP_POOL 0)
set(WAMR_BUILD_REF_TYPES     1)
include(${WAMR_ROOT_DIR}/build-scripts/runtime_lib.cmake)
target_sources(app PRIVATE ${WAMR_RUNTIME_LIB_SOURCE})

# WAMR's zephyr platform header uses struct fs_file_t/fs_dir_t without including
# <zephyr/fs/fs.h>; force-include it for the WAMR C/C++ sources (not the .S asm).
foreach(_wamr_src ${WAMR_RUNTIME_LIB_SOURCE})
    if(_wamr_src MATCHES "\\.(c|cc|cpp|cxx)$")
        set_source_files_properties(${_wamr_src} PROPERTIES
            COMPILE_OPTIONS "-include;zephyr/fs/fs.h")
    endif()
endforeach()

target_include_directories(app PRIVATE
    ${WAMR_ROOT_DIR}/core/iwasm/include
    ${WAMR_ROOT_DIR}/core/shared
    ${WAMR_ROOT_DIR}/core/deps
)
```

## prj.conf
```kconfig
# cg_microbench — Capability Guard per-call overhead.
# Standalone: WAMR + the real src/runtime/security.c are added by CMakeLists;
# the AKIRA_* switches that security.c needs are passed as -D there, so this
# file only carries standard Zephyr config and builds for native_sim and ESP32-S3.

CONFIG_LOG=y
CONFIG_LOG_MODE_DEFERRED=y
CONFIG_LOG_BUFFER_SIZE=8192

# CCOUNT is read on the benchmark thread; pin it to a core.
CONFIG_MP_MAX_NUM_CPUS=2
CONFIG_SCHED_CPU_MASK=y

# WAMR's zephyr platform references fs types.
CONFIG_FILE_SYSTEM=y

CONFIG_HEAP_MEM_POOL_SIZE=65536
CONFIG_MAIN_STACK_SIZE=16384
```

## src/main.c
```c
/*
 * cg_microbench — Capability Guard per-call overhead, measured with CCOUNT.
 *
 * Links the REAL guard (src/runtime/security.c: akira_security_check_exec) and
 * runs a tiny WASM module that calls a guarded native (capability GRANTED, so
 * the check takes its allow path) N times and an identical unguarded native N
 * times. The per-call delta is the Capability Guard overhead; the shared loop
 * and WAMR native-dispatch cost cancel. Result printed as one JSON object
 * between <<BENCH_JSON_START>>/<<BENCH_JSON_END>> (same convention as
 * bench/akiraclaw_bench), harvested by scripts/collect.py.
 *
 * No TFLite Micro / AIINFER — this builds anywhere WAMR builds.
 */
#include <zephyr/kernel.h>
#include <zephyr/sys/printk.h>
#include <stdint.h>
#include <string.h>

#include <wasm_export.h>
#include "security.h"              /* AKIRA_CHECK_CAP_OR_RETURN, AKIRA_CAP_GPIO_READ */

#include "cg_micro_wasm.h"         /* cg_micro_wasm[], cg_micro_wasm_len */

/* ── CCOUNT (cycle counter) ──────────────────────────────────────────────── */
static inline uint32_t ccount_now(void)
{
#if defined(CONFIG_SOC_SERIES_ESP32S3) || defined(CONFIG_SOC_SERIES_ESP32)
    uint32_t c;
    __asm__ volatile("rsr %0, CCOUNT" : "=r"(c) : : "memory");
    return c;
#else
    return k_cycle_get_32();  /* native_sim / non-Xtensa fallback */
#endif
}

#ifndef CONFIG_SOC_SERIES_ESP32S3
#define BENCH_CPU_MHZ (sys_clock_hw_cycles_per_sec() / 1000000U)
#else
#define BENCH_CPU_MHZ 240U
#endif

/* ── cap-mask source for the guard ───────────────────────────────────────────
 * The real runtime stores an akira_managed_app_t* in WAMR custom data and reads
 * its cap_mask. We mirror that access pattern exactly with a 1-field struct so
 * the measured path (get_module_inst -> get_custom_data -> field -> AND) matches
 * production. These two symbols are normally provided by akira_runtime.c, which
 * pulls the whole app manager; here the bench provides them. */
typedef struct { uint64_t cap_mask; } cg_app_t;
static cg_app_t g_app = { .cap_mask = AKIRA_CAP_GPIO_READ };  /* capability GRANTED */

uint64_t akira_runtime_get_cap_mask_for_module_inst(wasm_module_inst_t inst)
{
    if (!inst) return 0;
    cg_app_t *a = (cg_app_t *)wasm_runtime_get_custom_data(inst);
    return a ? a->cap_mask : 0;
}

int akira_runtime_get_name_for_module_inst(wasm_module_inst_t inst, char *buf, size_t buflen)
{
    (void)inst;
    if (buf && buflen) strncpy(buf, "cg_micro", buflen);
    return 0;
}

/* sandbox_audit_log is only reached on a DENY (never here); provide a stub so we
 * don't have to link sandbox.c. */
#include <runtime/security/sandbox.h>
void sandbox_audit_log(audit_event_type_t type, const char *app_name, uint32_t detail)
{
    (void)type; (void)app_name; (void)detail;
}

/* WAMR's zephyr platform installs a console hook; provide a weak no-op so the
 * standalone bench links where Zephyr does not supply one (e.g. native_sim).
 * We print via printk directly, so WAMR console routing is not needed. */
__attribute__((weak)) void __stdout_hook_install(int (*hook)(int)) { (void)hook; }

/* ── native functions exposed to the WASM module ─────────────────────────── */
static int32_t native_printf(wasm_exec_env_t env, const char *s)
{
    (void)env; if (s) printk("%s", s); return 0;
}
static uint32_t native_ccount(wasm_exec_env_t env) { (void)env; return ccount_now(); }

static void native_pin_core(wasm_exec_env_t env, int32_t core)
{
    (void)env; (void)core;  /* main thread is already pinned below */
}

/* The measured pair: identical bodies except for the capability check. */
static int32_t native_guarded_noop(wasm_exec_env_t env)
{
    AKIRA_CHECK_CAP_OR_RETURN(env, AKIRA_CAP_GPIO_READ, -1);
    return 0;
}
static int32_t native_unguarded_noop(wasm_exec_env_t env)
{
    (void)env;
    return 0;
}

static void native_report(wasm_exec_env_t env, uint32_t guarded, uint32_t unguarded, uint32_t iters)
{
    (void)env;
    if (iters == 0) iters = 1;
    uint64_t mhz = BENCH_CPU_MHZ ? BENCH_CPU_MHZ : 1;
    /* milli-cycles per call (x1000 for precision) */
    uint64_t g_mc = (uint64_t)guarded * 1000ULL / iters;
    uint64_t u_mc = (uint64_t)unguarded * 1000ULL / iters;
    uint64_t d_mc = (g_mc > u_mc) ? (g_mc - u_mc) : 0;
    /* guard overhead in picoseconds then ns: ns = cycles / MHz * 1000;
     * d_mc is milli-cycles, so ns = d_mc/1000 cycles -> d_mc/1000*1000/mhz = d_mc/mhz */
    uint64_t guard_ns = d_mc / mhz;                    /* ns per guarded call */
    uint64_t guard_ps = (d_mc * 1000ULL) / mhz;        /* ps, for sub-ns precision */

    printk("<<BENCH_JSON_START>>\n");
    printk("{\"bench\":\"B6_capability_guard\","
           "\"board\":\"%s\",\"cpu_mhz\":%u,\"iters\":%u,"
           "\"guarded_total_cycles\":%u,\"unguarded_total_cycles\":%u,"
           "\"guarded_cycles_per_call_x1000\":%llu,"
           "\"unguarded_cycles_per_call_x1000\":%llu,"
           "\"guard_overhead_cycles_x1000\":%llu,"
           "\"guard_overhead_ns\":%llu,\"guard_overhead_ps\":%llu,"
           "\"mock_mode\":false}\n",
           CONFIG_BOARD, (unsigned)mhz, iters,
           guarded, unguarded,
           (unsigned long long)g_mc, (unsigned long long)u_mc,
           (unsigned long long)d_mc,
           (unsigned long long)guard_ns, (unsigned long long)guard_ps);
    printk("<<BENCH_JSON_END>>\n");
}

static NativeSymbol g_natives[] = {
    { "printf_native",   (void *)native_printf,         "($)i", NULL },
    { "bench_ccount_get",(void *)native_ccount,         "()i",  NULL },
    { "bench_pin_core",  (void *)native_pin_core,       "(i)",  NULL },
    { "guarded_noop",    (void *)native_guarded_noop,   "()i",  NULL },
    { "unguarded_noop",  (void *)native_unguarded_noop, "()i",  NULL },
    { "bench_report",    (void *)native_report,         "(iii)",NULL },
};

#define WASM_STACK 8192
#define WASM_HEAP  16384

int main(void)
{
    printk("\n==== cg_microbench (Capability Guard overhead) ====\n");

#ifdef CONFIG_SCHED_CPU_MASK
    k_thread_cpu_mask_clear(k_current_get());
    k_thread_cpu_mask_enable(k_current_get(), 1);
#endif

    RuntimeInitArgs init = {0};
    init.mem_alloc_type = Alloc_With_System_Allocator;
    if (!wasm_runtime_full_init(&init)) { printk("wamr init failed\n"); return -1; }
    if (!wasm_runtime_register_natives("env", g_natives, ARRAY_SIZE(g_natives))) {
        printk("register natives failed\n"); return -1;
    }

    /* The WAMR mini-loader rewrites import strings in place, so the buffer must
     * be writable — the embedded array is const (flash/.rodata). Copy to RAM. */
    static uint8_t wasm_buf[sizeof(cg_micro_wasm)];
    memcpy(wasm_buf, cg_micro_wasm, cg_micro_wasm_len);

    char err[128] = {0};
    wasm_module_t mod = wasm_runtime_load(wasm_buf, cg_micro_wasm_len, err, sizeof(err));
    if (!mod) { printk("load failed: %s\n", err); return -1; }

    wasm_module_inst_t inst = wasm_runtime_instantiate(mod, WASM_STACK, WASM_HEAP, err, sizeof(err));
    if (!inst) { printk("instantiate failed: %s\n", err); return -1; }

    /* Grant the capability by attaching the cap-mask source the guard reads. */
    wasm_runtime_set_custom_data(inst, &g_app);

    wasm_exec_env_t exec_env = wasm_runtime_create_exec_env(inst, WASM_STACK);
    if (!exec_env) { printk("exec_env failed\n"); return -1; }

    wasm_function_inst_t fn = wasm_runtime_lookup_function(inst, "main");
    if (!fn) fn = wasm_runtime_lookup_function(inst, "__main_argc_argv");
    if (!fn) { printk("no main\n"); return -1; }

    uint32_t argv[1] = {0};
    if (!wasm_runtime_call_wasm(exec_env, fn, 0, argv)) {
        printk("call failed: %s\n", wasm_runtime_get_exception(inst));
    }

    printk("==== cg_microbench done ====\n");
    return 0;
}
```

## src/cg_micro_wasm.h
```c
/* Auto-generated from wasm/cg_micro.c — do not edit. */
#include <stddef.h>
static const unsigned char cg_micro_wasm[] = {
    0x00, 0x61, 0x73, 0x6d, 0x01, 0x00, 0x00, 0x00, 0x01, 0x15, 0x04, 0x60,
    0x01, 0x7f, 0x00, 0x60, 0x00, 0x01, 0x7f, 0x60, 0x03, 0x7f, 0x7f, 0x7f,
    0x00, 0x60, 0x02, 0x7f, 0x7f, 0x01, 0x7f, 0x02, 0x68, 0x05, 0x03, 0x65,
    0x6e, 0x76, 0x0e, 0x62, 0x65, 0x6e, 0x63, 0x68, 0x5f, 0x70, 0x69, 0x6e,
    0x5f, 0x63, 0x6f, 0x72, 0x65, 0x00, 0x00, 0x03, 0x65, 0x6e, 0x76, 0x0c,
    0x67, 0x75, 0x61, 0x72, 0x64, 0x65, 0x64, 0x5f, 0x6e, 0x6f, 0x6f, 0x70,
    0x00, 0x01, 0x03, 0x65, 0x6e, 0x76, 0x0e, 0x75, 0x6e, 0x67, 0x75, 0x61,
    0x72, 0x64, 0x65, 0x64, 0x5f, 0x6e, 0x6f, 0x6f, 0x70, 0x00, 0x01, 0x03,
    0x65, 0x6e, 0x76, 0x10, 0x62, 0x65, 0x6e, 0x63, 0x68, 0x5f, 0x63, 0x63,
    0x6f, 0x75, 0x6e, 0x74, 0x5f, 0x67, 0x65, 0x74, 0x00, 0x01, 0x03, 0x65,
    0x6e, 0x76, 0x0c, 0x62, 0x65, 0x6e, 0x63, 0x68, 0x5f, 0x72, 0x65, 0x70,
    0x6f, 0x72, 0x74, 0x00, 0x02, 0x03, 0x03, 0x02, 0x01, 0x03, 0x04, 0x05,
    0x01, 0x70, 0x01, 0x01, 0x01, 0x05, 0x04, 0x01, 0x01, 0x01, 0x01, 0x06,
    0x07, 0x01, 0x7f, 0x01, 0x41, 0x80, 0x28, 0x0b, 0x07, 0x11, 0x02, 0x06,
    0x6d, 0x65, 0x6d, 0x6f, 0x72, 0x79, 0x02, 0x00, 0x04, 0x6d, 0x61, 0x69,
    0x6e, 0x00, 0x06, 0x0a, 0xe4, 0x01, 0x02, 0xd8, 0x01, 0x01, 0x04, 0x7f,
    0x23, 0x80, 0x80, 0x80, 0x80, 0x00, 0x41, 0x10, 0x6b, 0x22, 0x00, 0x24,
    0x80, 0x80, 0x80, 0x80, 0x00, 0x41, 0x01, 0x10, 0x80, 0x80, 0x80, 0x80,
    0x00, 0x20, 0x00, 0x41, 0x00, 0x36, 0x02, 0x0c, 0x41, 0xd0, 0x0f, 0x21,
    0x01, 0x03, 0x40, 0x20, 0x00, 0x10, 0x81, 0x80, 0x80, 0x80, 0x00, 0x20,
    0x00, 0x28, 0x02, 0x0c, 0x6a, 0x36, 0x02, 0x0c, 0x20, 0x00, 0x10, 0x82,
    0x80, 0x80, 0x80, 0x00, 0x20, 0x00, 0x28, 0x02, 0x0c, 0x6a, 0x36, 0x02,
    0x0c, 0x20, 0x01, 0x41, 0x7f, 0x6a, 0x22, 0x01, 0x0d, 0x00, 0x0b, 0x41,
    0xc0, 0x9a, 0x0c, 0x21, 0x01, 0x10, 0x83, 0x80, 0x80, 0x80, 0x00, 0x21,
    0x02, 0x03, 0x40, 0x20, 0x00, 0x10, 0x81, 0x80, 0x80, 0x80, 0x00, 0x20,
    0x00, 0x28, 0x02, 0x0c, 0x6a, 0x36, 0x02, 0x0c, 0x20, 0x01, 0x41, 0x7f,
    0x6a, 0x22, 0x01, 0x0d, 0x00, 0x0b, 0x41, 0xc0, 0x9a, 0x0c, 0x21, 0x01,
    0x10, 0x83, 0x80, 0x80, 0x80, 0x00, 0x21, 0x03, 0x03, 0x40, 0x20, 0x00,
    0x10, 0x82, 0x80, 0x80, 0x80, 0x00, 0x20, 0x00, 0x28, 0x02, 0x0c, 0x6a,
    0x36, 0x02, 0x0c, 0x20, 0x01, 0x41, 0x7f, 0x6a, 0x22, 0x01, 0x0d, 0x00,
    0x0b, 0x20, 0x03, 0x20, 0x02, 0x6b, 0x10, 0x83, 0x80, 0x80, 0x80, 0x00,
    0x20, 0x03, 0x6b, 0x41, 0xc0, 0x9a, 0x0c, 0x10, 0x84, 0x80, 0x80, 0x80,
    0x00, 0x20, 0x00, 0x28, 0x02, 0x0c, 0x1a, 0x20, 0x00, 0x41, 0x10, 0x6a,
    0x24, 0x80, 0x80, 0x80, 0x80, 0x00, 0x41, 0x00, 0x0b, 0x08, 0x00, 0x10,
    0x85, 0x80, 0x80, 0x80, 0x00, 0x0b,
};
static const unsigned int cg_micro_wasm_len = 414;
```
