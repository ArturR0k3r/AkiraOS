/*
 * bench_b1_wasm.c — B1 WASM-path benchmarks (wasm_noguard / wasm_claw / wasm_claw_mpu)
 *
 * Loads the pre-compiled akiraclaw_bench WASM module embedded as a C header
 * (wasm_data_<variant>.h, generated by `make headers` in the WASM app dir).
 *
 * Before loading, registers two benchmark-only native symbols:
 *
 *   bench_ccount_get() → reads Xtensa CCOUNT; lets the WASM hot-loop time
 *                        individual iterations with µs precision.
 *   bench_pin_core(n)  → pins the WASM thread to CPU core n (Core 1).
 *
 * The WASM module's main() runs the benchmark loop and prints JSON to the
 * Zephyr console.  The native side waits for it to finish via an exit semaphore
 * then tidies up.
 *
 * wasm_claw_mpu: CONFIG_AKIRA_SANDBOX_MPU depends on ARM_MPU which is absent
 * on ESP32-S3 (Xtensa).  The WASM module detects BENCH_MPU at compile time
 * and emits mock_mode=true immediately.
 *
 * wasm_noguard: built with CONFIG_AKIRA_CAPABILITY_SYSTEM=n (prj_noguard.conf).
 * If that config is unavailable the CMakeLists falls back to reporting mock_mode.
 */

#include "bench_b1.h"
#include "timing.h"
#include "result.h"

#include <zephyr/kernel.h>
#include <zephyr/logging/log.h>
#include <string.h>

#ifdef CONFIG_AKIRA_WASM_RUNTIME
#include <wasm_export.h>
#include "runtime/akira_runtime.h"
#endif

LOG_MODULE_DECLARE(akiraclaw_bench, CONFIG_AKIRA_LOG_LEVEL);

/* ── WASM module byte-arrays (generated by `make headers`) ──────────────
 * If a header is missing the build fails with a clear message.
 * Generate with:
 *   cd AkiraSDK/wasm_apps/akiraclaw_bench && make all_variants
 */
#if defined(BENCH_WASM_VARIANT_NOGUARD)
#  include "wasm_data_noguard.h"
#  define WASM_BYTES     akiraclaw_bench_noguard_wasm
#  define WASM_LEN       akiraclaw_bench_noguard_wasm_len
#elif defined(BENCH_WASM_VARIANT_MPU)
#  include "wasm_data_mpu.h"
#  define WASM_BYTES     akiraclaw_bench_mpu_wasm
#  define WASM_LEN       akiraclaw_bench_mpu_wasm_len
#else
/* Default: wasm_claw */
#  include "wasm_data_claw.h"
#  define WASM_BYTES     akiraclaw_bench_claw_wasm
#  define WASM_LEN       akiraclaw_bench_claw_wasm_len
#endif

/* ── Exit semaphore ──────────────────────────────────────────────────── */
static K_SEM_DEFINE(g_wasm_done, 0, 1);

static void wasm_exit_cb(int slot, int exit_code)
{
    (void)slot;
    (void)exit_code;
    k_sem_give(&g_wasm_done);
}

/* ── bench_ccount_get native implementation ─────────────────────────── */
#ifdef CONFIG_SOC_SERIES_ESP32S3
static uint32_t native_bench_ccount_get(wasm_exec_env_t env)
{
    (void)env;
    uint32_t c;
    __asm__ volatile("rsr %0, CCOUNT" : "=r"(c) : : "memory");
    return c;
}
#else
static uint32_t native_bench_ccount_get(wasm_exec_env_t env)
{
    (void)env;
    return k_cycle_get_32();
}
#endif

/* ── bench_pin_core native implementation ───────────────────────────── */
static void native_bench_pin_core(wasm_exec_env_t env, int32_t core)
{
    (void)env;
#ifdef CONFIG_MP_MAX_NUM_CPUS
    if (core >= 0 && core < CONFIG_MP_MAX_NUM_CPUS) {
        k_thread_cpu_mask_clear(k_current_get());
        k_thread_cpu_mask_enable(k_current_get(), (uint8_t)core);
    }
#else
    (void)core;
#endif
}

/* ── Native symbol table (registered once before first module load) ─── */
static bool g_natives_registered = false;

static void register_bench_natives(void)
{
    if (g_natives_registered) return;

#ifdef CONFIG_AKIRA_WASM_RUNTIME
    static NativeSymbol bench_syms[] = {
        { "bench_ccount_get", native_bench_ccount_get, "()i", NULL },
        { "bench_pin_core",   native_bench_pin_core,   "(i)",  NULL },
    };
    bool ok = wasm_runtime_register_natives(
        "env", bench_syms, ARRAY_SIZE(bench_syms));
    if (!ok) {
        LOG_ERR("bench_b1_wasm: failed to register native symbols");
    }
#endif
    g_natives_registered = true;
}

/* ── Run one WASM variant ────────────────────────────────────────────── */
void bench_b1_wasm_run(const char *config)
{
#ifndef CONFIG_AKIRA_WASM_RUNTIME
    /* WASM runtime not built — emit mock */
    bench_b1_result_t r = {
        .config      = config,
        .mock_mode   = true,
        .mock_reason = "CONFIG_AKIRA_WASM_RUNTIME=n",
    };
    bench_print_b1(&r);
    return;
#else

    /* wasm_noguard requires CONFIG_AKIRA_CAPABILITY_SYSTEM=n build.
     * The prj_noguard.conf sets this; if the current build has CG enabled
     * we can still run — the WASM module has ai.infer in its manifest so
     * the check always passes.  The noguard prj disables the check entirely
     * for a true zero-overhead measurement. */
#ifdef CONFIG_AKIRA_CAPABILITY_SYSTEM
    if (strcmp(config, "wasm_noguard") == 0) {
        LOG_WRN("wasm_noguard: CG still enabled in this build "
                "(CONFIG_AKIRA_CAPABILITY_SYSTEM=y). "
                "Rebuild with prj_noguard.conf for zero-overhead baseline.");
        /* Continue anyway — results will include CG overhead (~1 inst) */
    }
#endif

    register_bench_natives();

    /* Register exit callback and reset semaphore */
    k_sem_reset(&g_wasm_done);
    akira_runtime_set_exit_callback(wasm_exit_cb);

    /* Load module — the embedded manifest is parsed here so cap_mask is set */
    int id = akira_runtime_load_wasm(WASM_BYTES, WASM_LEN);
    if (id < 0) {
        LOG_ERR("bench_b1_wasm/%s: akira_runtime_load_wasm failed: %d",
                config, id);
        bench_b1_result_t r = {
            .config      = config,
            .mock_mode   = true,
            .mock_reason = "akira_runtime_load_wasm failed",
        };
        bench_print_b1(&r);
        akira_runtime_set_exit_callback(NULL);
        return;
    }

    /* Start the WASM thread.  It runs main(), prints JSON, then exits. */
    int ret = akira_runtime_start(id);
    if (ret < 0) {
        LOG_ERR("bench_b1_wasm/%s: akira_runtime_start failed: %d",
                config, ret);
        bench_b1_result_t r = {
            .config      = config,
            .mock_mode   = true,
            .mock_reason = "akira_runtime_start failed",
        };
        bench_print_b1(&r);
        akira_runtime_set_exit_callback(NULL);
        akira_runtime_stop(id);
        return;
    }

    /* Wait for the WASM module to finish (up to 60 s for 1000 iterations) */
    ret = k_sem_take(&g_wasm_done, K_SECONDS(60));
    if (ret != 0) {
        LOG_ERR("bench_b1_wasm/%s: WASM module timed out", config);
    }

    akira_runtime_set_exit_callback(NULL);
    akira_runtime_stop(id);

    LOG_INF("bench_b1_wasm/%s: done", config);
#endif /* CONFIG_AKIRA_WASM_RUNTIME */
}
