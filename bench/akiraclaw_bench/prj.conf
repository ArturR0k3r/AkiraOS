## CMakeLists.txt
```
cmake_minimum_required(VERSION 3.20)

# ── AkiraOS board/DTS roots ─────────────────────────────────────────────
# Must be set BEFORE find_package(Zephyr) so the akiraconsole board
# definition is available. AKIRA_* Kconfig symbols come from the akira-os
# module (zephyr/Kconfig).
list(APPEND BOARD_ROOT ${CMAKE_CURRENT_LIST_DIR}/../..)
list(APPEND DTS_ROOT   ${CMAKE_CURRENT_LIST_DIR}/../..)
# The bench compiles its own subset of AkiraOS sources, so the module must
# not also build the full AkiraOS libraries into this image.
set(AKIRA_OS_BUILD_LIBRARIES OFF)

find_package(Zephyr REQUIRED HINTS $ENV{ZEPHYR_BASE})
project(akiraclaw_bench VERSION 1.0.0 LANGUAGES C CXX)

# ── Source files ─────────────────────────────────────────────────────────
target_sources(app PRIVATE
    src/main.c
    src/bench_b1_native.cpp
    src/bench_b1_wasm.c
    src/bench_b2_mpu.c
    src/bench_b3_audit.c
    src/bench_b4_mem.c
    src/bench_b5_ble.cpp
    # Minimal aiinfer native functions (PSRAM-arena, no capability gate)
    src/aiinfer_bench.cpp
    # AkiraOS runtime sources needed by B2 (sandbox) and B3 (audit)
    ${CMAKE_CURRENT_LIST_DIR}/../../src/runtime/security/sandbox.c
    # HMAC platform stub (only compiled when AKIRA_AUDIT_LOG_HMAC=y)
    src/akira_platform/audit_hmac.c
)

# ── Include directories ──────────────────────────────────────────────────
target_include_directories(app PRIVATE
    ${CMAKE_CURRENT_LIST_DIR}/src
    ${CMAKE_CURRENT_LIST_DIR}/../../src
    ${CMAKE_CURRENT_LIST_DIR}/../../src/api
    ${CMAKE_CURRENT_LIST_DIR}/../../src/runtime
    ${CMAKE_CURRENT_LIST_DIR}/../../src/runtime/security
    # TFLM headers
    ${ZEPHYR_TFLITE_MICRO_MODULE_DIR}
    ${ZEPHYR_TFLITE_MICRO_MODULE_DIR}/third_party_static/flatbuffers/include
    ${ZEPHYR_TFLITE_MICRO_MODULE_DIR}/third_party_static/gemmlowp
    # WAMR headers
    ${ZEPHYR_WASM_MICRO_RUNTIME_MODULE_DIR}/core/iwasm/include
    # hello_world_float model byte array
    ${CMAKE_CURRENT_LIST_DIR}/../../AkiraSDK/wasm_apps/aiinfer_test
)

# ── Mirror main CMakeLists: add AkiraOS TFLM submodule when AIINFER=y ───
if(CONFIG_AKIRA_AIINFER)
    enable_language(CXX)
    set(TFLM_ROOT_DIR ${ZEPHYR_TFLITE_MICRO_MODULE_DIR})
    if(CONFIG_AKIRA_TFLITE_MICRO AND EXISTS "${TFLM_ROOT_DIR}/CMakeLists.txt")
        add_subdirectory(${TFLM_ROOT_DIR} tflm_build EXCLUDE_FROM_ALL)
    endif()
    if(CONFIG_AKIRA_TFLITE_ESPNN AND CONFIG_SOC_SERIES_ESP32S3)
        target_compile_definitions(app PRIVATE TFLM_USE_ESPNN=1)
    endif()
    target_compile_definitions(app PRIVATE
        AKIRA_AIINFER_ARENA_KB=${CONFIG_AKIRA_AIINFER_ARENA_KB}
        AKIRA_AIINFER_MAX_HANDLES=${CONFIG_AKIRA_AIINFER_MAX_HANDLES}
    )
    if(TARGET tensorflow-lite-micro)
        target_link_libraries(app PRIVATE tensorflow-lite-micro)
    endif()
endif()

# ── WAMR build (mirroring main CMakeLists, simplified for bench) ────────
if(CONFIG_AKIRA_WASM_RUNTIME)
    set(WAMR_ROOT_DIR ${ZEPHYR_WASM_MICRO_RUNTIME_MODULE_DIR})
    set(WAMR_BUILD_PLATFORM  "zephyr")
    # Detect Xtensa toolchain (ESP32-S3 → XTENSA_32)
    string(TOLOWER "${CMAKE_C_COMPILER}" _bench_cc)
    if(_bench_cc MATCHES "xtensa")
        set(WAMR_BUILD_TARGET "XTENSA_32")
    elseif(_bench_cc MATCHES "arm" OR _bench_cc MATCHES "arm.*eabi")
        set(WAMR_BUILD_TARGET "THUMB_V7")
    elseif(_bench_cc MATCHES "riscv")
        if(CMAKE_SIZEOF_VOID_P EQUAL 8)
            set(WAMR_BUILD_TARGET "RISCV64")
        else()
            set(WAMR_BUILD_TARGET "RISCV32")
        endif()
    else()
        set(WAMR_BUILD_TARGET "X86_32")
    endif()
    set(WAMR_BUILD_INTERP           1)
    set(WAMR_BUILD_MINI_LOADER      1)
    set(WAMR_BUILD_AOT              0)
    set(WAMR_BUILD_LIBC_BUILTIN     1)
    set(WAMR_BUILD_LIBC_WASI        0)
    set(WAMR_BUILD_GLOBAL_HEAP_POOL 0)
    set(WAMR_BUILD_REF_TYPES        1)
    include(${WAMR_ROOT_DIR}/build-scripts/runtime_lib.cmake)
    target_sources(app PRIVATE ${WAMR_RUNTIME_LIB_SOURCE})
    # WAMR's zephyr platform header declares a zephyr_fs_desc with struct
    # fs_file_t/fs_dir_t but never includes <zephyr/fs/fs.h>; in the OS build the
    # WAMR Zephyr library picks it up transitively, but this standalone bench
    # build does not. Force-include it for the WAMR C/C++ sources only (not the
    # .S assembly files, which would choke on a C header).
    foreach(_wamr_src ${WAMR_RUNTIME_LIB_SOURCE})
        if(_wamr_src MATCHES "\\.(c|cc|cpp|cxx)$")
            set_source_files_properties(${_wamr_src} PROPERTIES
                COMPILE_OPTIONS "-include;zephyr/fs/fs.h")
        endif()
    endforeach()
    target_include_directories(app PRIVATE
        ${WAMR_ROOT_DIR}/core/iwasm/include
        ${WAMR_ROOT_DIR}/core/shared
        ${WAMR_ROOT_DIR}/core/deps
    )
    # Minimal akira_runtime wrapper (no full AkiraOS dep chain)
    target_sources(app PRIVATE
        ${CMAKE_CURRENT_LIST_DIR}/src/akira_runtime_bench.c
    )
endif()

# ── WASM variant selection ───────────────────────────────────────────────
if(CONFIG_BENCH_WASM_NOGUARD)
    target_compile_definitions(app PRIVATE BENCH_WASM_VARIANT_NOGUARD=1)
endif()

# ── Linker symbols for TFLM section size (B4) ───────────────────────────
zephyr_linker_sources(SECTIONS
    ${CMAKE_CURRENT_LIST_DIR}/tflm_section.ld
)

# ── C++ standard ────────────────────────────────────────────────────────
set_property(TARGET app PROPERTY CXX_STANDARD 14)
```

## Kconfig
```
# Benchmark-specific Kconfig options. Zephyr uses this file as the
# application Kconfig; AKIRA_* symbols come from the akira-os module.

config BENCH_WASM_NOGUARD
	bool "Use wasm_noguard binary for B1"
	default n
	help
	  When y, bench_b1_wasm.c includes wasm_data_noguard.h so the benchmark
	  runs the CG-disabled WASM variant.  Only meaningful with prj_noguard.conf
	  (CONFIG_AKIRA_CAPABILITY_SYSTEM=n).

config AKIRA_PLATFORM_AUDIT_HMAC
	bool "Platform HMAC key provider for audit log (bench stub)"
	default n
	help
	  Enables the bench-local audit_hmac.c which implements
	  akira_platform_audit_hmac_sign() using mbedTLS HMAC-SHA256 with a
	  fixed 32-byte bench key.  Required by AKIRA_AUDIT_LOG_HMAC.

source "Kconfig.zephyr"
```

## prj.conf
```kconfig
# akiraclaw_bench — baseline build
# Covers: B1 native_tflm + wasm_claw, B2 (watchdog path), B3 (no HMAC), B4, B5 (no BLE)

CONFIG_AKIRA_WASM_RUNTIME=y
CONFIG_AKIRA_AIINFER=y
CONFIG_AKIRA_TFLITE_MICRO=y
CONFIG_AKIRA_TFLITE_ESPNN=y
CONFIG_AKIRA_AIINFER_ARENA_KB=128
CONFIG_AKIRA_AIINFER_MAX_HANDLES=2

CONFIG_AKIRA_CAPABILITY_SYSTEM=y
CONFIG_AKIRA_SANDBOX=y
CONFIG_AKIRA_SANDBOX_EXEC_TIMEOUT_MS=30000
CONFIG_AKIRA_SANDBOX_RATE_LIMITING=n
CONFIG_AKIRA_SECURITY_AUDIT=y
CONFIG_AKIRA_AUDIT_LOG_SIZE=64
CONFIG_AKIRA_AUDIT_LOG_HMAC=n
CONFIG_AKIRA_SANDBOX_MPU=n

# PSRAM is enabled by the board defconfig (MEMC dependency satisfied there)

CONFIG_LOG=y
CONFIG_LOG_MODE_DEFERRED=y
CONFIG_LOG_BUFFER_SIZE=8192
CONFIG_AKIRA_LOG_LEVEL=3

CONFIG_BT=n

CONFIG_MP_MAX_NUM_CPUS=2
CONFIG_SCHED_CPU_MASK=y

CONFIG_AKIRA_WASM_START_TIMEOUT_MS=15000
CONFIG_AKIRA_WASM_STOP_TIMEOUT_MS=5000
CONFIG_MAX_CONTAINERS=2

CONFIG_HEAP_MEM_POOL_SIZE=32768
CONFIG_FILE_SYSTEM=y

# PSRAM: place 128KB TFLM tensor arena and audit sample buffer in SPIRAM
# Full OPI PSRAM config matching boards/akiraconsole_esp32s3_procpu.conf
CONFIG_AKIRA_PSRAM=y
CONFIG_ESP_SPIRAM=y
CONFIG_ESP_SPIRAM_SIZE=8388608
CONFIG_ESP_SPIRAM_HEAP_SIZE=4194304
CONFIG_SPIRAM_MODE_OCT=y
CONFIG_SPIRAM_TYPE_ESPPSRAM64=y
CONFIG_SPIRAM_SPEED_80M=y
CONFIG_SPIRAM_RODATA=y
CONFIG_SPIRAM_FETCH_INSTRUCTIONS=y
CONFIG_ESP_SPIRAM_MEMTEST=n
CONFIG_MEMC=y

CONFIG_CPP=y
CONFIG_STD_CPP14=y
CONFIG_GLIBCXX_LIBCPP=y
CONFIG_REQUIRES_FLOAT_PRINTF=y

# AkiraOS module options (zephyr/Kconfig) depend on this switch.
CONFIG_AKIRA_OS=y
```

## prj_ble.conf
```kconfig
# akiraclaw_bench — B5 BLE coexistence variant
# Enables BLE advertising while running aiinfer_run in a tight loop.
# Measures inference latency variance and missed advertising events.
#
# Usage:
#   west build -b akiraconsole/esp32s3/procpu bench/akiraclaw_bench \
#       -- -DCONF_FILE=prj_ble.conf

CONFIG_AKIRA_WASM_RUNTIME=y
CONFIG_AKIRA_AIINFER=y
CONFIG_AKIRA_TFLITE_MICRO=y
CONFIG_AKIRA_TFLITE_ESPNN=y
CONFIG_AKIRA_AIINFER_ARENA_KB=128
CONFIG_AKIRA_AIINFER_MAX_HANDLES=2
CONFIG_AKIRA_CAPABILITY_SYSTEM=y
CONFIG_AKIRA_SANDBOX=y
CONFIG_AKIRA_SANDBOX_EXEC_TIMEOUT_MS=30000
CONFIG_AKIRA_SANDBOX_RATE_LIMITING=n
CONFIG_AKIRA_SECURITY_AUDIT=y
CONFIG_AKIRA_AUDIT_LOG_SIZE=64
CONFIG_AKIRA_AUDIT_LOG_HMAC=n
CONFIG_AKIRA_PSRAM=y
CONFIG_LOG=y
CONFIG_LOG_MODE_DEFERRED=y
CONFIG_AKIRA_LOG_LEVEL=3
CONFIG_MP_MAX_NUM_CPUS=2
CONFIG_SCHED_CPU_MASK=y
CONFIG_MAX_CONTAINERS=2
CONFIG_HEAP_MEM_POOL_SIZE=65536
CONFIG_FILE_SYSTEM=y
CONFIG_CPP=y
CONFIG_STD_CPP14=y
CONFIG_GLIBCXX_LIBCPP=y

# ── BLE ───────────────────────────────────────────────────────────────────
CONFIG_BT=y
CONFIG_BT_PERIPHERAL=y
CONFIG_BT_DEVICE_NAME="akiraclaw_bench"
CONFIG_BT_MAX_CONN=1

# BT host stack heap — must accommodate adv + connection state
CONFIG_BT_BUF_ACL_TX_COUNT=4
CONFIG_BT_BUF_ACL_RX_COUNT=4

# ESP32-S3 BLE controller uses the IDF BT stack via Zephyr shim
CONFIG_ESP_HEAP_MEM_POOL_REGION_1_SIZE=0

# AkiraOS module options (zephyr/Kconfig) depend on this switch.
CONFIG_AKIRA_OS=y
```

## prj_hmac.conf
```kconfig
# akiraclaw_bench — B3 HMAC variant
# Enable HMAC-SHA256 signing of audit entries.
# Compare audit_write_avg_ns against the baseline prj.conf run.

# ── Inherit baseline config ────────────────────────────────────────────────
CONFIG_AKIRA_WASM_RUNTIME=y
CONFIG_AKIRA_AIINFER=y
CONFIG_AKIRA_TFLITE_MICRO=y
CONFIG_AKIRA_TFLITE_ESPNN=y
CONFIG_AKIRA_AIINFER_ARENA_KB=128
CONFIG_AKIRA_AIINFER_MAX_HANDLES=2
CONFIG_AKIRA_CAPABILITY_SYSTEM=y
CONFIG_AKIRA_SANDBOX=y
CONFIG_AKIRA_SANDBOX_EXEC_TIMEOUT_MS=30000
CONFIG_AKIRA_SANDBOX_RATE_LIMITING=n
CONFIG_AKIRA_SECURITY_AUDIT=y
CONFIG_AKIRA_AUDIT_LOG_SIZE=64
CONFIG_AKIRA_SANDBOX_MPU=n

CONFIG_LOG=y
CONFIG_LOG_MODE_DEFERRED=y
CONFIG_LOG_BUFFER_SIZE=8192
CONFIG_AKIRA_LOG_LEVEL=3

CONFIG_BT=n
CONFIG_MP_MAX_NUM_CPUS=2
CONFIG_SCHED_CPU_MASK=y
CONFIG_AKIRA_WASM_START_TIMEOUT_MS=15000
CONFIG_AKIRA_WASM_STOP_TIMEOUT_MS=5000
CONFIG_MAX_CONTAINERS=2

CONFIG_HEAP_MEM_POOL_SIZE=32768
CONFIG_FILE_SYSTEM=y

CONFIG_AKIRA_PSRAM=y
CONFIG_ESP_SPIRAM=y
CONFIG_ESP_SPIRAM_SIZE=8388608
CONFIG_ESP_SPIRAM_HEAP_SIZE=4194304
CONFIG_SPIRAM_MODE_OCT=y
CONFIG_SPIRAM_TYPE_ESPPSRAM64=y
CONFIG_SPIRAM_SPEED_80M=y
CONFIG_SPIRAM_RODATA=y
CONFIG_SPIRAM_FETCH_INSTRUCTIONS=y
CONFIG_ESP_SPIRAM_MEMTEST=n
CONFIG_MEMC=y

CONFIG_CPP=y
CONFIG_STD_CPP14=y
CONFIG_GLIBCXX_LIBCPP=y
CONFIG_REQUIRES_FLOAT_PRINTF=y

# ── HMAC-specific ─────────────────────────────────────────────────────────
CONFIG_AKIRA_PLATFORM_AUDIT_HMAC=y
CONFIG_AKIRA_AUDIT_LOG_HMAC=y
CONFIG_MBEDTLS=y
CONFIG_MBEDTLS_SHA256=y
CONFIG_MBEDTLS_MD_C=y

# AkiraOS module options (zephyr/Kconfig) depend on this switch.
CONFIG_AKIRA_OS=y
```

## prj_noguard.conf
```kconfig
# akiraclaw_bench — B1 wasm_noguard variant
# Disables the capability gate system so AKIRA_CHECK_CAP_OR_RETURN
# compiles to a true no-op.  This gives the zero-overhead WASM baseline
# for the CG cost comparison (wasm_noguard vs wasm_claw).
#
# WARNING: CONFIG_AKIRA_CAPABILITY_SYSTEM=n implies CONFIG_AKIRA_SANDBOX=n
# (sandbox depends on CG).  Do not use this config for production.
#
# Usage:
#   west build -b akiraconsole/esp32s3/procpu bench/akiraclaw_bench \
#       -- -DCONF_FILE=prj_noguard.conf -DCONFIG_BENCH_WASM_NOGUARD=y

CONFIG_AKIRA_WASM_RUNTIME=y
CONFIG_AKIRA_AIINFER=y
CONFIG_AKIRA_TFLITE_MICRO=y
CONFIG_AKIRA_TFLITE_ESPNN=y
CONFIG_AKIRA_AIINFER_ARENA_KB=128
CONFIG_AKIRA_AIINFER_MAX_HANDLES=2
CONFIG_LOG=y
CONFIG_LOG_MODE_DEFERRED=y
CONFIG_AKIRA_LOG_LEVEL=3
CONFIG_BT=n
CONFIG_MP_MAX_NUM_CPUS=2
CONFIG_SCHED_CPU_MASK=y
CONFIG_MAX_CONTAINERS=2
CONFIG_HEAP_MEM_POOL_SIZE=65536
CONFIG_FILE_SYSTEM=y
CONFIG_CPP=y
CONFIG_STD_CPP14=y
CONFIG_GLIBCXX_LIBCPP=y

# ── CG disabled — WASM API cap checks become unconditional pass ──────────
CONFIG_AKIRA_CAPABILITY_SYSTEM=n
# AKIRA_SANDBOX and AKIRA_SECURITY_AUDIT both depend on CAPABILITY_SYSTEM
# and will be automatically disabled.

# Expose the noguard WASM binary in bench_b1_wasm.c
CONFIG_BENCH_WASM_NOGUARD=y

# AkiraOS module options (zephyr/Kconfig) depend on this switch.
CONFIG_AKIRA_OS=y
```

## src/main.c
```c
/*
 * main.c — akiraclaw_bench orchestrator
 *
 * Runs B1-B5 in sequence on boot.  Each sub-benchmark prints one or more
 * JSON objects delimited by <<BENCH_JSON_START>> / <<BENCH_JSON_END>>.
 * The host-side scripts/collect.py extracts these from the serial log.
 *
 * Build variants (select via CMake -DCONF_FILE=):
 *   prj.conf          — baseline: B1 native_tflm + wasm_claw, B2 watchdog, B3 no-HMAC, B4, B5 no-BLE
 *   prj_hmac.conf     — B3 with HMAC enabled
 *   prj_noguard.conf  — B1 wasm_noguard (CONFIG_AKIRA_CAPABILITY_SYSTEM=n)
 *   prj_ble.conf      — B5 with BLE advertising active
 *
 * Thread pinning:
 *   Main benchmark thread is pinned to Core 1 immediately at entry.
 *   This matches the SMP/AMP paper baseline (DOI 10.13140/RG.2.2.19723.25124).
 *   The WASM bench module also calls bench_pin_core(1) on startup.
 */

#include <zephyr/kernel.h>
#include <zephyr/logging/log.h>
#include <zephyr/logging/log_ctrl.h>

#include "bench_b1.h"
#include "result.h"
#include "timing.h"

LOG_MODULE_REGISTER(akiraclaw_bench, CONFIG_AKIRA_LOG_LEVEL);

/* Forward declarations for B2-B5 (defined in separate .c files) */
void bench_b2_run(void);
void bench_b3_run(void);
void bench_b4_run(void);
void bench_b5_run(void);

/* ── Runtime init barrier: wait for AkiraOS runtime to be ready ─────── */
#ifdef CONFIG_AKIRA_WASM_RUNTIME
#include "runtime/akira_runtime.h"
/* The runtime initialises as a SYS_INIT at APPLICATION level.
 * We yield briefly to ensure it finishes before loading modules. */
static void wait_for_runtime(void)
{
    /* Probe: try to get runtime status.  100 ms is conservative. */
    k_sleep(K_MSEC(100));
}
#else
static void wait_for_runtime(void) {}
#endif

int main(void)
{
    printk("\n");
    printk("========================================\n");
    printk("  akiraclaw_bench v1.0  AkiraOS 4.3.0  \n");
    printk("  platform: esp32s3_akiraconsole        \n");
    printk("========================================\n\n");

    /* ── Pin this thread to Core 1 ──────────────────────────────────── */
#ifdef CONFIG_MP_MAX_NUM_CPUS
    k_thread_cpu_mask_clear(k_current_get());
    k_thread_cpu_mask_enable(k_current_get(), 1);
    LOG_INF("Benchmark thread pinned to Core 1");
#endif

    /* ── B4: memory breakdown (compile-time, run first for quick sanity) */
    LOG_INF("--- B4: memory breakdown ---");
    bench_b4_run();
    log_panic();           /* flush any deferred log messages now */
    k_msleep(200);         /* let UART TX FIFO drain before next section */

    /* ── Wait for WASM runtime ──────────────────────────────────────── */
    wait_for_runtime();

    /* ── B1 native_tflm: TFLite Micro direct (no WASM) ─────────────── */
    printk("--- B1: native_tflm ---\n");
    bench_b1_native_run();
    log_panic();
    k_msleep(200);

    /* ── B1 wasm_claw: WASM + capability gate (ai.infer granted) ────── */
    printk("--- B1: wasm_claw ---\n");
    bench_b1_wasm_run("wasm_claw");
    log_panic();
    k_msleep(200);

    /* ── B1 wasm_noguard: WASM, CG disabled (prj_noguard.conf) ─────── */
#ifdef CONFIG_BENCH_WASM_NOGUARD
    printk("--- B1: wasm_noguard ---\n");
    bench_b1_wasm_run("wasm_noguard");
    log_panic();
    k_msleep(200);
#endif

    /* ── B1 wasm_claw_mpu: ARM MPU only; on Xtensa emit mock directly ── */
    printk("--- B1: wasm_claw_mpu ---\n");
#ifdef CONFIG_SOC_SERIES_ESP32S3
    {
        bench_b1_result_t r = {
            .config      = "wasm_claw_mpu",
            .mock_mode   = true,
            .mock_reason = "ARM_MPU unavailable on ESP32-S3 (Xtensa LX7); "
                           "run on Cortex-M with prj_mpu.conf for real measurement",
        };
        bench_print_b1(&r);
    }
#else
    bench_b1_wasm_run("wasm_claw_mpu");
#endif
    log_panic();
    k_msleep(200);

    /* ── B2: sandbox_exec_begin / end domain-switch overhead ─────────── */
    printk("--- B2: MPU domain switch overhead ---\n");
    bench_b2_run();
    log_panic();
    k_msleep(200);

    /* ── B3: HMAC audit log write latency ───────────────────────────── */
    printk("--- B3: HMAC audit log ---\n");
    bench_b3_run();
    log_panic();
    k_msleep(200);

    /* ── B5: inference + BLE coexistence ───────────────────────────── */
    printk("--- B5: BLE coexistence ---\n");
    bench_b5_run();
    log_panic();
    k_msleep(200);

    printk("\n========================================\n");
    printk("  akiraclaw_bench COMPLETE\n");
    printk("========================================\n\n");

    return 0;
}
```

## src/aiinfer_bench.cpp
```c
/*
 * aiinfer_bench.cpp — minimal aiinfer native API for akiraclaw_bench.
 *
 * Provides akira_native_aiinfer_load/run/unload without the full AkiraOS
 * dependency chain (no security gate, no mem_helper).
 * Arenas are placed in PSRAM (.ext_ram.bss) when CONFIG_AKIRA_PSRAM=y.
 */

#ifdef CONFIG_AKIRA_AIINFER

#include "akira_aiinfer_api.h"

#include <zephyr/kernel.h>
#include <zephyr/logging/log.h>
#include <string.h>

#include "tensorflow/lite/micro/micro_interpreter.h"
#include "tensorflow/lite/micro/micro_mutable_op_resolver.h"
#include "tensorflow/lite/schema/schema_generated.h"

LOG_MODULE_DECLARE(akiraclaw_bench, CONFIG_AKIRA_LOG_LEVEL);

#ifndef AKIRA_AIINFER_ARENA_KB
#define AKIRA_AIINFER_ARENA_KB 128
#endif

#ifndef AKIRA_AIINFER_MAX_HANDLES
#define AKIRA_AIINFER_MAX_HANDLES 2
#endif

#define BENCH_ARENA_BYTES (AKIRA_AIINFER_ARENA_KB * 1024U)

#ifdef CONFIG_AKIRA_PSRAM
#define EXT_BSS __attribute__((section(".ext_ram.bss"), aligned(16)))
#else
#define EXT_BSS __attribute__((aligned(16)))
#endif

/* Arenas must be globals to carry section attributes (not struct members). */
static uint8_t g_arena_0[BENCH_ARENA_BYTES] EXT_BSS;
static uint8_t g_arena_1[BENCH_ARENA_BYTES] EXT_BSS;

static uint8_t * const g_arenas[AKIRA_AIINFER_MAX_HANDLES] = {
    g_arena_0,
    g_arena_1,
};

typedef struct {
    bool   used;
    alignas(alignof(tflite::MicroInterpreter))
        uint8_t interp_buf[sizeof(tflite::MicroInterpreter)];
    alignas(alignof(tflite::MicroMutableOpResolver<16>))
        uint8_t resolver_buf[sizeof(tflite::MicroMutableOpResolver<16>)];
    tflite::MicroInterpreter          *interp;
    tflite::MicroMutableOpResolver<16> *resolver;
} bench_infer_slot_t;

static bench_infer_slot_t g_bench_slots[AKIRA_AIINFER_MAX_HANDLES];

static void build_resolver(tflite::MicroMutableOpResolver<16> *r)
{
    r->AddDepthwiseConv2D();
    r->AddConv2D();
    r->AddFullyConnected();
    r->AddSoftmax();
    r->AddReshape();
    r->AddAveragePool2D();
    r->AddMaxPool2D();
    r->AddQuantize();
    r->AddDequantize();
}

int akira_native_aiinfer_load(wasm_exec_env_t exec_env,
                              const uint8_t *model_buf, uint32_t model_len)
{
    (void)exec_env;
    (void)model_len;

    for (int i = 0; i < AKIRA_AIINFER_MAX_HANDLES; i++) {
        bench_infer_slot_t *s = &g_bench_slots[i];
        if (s->used) continue;

        s->resolver = new (s->resolver_buf) tflite::MicroMutableOpResolver<16>();
        build_resolver(s->resolver);

        s->interp = new (s->interp_buf) tflite::MicroInterpreter(
            tflite::GetModel(model_buf), *s->resolver,
            g_arenas[i], BENCH_ARENA_BYTES);

        if (s->interp->AllocateTensors() != kTfLiteOk) {
            LOG_ERR("aiinfer_bench: AllocateTensors failed (slot %d)", i);
            s->interp->~MicroInterpreter();
            s->resolver->~MicroMutableOpResolver<16>();
            return AIINFER_ERR_NOMEM;
        }
        s->used = true;
        LOG_INF("aiinfer_bench: loaded slot %d (%u KB arena)", i,
                AKIRA_AIINFER_ARENA_KB);
        return i;
    }
    return AIINFER_ERR_NOSLOT;
}

int akira_native_aiinfer_run(wasm_exec_env_t exec_env,
                             int handle,
                             const uint8_t *in_buf,  uint32_t in_len,
                             uint8_t       *out_buf, uint32_t out_len)
{
    (void)exec_env;
    if (handle < 0 || handle >= AKIRA_AIINFER_MAX_HANDLES ||
        !g_bench_slots[handle].used) {
        return AIINFER_ERR_INVALID;
    }
    bench_infer_slot_t *s = &g_bench_slots[handle];
    TfLiteTensor *in  = s->interp->input(0);
    TfLiteTensor *out = s->interp->output(0);

    if (!in || !out) return AIINFER_ERR_SHAPE;
    if (in_len < in->bytes) return AIINFER_ERR_SHAPE;

    memcpy(in->data.raw, in_buf, in->bytes);
    if (s->interp->Invoke() != kTfLiteOk) return AIINFER_ERR_INVALID;

    uint32_t copy_len = (out_len < out->bytes) ? out_len : out->bytes;
    memcpy(out_buf, out->data.raw, copy_len);
    return AIINFER_OK;
}

void akira_native_aiinfer_unload(wasm_exec_env_t exec_env, int handle)
{
    (void)exec_env;
    if (handle < 0 || handle >= AKIRA_AIINFER_MAX_HANDLES ||
        !g_bench_slots[handle].used) {
        return;
    }
    bench_infer_slot_t *s = &g_bench_slots[handle];
    s->interp->~MicroInterpreter();
    s->resolver->~MicroMutableOpResolver<16>();
    s->used = false;
    LOG_INF("aiinfer_bench: unloaded slot %d", handle);
}

#endif /* CONFIG_AKIRA_AIINFER */
```

## src/akira_runtime_bench.c
```c
/*
 * akira_runtime_bench.c — minimal WAMR wrapper for akiraclaw_bench.
 *
 * Provides akira_runtime_{set_exit_callback,load_wasm,start,stop} without
 * pulling in the full AkiraOS runtime dependency chain (manifest_parser,
 * fs_manager, app_signing, etc.).  Intended ONLY for the benchmark app.
 */

#ifdef CONFIG_AKIRA_WASM_RUNTIME

#include <wasm_export.h>
#include <zephyr/kernel.h>
#include <zephyr/logging/log.h>
#include <string.h>
#include <stdint.h>
#include <stdbool.h>

#ifdef CONFIG_AKIRA_AIINFER
#include "akira_aiinfer_api.h"
#endif

#include <zephyr/sys/printk.h>

LOG_MODULE_DECLARE(akiraclaw_bench, CONFIG_AKIRA_LOG_LEVEL);

/* ── Utility natives required by the akiraclaw_bench WASM module ──── */

static int32_t native_printf_native(wasm_exec_env_t env, const char *str)
{
    (void)env;
    if (!str) return -1;
    printk("%s", str);
    return (int32_t)strlen(str);
}

static int32_t native_strlen(wasm_exec_env_t env, const char *str)
{
    (void)env;
    if (!str) return 0;
    return (int32_t)strlen(str);
}

typedef void (*akira_runtime_exit_cb_t)(int slot, int exit_code);

#define BENCH_MAX_SLOTS  2
#define BENCH_STACK_SIZE 4096
#define BENCH_WASM_STACK 4096
#define BENCH_WASM_HEAP  32768

typedef struct {
    bool            used;
    wasm_module_t   module;
    wasm_module_inst_t instance;
    wasm_exec_env_t exec_env;
    struct k_thread thread;
    K_KERNEL_STACK_MEMBER(stack, BENCH_STACK_SIZE);
} bench_slot_t;

static bench_slot_t g_slots[BENCH_MAX_SLOTS];
static akira_runtime_exit_cb_t g_exit_cb;
static bool g_wamr_inited;

static NativeSymbol g_bench_util_natives[] = {
    {"printf_native", (void *)native_printf_native, "($)i", NULL},
    {"strlen",        (void *)native_strlen,        "($)i", NULL},
};

#ifdef CONFIG_AKIRA_AIINFER
static NativeSymbol g_aiinfer_natives[] = {
    {"aiinfer_load",   (void *)akira_native_aiinfer_load,   "(*~)i",    NULL},
    {"aiinfer_run",    (void *)akira_native_aiinfer_run,    "(i*~*~)i", NULL},
    {"aiinfer_unload", (void *)akira_native_aiinfer_unload, "(i)",      NULL},
};
#endif

static int bench_wamr_init(void)
{
    RuntimeInitArgs init = {0};
    init.mem_alloc_type = Alloc_With_System_Allocator;
    if (!wasm_runtime_full_init(&init)) {
        LOG_ERR("bench_runtime: wasm_runtime_full_init failed");
        return -EIO;
    }

    if (!wasm_runtime_register_natives("env", g_bench_util_natives,
                                       ARRAY_SIZE(g_bench_util_natives))) {
        LOG_ERR("bench_runtime: util native registration failed");
        return -EIO;
    }

#ifdef CONFIG_AKIRA_AIINFER
    if (!wasm_runtime_register_natives("env", g_aiinfer_natives,
                                       ARRAY_SIZE(g_aiinfer_natives))) {
        LOG_ERR("bench_runtime: aiinfer native registration failed");
        return -EIO;
    }
    LOG_DBG("bench_runtime: aiinfer natives registered");
#endif

    g_wamr_inited = true;
    LOG_DBG("bench_runtime: WAMR initialized");
    return 0;
}
SYS_INIT(bench_wamr_init, APPLICATION, CONFIG_APPLICATION_INIT_PRIORITY);

int akira_runtime_init(void)
{
    return g_wamr_inited ? 0 : bench_wamr_init();
}

void akira_runtime_set_exit_callback(akira_runtime_exit_cb_t cb)
{
    g_exit_cb = cb;
}

static void bench_wasm_thread(void *arg1, void *arg2, void *arg3)
{
    int slot = (int)(intptr_t)arg1;
    (void)arg2;
    (void)arg3;
    bench_slot_t *s = &g_slots[slot];
    char err[128] = {0};

    s->instance = wasm_runtime_instantiate(s->module,
                                           BENCH_WASM_STACK, BENCH_WASM_HEAP,
                                           err, sizeof(err));
    if (!s->instance) {
        LOG_ERR("bench_runtime: instantiate failed: %s", err);
        if (g_exit_cb) {
            g_exit_cb(slot, -1);
        }
        return;
    }

    s->exec_env = wasm_runtime_create_exec_env(s->instance, BENCH_WASM_STACK);
    if (!s->exec_env) {
        LOG_ERR("bench_runtime: create_exec_env failed");
        wasm_runtime_deinstantiate(s->instance);
        s->instance = NULL;
        if (g_exit_cb) {
            g_exit_cb(slot, -1);
        }
        return;
    }

    /* Try WASI-style entry first, fall back to bare main */
    wasm_function_inst_t fn =
        wasm_runtime_lookup_function(s->instance, "__main_argc_argv");
    if (!fn) {
        fn = wasm_runtime_lookup_function(s->instance, "main");
    }

    int exit_code = 0;
    if (fn) {
        uint32_t args[2] = {0, 0};
        if (!wasm_runtime_call_wasm(s->exec_env, fn, 2, args)) {
            LOG_WRN("bench_runtime: wasm call returned non-zero");
            exit_code = 1;
        }
    } else {
        LOG_WRN("bench_runtime: no main() found in WASM module");
    }

    if (g_exit_cb) {
        g_exit_cb(slot, exit_code);
    }
}

int akira_runtime_load_wasm(const uint8_t *buffer, uint32_t size)
{
    if (!g_wamr_inited) {
        LOG_ERR("bench_runtime: WAMR not initialized");
        return -1;
    }

    for (int i = 0; i < BENCH_MAX_SLOTS; i++) {
        if (!g_slots[i].used) {
            char err[128] = {0};
            /* Cast away const: WAMR takes uint8_t* but does not modify buffer */
            g_slots[i].module = wasm_runtime_load(
                (uint8_t *)(uintptr_t)buffer, size, err, sizeof(err));
            if (!g_slots[i].module) {
                LOG_ERR("bench_runtime: load failed: %s", err);
                return -1;
            }
            g_slots[i].used     = true;
            g_slots[i].instance = NULL;
            g_slots[i].exec_env = NULL;
            return i;
        }
    }
    LOG_ERR("bench_runtime: no free slots");
    return -1;
}

int akira_runtime_start(int instance_id)
{
    if (instance_id < 0 || instance_id >= BENCH_MAX_SLOTS ||
        !g_slots[instance_id].used) {
        return -1;
    }
    k_thread_create(
        &g_slots[instance_id].thread,
        g_slots[instance_id].stack,
        K_KERNEL_STACK_SIZEOF(g_slots[instance_id].stack),
        bench_wasm_thread,
        (void *)(intptr_t)instance_id, NULL, NULL,
        5, 0, K_NO_WAIT);
    return 0;
}

int akira_runtime_stop(int instance_id)
{
    if (instance_id < 0 || instance_id >= BENCH_MAX_SLOTS ||
        !g_slots[instance_id].used) {
        return -1;
    }
    bench_slot_t *s = &g_slots[instance_id];

    if (s->exec_env) {
        wasm_runtime_destroy_exec_env(s->exec_env);
        s->exec_env = NULL;
    }
    if (s->instance) {
        wasm_runtime_deinstantiate(s->instance);
        s->instance = NULL;
    }
    if (s->module) {
        wasm_runtime_unload(s->module);
        s->module = NULL;
    }
    s->used = false;
    return 0;
}

#endif /* CONFIG_AKIRA_WASM_RUNTIME */
```

## src/bench_b1.h
```c
/* bench_b1.h — shared declarations for B1 sub-modules */
#pragma once

#ifdef __cplusplus
extern "C" {
#endif

/* native_tflm: TFLite Micro called directly from C++ (no WASM) */
void bench_b1_native_run(void);

/* wasm_noguard / wasm_claw / wasm_claw_mpu:
 * Load the akiraclaw_bench WASM module via the AkiraOS runtime and
 * collect the JSON results it prints to the console.
 * @param config  one of "wasm_noguard", "wasm_claw", "wasm_claw_mpu"
 */
void bench_b1_wasm_run(const char *config);

#ifdef __cplusplus
}
#endif
```

## src/bench_b1_native.cpp
```c
/*
 * bench_b1_native.cpp — B1 baseline: TFLite Micro called directly from C++
 *
 * Bypasses the AkiraOS WASM wrapper, WAMR dispatch, and capability gate
 * entirely.  Mirrors the setup in akira_aiinfer_api.cpp so the comparison
 * is apples-to-apples: same ops, same arena size, same PSRAM placement.
 *
 * Timing: CCOUNT register (Xtensa @ 240 MHz).  Compiler barriers prevent
 * the compiler from moving the timestamp reads out of the measured region.
 * Loop overhead is calibrated and subtracted before reporting.
 */

#include "bench_b1.h"
#include "timing.h"
#include "result.h"

#include <zephyr/kernel.h>
#include <zephyr/logging/log.h>
#include <string.h>

#include "tensorflow/lite/micro/micro_interpreter.h"
#include "tensorflow/lite/micro/micro_mutable_op_resolver.h"
#include "tensorflow/lite/schema/schema_generated.h"

LOG_MODULE_DECLARE(akiraclaw_bench, CONFIG_AKIRA_LOG_LEVEL);

/* ── Model embedded from AkiraSDK (3164 bytes, hello_world_float_sine) ─── */
/* model_data.h is found via the CMakeLists include path for aiinfer_test/ */
#include "model_data.h"

/* ── Tensor arena — PSRAM on ESP32-S3, SRAM on other targets ───────────── */
#ifdef CONFIG_AKIRA_PSRAM
#define EXT_BSS __attribute__((section(".ext_ram.bss"), aligned(16)))
#else
#define EXT_BSS __attribute__((aligned(16)))
#endif

#define ARENA_KB 128U
static uint8_t g_arena[ARENA_KB * 1024U] EXT_BSS;

/* ── TFLM op resolver — same set as akira_aiinfer_api.cpp ─────────────── */
static tflite::MicroMutableOpResolver<16> g_resolver;

static bool g_resolver_built = false;

static void build_resolver(void)
{
    if (g_resolver_built) return;
    g_resolver.AddDepthwiseConv2D();
    g_resolver.AddConv2D();
    g_resolver.AddFullyConnected();
    g_resolver.AddSoftmax();
    g_resolver.AddReshape();
    g_resolver.AddAveragePool2D();
    g_resolver.AddMaxPool2D();
    g_resolver.AddQuantize();
    g_resolver.AddDequantize();
    g_resolver_built = true;
}

/* ── Persistent samples buffer — static to avoid large stack frame ──────── */
static bench_stat_t g_stat;

extern "C" void bench_b1_native_run(void)
{
    bench_b1_result_t result = {
        .config            = "native_tflm",
        .iterations        = BENCH_MAX_ITERS,
        .model_size_bytes  = hello_world_model_len,
        .ble_active        = false,
        .mock_mode         = false,
        .mock_reason       = NULL,
    };

    /* Calibrate loop overhead (50 warm-up iterations) */
    result.loop_overhead_us = bench_loop_overhead_us(50);

    /* ── Load phase ───────────────────────────────────────────────────── */
    build_resolver();
    const tflite::Model *model = tflite::GetModel(hello_world_model);
    if (model->version() != TFLITE_SCHEMA_VERSION) {
        LOG_ERR("B1/native: schema version mismatch");
        result.mock_mode   = true;
        result.mock_reason = "model schema version mismatch";
        bench_print_b1(&result);
        return;
    }

    uint32_t t0, t1;

    /* Construct interpreter in stack-scoped storage so it is destroyed
     * before we print results.  Placement-new into a static buffer avoids
     * heap operator new (not available in all Zephyr configs). */
    static uint8_t g_interp_buf[sizeof(tflite::MicroInterpreter)]
        __attribute__((aligned(alignof(tflite::MicroInterpreter))));

    BENCH_TS_START(t0);
    tflite::MicroInterpreter *interp =
        new (g_interp_buf) tflite::MicroInterpreter(
            model, g_resolver, g_arena, sizeof(g_arena));
    if (interp->AllocateTensors() != kTfLiteOk) {
        BENCH_TS_STOP(t1);
        LOG_ERR("B1/native: AllocateTensors failed");
        result.mock_mode   = true;
        result.mock_reason = "AllocateTensors failed — arena too small?";
        bench_print_b1(&result);
        return;
    }
    BENCH_TS_STOP(t1);
    result.load_us = bench_cycles_to_us(t1 - t0);

    TfLiteTensor *input  = interp->input(0);
    TfLiteTensor *output = interp->output(0);

    if (!input || !output || input->bytes != sizeof(float)) {
        LOG_ERR("B1/native: unexpected tensor shape");
        result.mock_mode   = true;
        result.mock_reason = "unexpected input/output tensor shape";
        bench_print_b1(&result);
        return;
    }

    /* ── Warm-up (not measured) ─────────────────────────────────────── */
    float x = 0.7854f; /* π/4 */
    for (int i = 0; i < 5; i++) {
        memcpy(input->data.raw, &x, sizeof(float));
        interp->Invoke();
    }

    /* ── Hot-loop: 1000 iterations ───────────────────────────────────── */
    bench_stat_reset(&g_stat);

    for (int i = 0; i < BENCH_MAX_ITERS; i++) {
        /* Rotate input across [0, π] to defeat constant-folding */
        float xi = (float)i * (3.14159f / BENCH_MAX_ITERS);
        memcpy(input->data.raw, &xi, sizeof(float));

        BENCH_TS_START(t0);
        interp->Invoke();
        BENCH_TS_STOP(t1);

        bench_stat_add(&g_stat, t1 - t0);
    }

    result.run_avg_us = bench_stat_avg_us(&g_stat);
    result.run_p99_us = bench_stat_p99_us(&g_stat); /* sorts g_stat.samples_us */
    result.run_max_us = g_stat.max_us;

    /* Subtract loop overhead from average (p99/max left as hardware truth) */
    if (result.run_avg_us > result.loop_overhead_us)
        result.run_avg_us -= result.loop_overhead_us;

    /* ── Unload phase ──────────────────────────────────────────────────── */
    BENCH_TS_START(t0);
    interp->~MicroInterpreter();
    BENCH_TS_STOP(t1);
    result.unload_us = bench_cycles_to_us(t1 - t0);

    bench_print_b1(&result);
    LOG_INF("B1/native_tflm done: avg=%u p99=%u max=%u us",
            result.run_avg_us, result.run_p99_us, result.run_max_us);
}
```

## src/bench_b1_wasm.c
```c
/*
 * bench_b1_wasm.c — B1 WASM-path benchmarks (wasm_noguard / wasm_claw / wasm_claw_mpu)
 *
 * Loads the pre-compiled akiraclaw_bench WASM module embedded as a C header
 * (wasm_data_<variant>.h, generated by `make headers` in the WASM app dir).
 *
 * Before loading, registers two benchmark-only native symbols:
 *
 *   bench_ccount_get() → reads Xtensa CCOUNT; lets the WASM hot-loop time
 *                        individual iterations with µs precision.
 *   bench_pin_core(n)  → pins the WASM thread to CPU core n (Core 1).
 *
 * The WASM module's main() runs the benchmark loop and prints JSON to the
 * Zephyr console.  The native side waits for it to finish via an exit semaphore
 * then tidies up.
 *
 * wasm_claw_mpu: CONFIG_AKIRA_SANDBOX_MPU depends on ARM_MPU which is absent
 * on ESP32-S3 (Xtensa).  The WASM module detects BENCH_MPU at compile time
 * and emits mock_mode=true immediately.
 *
 * wasm_noguard: built with CONFIG_AKIRA_CAPABILITY_SYSTEM=n (prj_noguard.conf).
 * If that config is unavailable the CMakeLists falls back to reporting mock_mode.
 */

#include "bench_b1.h"
#include "timing.h"
#include "result.h"

#include <zephyr/kernel.h>
#include <zephyr/logging/log.h>
#include <string.h>

#ifdef CONFIG_AKIRA_WASM_RUNTIME
#include <wasm_export.h>
#include "runtime/akira_runtime.h"
#endif

LOG_MODULE_DECLARE(akiraclaw_bench, CONFIG_AKIRA_LOG_LEVEL);

/* ── WASM module byte-arrays (generated by `make headers`) ──────────────
 * If a header is missing the build fails with a clear message.
 * Generate with:
 *   cd AkiraSDK/wasm_apps/akiraclaw_bench && make all_variants
 */
#if defined(BENCH_WASM_VARIANT_NOGUARD)
#  include "wasm_data_noguard.h"
#  define WASM_BYTES     akiraclaw_bench_noguard_wasm
#  define WASM_LEN       akiraclaw_bench_noguard_wasm_len
#elif defined(BENCH_WASM_VARIANT_MPU)
#  include "wasm_data_mpu.h"
#  define WASM_BYTES     akiraclaw_bench_mpu_wasm
#  define WASM_LEN       akiraclaw_bench_mpu_wasm_len
#else
/* Default: wasm_claw */
#  include "wasm_data_claw.h"
#  define WASM_BYTES     akiraclaw_bench_claw_wasm
#  define WASM_LEN       akiraclaw_bench_claw_wasm_len
#endif

/* ── Exit semaphore ──────────────────────────────────────────────────── */
static K_SEM_DEFINE(g_wasm_done, 0, 1);

static void wasm_exit_cb(int slot, int exit_code)
{
    (void)slot;
    (void)exit_code;
    k_sem_give(&g_wasm_done);
}

/* ── bench_ccount_get native implementation ─────────────────────────── */
#ifdef CONFIG_SOC_SERIES_ESP32S3
static uint32_t native_bench_ccount_get(wasm_exec_env_t env)
{
    (void)env;
    uint32_t c;
    __asm__ volatile("rsr %0, CCOUNT" : "=r"(c) : : "memory");
    return c;
}
#else
static uint32_t native_bench_ccount_get(wasm_exec_env_t env)
{
    (void)env;
    return k_cycle_get_32();
}
#endif

/* ── bench_pin_core native implementation ───────────────────────────── */
static void native_bench_pin_core(wasm_exec_env_t env, int32_t core)
{
    (void)env;
#ifdef CONFIG_MP_MAX_NUM_CPUS
    if (core >= 0 && core < CONFIG_MP_MAX_NUM_CPUS) {
        k_thread_cpu_mask_clear(k_current_get());
        k_thread_cpu_mask_enable(k_current_get(), (uint8_t)core);
    }
#else
    (void)core;
#endif
}

/* ── Native symbol table (registered once before first module load) ─── */
static bool g_natives_registered = false;

static void register_bench_natives(void)
{
    if (g_natives_registered) return;

#ifdef CONFIG_AKIRA_WASM_RUNTIME
    static NativeSymbol bench_syms[] = {
        { "bench_ccount_get", native_bench_ccount_get, "()i", NULL },
        { "bench_pin_core",   native_bench_pin_core,   "(i)",  NULL },
    };
    bool ok = wasm_runtime_register_natives(
        "env", bench_syms, ARRAY_SIZE(bench_syms));
    if (!ok) {
        LOG_ERR("bench_b1_wasm: failed to register native symbols");
    }
#endif
    g_natives_registered = true;
}

/* ── Run one WASM variant ────────────────────────────────────────────── */
void bench_b1_wasm_run(const char *config)
{
#ifndef CONFIG_AKIRA_WASM_RUNTIME
    /* WASM runtime not built — emit mock */
    bench_b1_result_t r = {
        .config      = config,
        .mock_mode   = true,
        .mock_reason = "CONFIG_AKIRA_WASM_RUNTIME=n",
    };
    bench_print_b1(&r);
    return;
#else

    /* wasm_noguard requires CONFIG_AKIRA_CAPABILITY_SYSTEM=n build.
     * The prj_noguard.conf sets this; if the current build has CG enabled
     * we can still run — the WASM module has ai.infer in its manifest so
     * the check always passes.  The noguard prj disables the check entirely
     * for a true zero-overhead measurement. */
#ifdef CONFIG_AKIRA_CAPABILITY_SYSTEM
    if (strcmp(config, "wasm_noguard") == 0) {
        LOG_WRN("wasm_noguard: CG still enabled in this build "
                "(CONFIG_AKIRA_CAPABILITY_SYSTEM=y). "
                "Rebuild with prj_noguard.conf for zero-overhead baseline.");
        /* Continue anyway — results will include CG overhead (~1 inst) */
    }
#endif

    register_bench_natives();

    /* Register exit callback and reset semaphore */
    k_sem_reset(&g_wasm_done);
    akira_runtime_set_exit_callback(wasm_exit_cb);

    /* Load module — the embedded manifest is parsed here so cap_mask is set */
    int id = akira_runtime_load_wasm(WASM_BYTES, WASM_LEN);
    if (id < 0) {
        LOG_ERR("bench_b1_wasm/%s: akira_runtime_load_wasm failed: %d",
                config, id);
        bench_b1_result_t r = {
            .config      = config,
            .mock_mode   = true,
            .mock_reason = "akira_runtime_load_wasm failed",
        };
        bench_print_b1(&r);
        akira_runtime_set_exit_callback(NULL);
        return;
    }

    /* Start the WASM thread.  It runs main(), prints JSON, then exits. */
    int ret = akira_runtime_start(id);
    if (ret < 0) {
        LOG_ERR("bench_b1_wasm/%s: akira_runtime_start failed: %d",
                config, ret);
        bench_b1_result_t r = {
            .config      = config,
            .mock_mode   = true,
            .mock_reason = "akira_runtime_start failed",
        };
        bench_print_b1(&r);
        akira_runtime_set_exit_callback(NULL);
        akira_runtime_stop(id);
        return;
    }

    /* Wait for the WASM module to finish (up to 60 s for 1000 iterations) */
    ret = k_sem_take(&g_wasm_done, K_SECONDS(60));
    if (ret != 0) {
        LOG_ERR("bench_b1_wasm/%s: WASM module timed out", config);
    }

    akira_runtime_set_exit_callback(NULL);
    akira_runtime_stop(id);

    LOG_INF("bench_b1_wasm/%s: done", config);
#endif /* CONFIG_AKIRA_WASM_RUNTIME */
}
```

## src/bench_b2_mpu.c
```c
/*
 * bench_b2_mpu.c — B2: sandbox_exec_begin / sandbox_exec_end isolation cost
 *
 * Measures the overhead of the k_mem_domain add/remove pair that implements
 * per-WASM-app MPU sandboxing.  10 000 iterations, CCOUNT timing.
 *
 * ARM MPU dependency:
 *   CONFIG_AKIRA_SANDBOX_MPU=y depends on CONFIG_ARM_MPU=y, which is only
 *   available on ARM Cortex-M/A targets.  ESP32-S3 (Xtensa LX7) does not
 *   implement this Zephyr MPU backend.  On ESP32-S3 this benchmark reports
 *   mock_mode=true with the reason documented below.
 *
 *   To run B2 with real numbers, target an ARM board (e.g. nrf5340dk or
 *   stm32h7) with CONFIG_AKIRA_SANDBOX_MPU=y.
 *
 * Without MPU (CONFIG_AKIRA_SANDBOX=y but CONFIG_AKIRA_SANDBOX_MPU=n):
 *   sandbox_exec_begin/end still run — they update exec_active and the
 *   watchdog timestamp.  This sub-benchmark measures THAT baseline cost
 *   even on ESP32-S3, and separately reports the MPU increment as mock.
 */

#include "result.h"
#include "timing.h"

#include <zephyr/kernel.h>
#include <zephyr/logging/log.h>

#ifdef CONFIG_AKIRA_SANDBOX
#include "runtime/security/sandbox.h"
#include "runtime/security/trust_levels.h"
#endif

LOG_MODULE_DECLARE(akiraclaw_bench, CONFIG_AKIRA_LOG_LEVEL);

#define B2_ITERS 10000

/* Separate ns-resolution stat from timing.h's us stat */
typedef struct {
    uint32_t samples_ns[B2_ITERS];
    int      n;
    uint64_t sum_ns;
    uint32_t max_ns;
} b2_stat_t;

/* 10000 * 4 * 2 = 80 KB — place in PSRAM on ESP32-S3 */
#ifdef CONFIG_AKIRA_PSRAM
#define B2_BSS __attribute__((section(".ext_ram.bss"), aligned(4)))
#else
#define B2_BSS
#endif
static b2_stat_t g_begin_stat B2_BSS;
static b2_stat_t g_end_stat   B2_BSS;

static void b2_stat_reset(b2_stat_t *s) { s->n = 0; s->sum_ns = 0; s->max_ns = 0; }

static void b2_stat_add(b2_stat_t *s, uint32_t cycles)
{
    uint32_t ns = bench_cycles_to_ns(cycles);
    if (s->n < B2_ITERS) s->samples_ns[s->n++] = ns;
    s->sum_ns += ns;
    if (ns > s->max_ns) s->max_ns = ns;
}

static int b2_ns_cmp(const void *a, const void *b)
{
    uint32_t x = *(const uint32_t *)a;
    uint32_t y = *(const uint32_t *)b;
    return (x > y) - (x < y);
}

static uint32_t b2_stat_avg(const b2_stat_t *s)
{
    return s->n ? (uint32_t)(s->sum_ns / (uint64_t)s->n) : 0;
}

static uint32_t b2_stat_p99(b2_stat_t *s)
{
    if (s->n < 2) return s->n ? s->samples_ns[0] : 0;
    qsort(s->samples_ns, (size_t)s->n, sizeof(s->samples_ns[0]), b2_ns_cmp);
    int idx = (s->n * 99) / 100;
    if (idx >= s->n) idx = s->n - 1;
    return s->samples_ns[idx];
}

void bench_b2_run(void)
{
    bench_b2_result_t result = {
        .iterations = B2_ITERS,
        .mock_mode  = false,
        .mock_reason = NULL,
    };

#ifndef CONFIG_AKIRA_SANDBOX
    result.mock_mode   = true;
    result.mock_reason = "CONFIG_AKIRA_SANDBOX=n in this build";
    bench_print_b2(&result);
    return;
#else

    /* ── Initialise a scratch sandbox context ────────────────────────── */
    static sandbox_ctx_t ctx;
    sandbox_ctx_init(&ctx, TRUST_LEVEL_USER, 0);

#ifdef CONFIG_AKIRA_SANDBOX_MPU
    /* Provide a dummy WASM heap region for the MPU partition.
     * Must be power-of-two aligned (ARMv7-M MPU constraint). */
    static uint8_t dummy_heap[4096] __aligned(4096);
    sandbox_mpu_configure(&ctx, dummy_heap, sizeof(dummy_heap));
#endif

    /* ── Warm-up (not measured) ──────────────────────────────────────── */
    for (int i = 0; i < 50; i++) {
        sandbox_exec_begin(&ctx);
        sandbox_exec_end(&ctx);
    }

    /* ── Measure sandbox_exec_begin ─────────────────────────────────── */
    b2_stat_reset(&g_begin_stat);
    uint32_t t0, t1;

    for (int i = 0; i < B2_ITERS; i++) {
        BENCH_TS_START(t0);
        sandbox_exec_begin(&ctx);
        BENCH_TS_STOP(t1);
        b2_stat_add(&g_begin_stat, t1 - t0);

        /* Must call end to reset exec_active for the next iteration */
        sandbox_exec_end(&ctx);
    }

    /* ── Measure sandbox_exec_end ───────────────────────────────────── */
    b2_stat_reset(&g_end_stat);

    for (int i = 0; i < B2_ITERS; i++) {
        sandbox_exec_begin(&ctx);

        BENCH_TS_START(t0);
        sandbox_exec_end(&ctx);
        BENCH_TS_STOP(t1);
        b2_stat_add(&g_end_stat, t1 - t0);
    }

    result.begin_avg_ns = b2_stat_avg(&g_begin_stat);
    result.begin_p99_ns = b2_stat_p99(&g_begin_stat);
    result.begin_max_ns = g_begin_stat.max_ns;
    result.end_avg_ns   = b2_stat_avg(&g_end_stat);
    result.end_p99_ns   = b2_stat_p99(&g_end_stat);
    result.end_max_ns   = g_end_stat.max_ns;

#ifndef CONFIG_AKIRA_SANDBOX_MPU
    /* Measured the watchdog-only path.  Separately note MPU not active. */
    result.mock_mode   = true;
    result.mock_reason = "CONFIG_AKIRA_SANDBOX_MPU=n (ARM_MPU unavailable on ESP32-S3); "
                         "values reflect watchdog-timestamp path only, not k_mem_domain cost";
#endif

    bench_print_b2(&result);

    LOG_INF("B2: begin avg=%u p99=%u ns | end avg=%u p99=%u ns",
            result.begin_avg_ns, result.begin_p99_ns,
            result.end_avg_ns,   result.end_p99_ns);
#endif /* CONFIG_AKIRA_SANDBOX */
}
```

## src/bench_b3_audit.c
```c
/*
 * bench_b3_audit.c — B3: HMAC audit log write overhead
 *
 * Triggers AUDIT_EVENT_CAPABILITY_DENIED 10 000 times and measures the
 * latency from violation detected (BENCH_TS_START) to ring-buffer write
 * complete (BENCH_TS_STOP).
 *
 * Two sub-measurements:
 *   hmac_enabled=true   — CONFIG_AKIRA_AUDIT_LOG_HMAC=y (prj_hmac.conf)
 *   hmac_enabled=false  — CONFIG_AKIRA_AUDIT_LOG_HMAC=n (baseline)
 *
 * The benchmark can only measure the build it was compiled with.  Run once
 * with each prj.conf and compare audit_write_avg_ns.
 *
 * mock_mode=true is never set here — sandbox_audit_log is always available
 * when CONFIG_AKIRA_SECURITY_AUDIT=y (selected by CAPABILITY_SYSTEM).
 */

#include "result.h"
#include "timing.h"

#include <zephyr/kernel.h>
#include <zephyr/logging/log.h>

#ifdef CONFIG_AKIRA_SECURITY_AUDIT
#include "runtime/security/sandbox.h"
#endif

LOG_MODULE_DECLARE(akiraclaw_bench, CONFIG_AKIRA_LOG_LEVEL);

#define B3_ITERS 1000

typedef struct {
    uint32_t samples_ns[B3_ITERS];
    int      n;
    uint64_t sum_ns;
    uint32_t max_ns;
} b3_stat_t;

#ifdef CONFIG_AKIRA_PSRAM
#define B3_BSS __attribute__((section(".ext_ram.bss"), aligned(4)))
#else
#define B3_BSS
#endif
static b3_stat_t g_stat B3_BSS;

static void b3_stat_reset(b3_stat_t *s) { s->n = 0; s->sum_ns = 0; s->max_ns = 0; }

static void b3_stat_add(b3_stat_t *s, uint32_t cycles)
{
    uint32_t ns = bench_cycles_to_ns(cycles);
    if (s->n < B3_ITERS) s->samples_ns[s->n++] = ns;
    s->sum_ns += ns;
    if (ns > s->max_ns) s->max_ns = ns;
}

static int b3_ns_cmp(const void *a, const void *b)
{
    uint32_t x = *(const uint32_t *)a;
    uint32_t y = *(const uint32_t *)b;
    return (x > y) - (x < y);
}

static uint32_t b3_stat_avg(const b3_stat_t *s)
{
    return s->n ? (uint32_t)(s->sum_ns / (uint64_t)s->n) : 0;
}

static uint32_t b3_stat_p99(b3_stat_t *s)
{
    if (s->n < 2) return s->n ? s->samples_ns[0] : 0;
    qsort(s->samples_ns, (size_t)s->n, sizeof(s->samples_ns[0]), b3_ns_cmp);
    int idx = (s->n * 99) / 100;
    if (idx >= s->n) idx = s->n - 1;
    return s->samples_ns[idx];
}

void bench_b3_run(void)
{
    bench_b3_result_t result = {
        .iterations   = B3_ITERS,
        .mock_mode    = false,
        .mock_reason  = NULL,
    };

#ifndef CONFIG_AKIRA_SECURITY_AUDIT
    result.mock_mode   = true;
    result.mock_reason = "CONFIG_AKIRA_SECURITY_AUDIT=n; rebuild with prj_hmac.conf or prj.conf";
    bench_print_b3(&result);
    return;
#else

    /* Disable the Zephyr logger inside the measurement loop: it adds
     * non-deterministic RTT/UART latency.  LOG_MODE_DEFERRED must be set
     * in prj.conf; the backend flushes outside the measured region. */

    /* ── Warm-up ──────────────────────────────────────────────────────── */
    for (int i = 0; i < 50; i++) {
        sandbox_audit_log(AUDIT_EVENT_CAPABILITY_DENIED, "bench_warmup", 0xDEAD);
    }

    /* ── Hot loop ────────────────────────────────────────────────────── */
    b3_stat_reset(&g_stat);
    uint32_t t0, t1;

    for (int i = 0; i < B3_ITERS; i++) {
        /* Vary detail field to prevent the compiler from caching the call */
        uint32_t detail = (uint32_t)i;

        BENCH_TS_START(t0);
        sandbox_audit_log(AUDIT_EVENT_CAPABILITY_DENIED, "akiraclaw_bench", detail);
        BENCH_TS_STOP(t1);

        b3_stat_add(&g_stat, t1 - t0);
    }

    result.audit_write_avg_ns = b3_stat_avg(&g_stat);
    result.audit_write_p99_ns = b3_stat_p99(&g_stat);
    result.audit_write_max_ns = g_stat.max_ns;

    /* audit_nohmac_avg_ns: only meaningful when comparing across two builds.
     * In the HMAC build, set to 0 (the no-HMAC build populates it). */
#ifdef CONFIG_AKIRA_AUDIT_LOG_HMAC
    result.hmac_enabled      = true;
    result.audit_nohmac_avg_ns = 0; /* populate from non-HMAC build run */
#else
    result.hmac_enabled        = false;
    result.audit_nohmac_avg_ns = result.audit_write_avg_ns;
#endif

    bench_print_b3(&result);

    LOG_INF("B3: audit_write avg=%u p99=%u max=%u ns (HMAC=%s)",
            result.audit_write_avg_ns, result.audit_write_p99_ns,
            result.audit_write_max_ns,
            result.hmac_enabled ? "on" : "off");
#endif /* CONFIG_AKIRA_SECURITY_AUDIT */
}
```
