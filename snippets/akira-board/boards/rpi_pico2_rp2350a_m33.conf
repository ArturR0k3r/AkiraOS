## templates/akira-product/sample.yaml
```yaml
sample:
  name: AkiraOS product template
  description: Product firmware skeleton — vendor capability, native API and hook
tests:
  akiraos.template.akira_product:
    build_only: true
    platform_allow:
      - native_sim
    integration_platforms:
      - native_sim
    tags: akiraos module product
```

## templates/akira-product/subsys/widget/Kconfig
```kconfig
# SPDX-License-Identifier: Apache-2.0
config WIDGET
    bool "Widget product subsystem"
    depends on AKIRA_OS
    help
      Example product subsystem: a vendor capability, a vendor native API and a
      boot hook, all registered through AkiraOS extension points.
```

## tests/testcase.yaml
```yaml
tests:
  akiraos.tests:
    tags: akiraos security ota manifest lifecycle matter
    platform_allow: native_sim
    harness: ztest
    timeout: 120
    min_ram: 512
    filter: CONFIG_ZTEST
  # Release posture for apps no signature verifier has attested.
  akiraos.tests.hardened:
    tags: akiraos security
    platform_allow: native_sim
    harness: ztest
    timeout: 120
    min_ram: 512
    filter: CONFIG_ZTEST
    extra_configs:
      - CONFIG_AKIRA_HARDEN_UNATTESTED_APPS=y
```
