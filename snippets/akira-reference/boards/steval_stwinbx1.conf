## snippets/akira-reference/boards/steval_stwinbx1.conf
```kconfig
# BOARD_ZEPHYR: steval_stwinbx1
# BOARD_CHIP: stm32
# BOARD_DESC: ST STEVAL-STWINBX1

# ST STEVAL-STWINBX1 Specific Configuration
# Board: steval_stwinbx1
# SoC: STM32U585AI (ARM Cortex-M33 @ 160MHz)

# Memory Configuration
CONFIG_HEAP_MEM_POOL_SIZE=131072
CONFIG_MAIN_STACK_SIZE=4096
CONFIG_SYSTEM_WORKQUEUE_STACK_SIZE=2048

# Bluetooth (via BlueNRG-M2SA module on SPI3)
# BT_SPI is auto-selected based on devicetree hci_spi node
CONFIG_BT=y
CONFIG_BT_HCI=y
CONFIG_BT_HCI_VS=y
CONFIG_BT_BLUENRG_ACI=y
CONFIG_BT_PERIPHERAL=y
CONFIG_BT_DEVICE_NAME="AkiraOS-STWINBX1"

# GPIO and basic peripherals
# (CONFIG_GPIO, CONFIG_I2C, CONFIG_SPI, CONFIG_SENSOR are set in prj.conf)

# Individual sensor drivers (STWINBX1-specific)
# Temperature
CONFIG_STTS22H=y

# IMU - 6-axis accelerometer/gyroscope with ML Core
CONFIG_ISM330DHCX=y
CONFIG_ISM330DHCX_TRIGGER_GLOBAL_THREAD=y

# Accelerometer
CONFIG_IIS2DLPC=y
CONFIG_IIS2DLPC_TRIGGER_GLOBAL_THREAD=y

# Inclinometer with ML Core
CONFIG_IIS2ICLX=y

# Magnetometer
CONFIG_IIS2MDC=y
CONFIG_IIS2MDC_TRIGGER_GLOBAL_THREAD=y

# Pressure sensor
# CONFIG_LPS22DF=y  # Use ILPS22QS if available

# ADC
CONFIG_ADC=y

# DAC - Disabled to save flash
# CONFIG_DAC=y

# PWM
CONFIG_PWM=y

# USB (Type-C) — board DTS defines zephyr_udc0 so use the new USB Device Stack Next
# (using legacy USB_DEVICE_STACK together with NEXT causes duplicate symbol errors)
CONFIG_USB_DEVICE_STACK=n
CONFIG_USB_DEVICE_STACK_NEXT=y
CONFIG_USBD_CDC_ACM_CLASS=y
CONFIG_UART_LINE_CTRL=y

# Disable WiFi (no WiFi hardware on STM32)
CONFIG_WIFI=n

# Flash storage — board-specific NVS and Settings in addition to prj.conf flash
CONFIG_SDMMC_STACK=y
CONFIG_NVS=y

# File System (board override: FAT for SD card only — prj.conf has both FAT+LittleFS)
CONFIG_FILE_SYSTEM_LITTLEFS=y

# Settings storage
CONFIG_SETTINGS=y
CONFIG_SETTINGS_NVS=y

# CAN FD - Disabled to save flash
# CONFIG_CAN=y
# CONFIG_CAN_FD_MODE=y

# Watchdog
CONFIG_WATCHDOG=y
CONFIG_AKIRA_WDT=y
CONFIG_AKIRA_WASM_WDT=y

# ADC — WASM API (CONFIG_ADC=y already set above)
CONFIG_AKIRA_WASM_ADC=y
CONFIG_AKIRA_WASM_ADC_VREF_MV=3300
CONFIG_AKIRA_WASM_ADC_RESOLUTION=12

# RTC - disabled until clock source is properly configured in overlay
# CONFIG_RTC=y

# Power Management
CONFIG_PM=y
CONFIG_PM_DEVICE=y


# Crypto — MbedTLS already in prj.conf; no board-specific additions needed.


# Logging — reduced level to save flash (overrides prj.conf default=3)
CONFIG_LOG_DEFAULT_LEVEL=2

# Shell
CONFIG_SHELL_MINIMAL=y
CONFIG_SHELL_BACKEND_TELNET=n
CONFIG_SHELL_TELNET_SUPPORT_COMMAND=n
CONFIG_NET_SOCKETS_OFFLOAD=n

# Size optimizations for flash-constrained MCUboot slot
CONFIG_SIZE_OPTIMIZATIONS=y
CONFIG_LOG_MODE_MINIMAL=y

###############################################################################
# App Manager
###############################################################################
# (CONFIG_AKIRA_APP_MANAGER is enabled in prj.conf)

# NOTE: WAMR optimizations (mini loader, minimal mode) are controlled by
# the WAMR CMake build configuration, not Kconfig options.

# Network socket service stack - increased for OTA and upload operations
CONFIG_NET_SOCKETS_SERVICE_STACK_SIZE=4096

# MCUboot signing key for imgtool (STM32 boards sign images via Zephyr's imgtool)
CONFIG_MCUBOOT_SIGNATURE_KEY_FILE="bootloader/mcuboot/root-rsa-2048.pem"
```
