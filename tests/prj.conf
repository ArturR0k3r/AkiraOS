## CMakeLists.txt
```
# SPDX-License-Identifier: Apache-2.0

cmake_minimum_required(VERSION 3.20.0)

# Make AkiraOS board and DTS roots available
list(APPEND BOARD_ROOT ${CMAKE_CURRENT_LIST_DIR}/..)
list(APPEND DTS_ROOT   ${CMAKE_CURRENT_LIST_DIR}/..)

# The suite compiles the sources under test directly (below), so the akira-os
# module must not also build its libraries into this image.
set(AKIRA_OS_BUILD_LIBRARIES OFF)

find_package(Zephyr REQUIRED HINTS $ENV{ZEPHYR_BASE})
project(akiraos_tests)

# ── Include paths ──────────────────────────────────────────────────────────────
set(AKIRA_SRC ${CMAKE_CURRENT_LIST_DIR}/../src)
set(AKIRA_INC ${CMAKE_CURRENT_LIST_DIR}/../include)

target_include_directories(app PRIVATE
    ${AKIRA_SRC}
    ${AKIRA_SRC}/runtime
    ${AKIRA_SRC}/runtime/security
    ${AKIRA_SRC}/runtime/app_manager
    ${AKIRA_SRC}/connectivity
    ${AKIRA_SRC}/connectivity/ota
    ${AKIRA_SRC}/connectivity/matter
    ${AKIRA_SRC}/connectivity/mqtt
    ${AKIRA_INC}
    ${CMAKE_CURRENT_LIST_DIR}/../AkiraSDK/include
    ${CMAKE_CURRENT_LIST_DIR}/stubs
)

# ── Source files under test ────────────────────────────────────────────────────
target_sources(app PRIVATE
    # Sources under test
    ${AKIRA_SRC}/runtime/manifest_parser.c
    ${AKIRA_SRC}/runtime/akira_abi_check.c
    ${AKIRA_SRC}/runtime/security.c
    ${AKIRA_SRC}/runtime/security/app_signing_v2.c
    ${AKIRA_SRC}/runtime/security/sandbox.c
    ${AKIRA_SRC}/connectivity/ota/ota_manager.c
    ${AKIRA_SRC}/runtime/akira_boot_guard.c
    ${AKIRA_SRC}/runtime/akira_hooks.c

    # Stubs
    stubs/stub_mcuboot.c
    stubs/stub_settings.c

    # Matter accessory path + in-firmware mock co-processor
    ${AKIRA_SRC}/runtime/akira_matter_ipc.c
    ${AKIRA_SRC}/connectivity/matter/matter_coproc_mock.c

    # Home Assistant discovery JSON helpers (transport stubbed in the test)
    ${AKIRA_SRC}/connectivity/mqtt/ha_discovery.c

    # Test suites
    src/test_manifest_parser.c
    src/test_security.c
    src/test_app_lifecycle.c
    src/test_ota_state.c
    src/test_boot_guard.c
    src/test_matter_accessory.c
    src/test_mqtt_ha.c
    src/test_display_clip.c
)

# The Matter accessory sources are normally gated by Kconfig symbols whose
# dependency chain (AKIRA_MATTER -> AKIRA_RADIO_MANAGER, SERIAL, ...) is not
# satisfiable on native_sim. Define the two relevant switches directly so the
# accessory path + mock compile against the flat test build (same technique as
# the CONFIG_BOOTLOADER_MCUBOOT define below). The mock replaces the UART, so
# no serial hardware is required.
target_compile_definitions(app PRIVATE
    CONFIG_AKIRA_MATTER_ACCESSORY=1
    CONFIG_AKIRA_MATTER_COPROC_MOCK=1
)

# ota_manager.c guards its flash_area and mcuboot includes behind:
#   #if defined(CONFIG_FLASH_MAP) && defined(CONFIG_BOOTLOADER_MCUBOOT)
# CONFIG_FLASH_MAP=y is set in prj.conf (flash simulator), but
# CONFIG_BOOTLOADER_MCUBOOT cannot be set via Kconfig on native_sim (it would
# select USE_DT_CODE_PARTITION which has unsatisfied SOC dependencies).
# Setting it as a per-file compile definition bypasses Kconfig entirely so
# ota_manager.c compiles with OTA_FLASH_AVAILABLE=1.  The boot_request_upgrade /
# boot_write_img_confirmed symbols are satisfied by stubs/stub_mcuboot.c.
set_source_files_properties(
    ${AKIRA_SRC}/connectivity/ota/ota_manager.c
    src/test_ota_state.c
    PROPERTIES COMPILE_DEFINITIONS
    "CONFIG_BOOTLOADER_MCUBOOT=1;CONFIG_AKIRA_BOOT_GUARD=1;CONFIG_AKIRA_OTA_REFUSE_DOWNGRADE=1"
)

# CONFIG_AKIRA_BOOT_GUARD depends on MCUBOOT_IMG_MANAGER, unavailable here for
# the same reason, so the boot guard gets its symbols the same way. The short
# confirm delay keeps the BOOT_READY auto-confirm test fast.
set_source_files_properties(
    ${AKIRA_SRC}/runtime/akira_boot_guard.c
    src/test_boot_guard.c
    PROPERTIES COMPILE_DEFINITIONS
    "CONFIG_AKIRA_BOOT_GUARD=1;CONFIG_AKIRA_BOOT_GUARD_CONFIRM_DELAY_S=1;CONFIG_AKIRA_BOOT_GUARD_TRIAL_TIMEOUT_S=300;CONFIG_AKIRA_BOOT_GUARD_INIT_PRIORITY=60"
)
```

## Kconfig
```
# SPDX-License-Identifier: Apache-2.0
#
# Test-scope Kconfig for the AkiraOS ztest suite.
#
# Zephyr's kconfig.cmake auto-discovers this file via APPLICATION_SOURCE_DIR.
# The AkiraOS symbols come from the akira-os module (zephyr/Kconfig) and are
# enabled by CONFIG_AKIRA_OS=y in prj.conf.

source "Kconfig.zephyr"
```

## prj.conf
```kconfig
# ── Zephyr test framework ──────────────────────────────────────────────────────
CONFIG_ZTEST=y
# CONFIG_ZTEST_NEW_API does not exist in Zephyr v4; new API is always on

# ── Coverage (gcov) ────────────────────────────────────────────────────────────
CONFIG_COVERAGE=y
CONFIG_COVERAGE_GCOV=y

# ── libc ───────────────────────────────────────────────────────────────────────
CONFIG_NEWLIB_LIBC=y
CONFIG_PICOLIBC=n
CONFIG_EXTERNAL_LIBC=n

# ── Logging ────────────────────────────────────────────────────────────────────
CONFIG_LOG=y
CONFIG_LOG_DEFAULT_LEVEL=2

# ── Kernel / heap ──────────────────────────────────────────────────────────────
CONFIG_HEAP_MEM_POOL_SIZE=65536
CONFIG_MAIN_STACK_SIZE=4096

# ── AkiraOS config ─────────────────────────────────────────────────────────────
CONFIG_AKIRA_OS=y
CONFIG_AKIRA_LOG_LEVEL=2
CONFIG_AKIRA_WASM_RUNTIME=n
CONFIG_AKIRA_AUDIT_LOG_SIZE=16
CONFIG_AKIRA_SANDBOX_EXEC_TIMEOUT_MS=5000
CONFIG_AKIRA_APP_SIGNING=n

# ── Crypto (for app_signing tests) ────────────────────────────────────────────
CONFIG_MBEDTLS=y
CONFIG_MBEDTLS_BUILTIN=y
CONFIG_MBEDTLS_SHA256=y
# Disable the smaller-footprint SHA-256 implementation — it produces wrong
# results on native_sim (at least with Zephyr v4.3.0 / mbedTLS 3.x builtin).
# The standard implementation is slightly larger but correct.
CONFIG_MBEDTLS_SHA256_SMALLER=n

# ── Flash + OTA ────────────────────────────────────────────────────────────────
CONFIG_FLASH=y
CONFIG_FLASH_MAP=y
CONFIG_FLASH_SIMULATOR=y
CONFIG_FLASH_SIMULATOR_DOUBLE_WRITES=y
# sys_reboot() for the OTA rollback and boot-guard paths
CONFIG_REBOOT=y

# Do NOT enable CONFIG_BOOTLOADER_MCUBOOT — it selects USE_DT_CODE_PARTITION
# which has unsatisfied dependencies on native_sim.  Without it,
# ota_manager.c compiles with OTA_FLASH_AVAILABLE=0, and the OTA ztest cases
# that require a live flash path call ztest_test_skip() gracefully.

# ── Disable hardware not present on native_sim ─────────────────────────────────
CONFIG_GPIO=n
CONFIG_SPI=n
CONFIG_I2C=n
CONFIG_DISPLAY=n
CONFIG_WIFI=n
CONFIG_BT=n
CONFIG_USB_DEVICE_STACK=n
CONFIG_AKIRA_USB_HID=n
CONFIG_SENSOR=n

# ── Networking (not needed for tests) ─────────────────────────────────────────
CONFIG_NETWORKING=n

# ── Matter accessory IPC (mock co-processor) ──────────────────────────────────
# crc16_reflect() is used by the IPC framing + mock responder.
CONFIG_CRC=y
```

## src/test_boot_guard.c
```c
/*
 * test_boot_guard.c
 * ztest suite: boot_guard
 *
 * Tests for src/runtime/akira_boot_guard.c: trial-boot detection, confirmation
 * (manual and after BOOT_READY), and rollback detection on the next boot.
 *
 * MCUboot is simulated by stubs/stub_mcuboot.c (image confirmed flag and slot
 * headers), settings by stubs/stub_settings.c. The deadline reboot and
 * akira_boot_guard_reject() are not exercised: sys_reboot() ends native_sim.
 */

#include <zephyr/ztest.h>
#include <zephyr/dfu/mcuboot.h>
#include <errno.h>
#include <string.h>

#include <akira_boot_guard.h>
#include <akira_hooks.h>
#include "settings/settings.h"
#include "ota/ota_manager.h"

/* Exported by stubs/stub_mcuboot.c */
extern int stub_boot_request_upgrade_rc;
extern int stub_boot_write_img_confirmed_rc;
extern int stub_boot_write_img_confirmed_calls;
extern bool stub_boot_img_confirmed;
extern struct mcuboot_img_header stub_slot0_header;
extern struct mcuboot_img_header stub_slot1_header;

#define TRIAL_KEY "ota/trial"

static int confirmed_events;
static int rollback_events;
static int rollback_error;

static void on_ota_event(const struct akira_hook_event *event, void *user_data)
{
    ARG_UNUSED(user_data);

    if (event->type == AKIRA_HOOK_OTA_CONFIRMED) {
        confirmed_events++;
    } else if (event->type == AKIRA_HOOK_OTA_ERROR) {
        rollback_events++;
        rollback_error = event->ota.error;
    }
}

AKIRA_HOOK_DEFINE(test_boot_guard_hook,
                  AKIRA_HOOK_MASK(AKIRA_HOOK_OTA_CONFIRMED) |
                      AKIRA_HOOK_MASK(AKIRA_HOOK_OTA_ERROR),
                  on_ota_event, NULL);

static void set_slot0(uint8_t major, uint8_t minor, uint32_t size)
{
    memset(&stub_slot0_header, 0, sizeof(stub_slot0_header));
    stub_slot0_header.mcuboot_version = 1;
    stub_slot0_header.h.v1.image_size = size;
    stub_slot0_header.h.v1.sem_ver.major = major;
    stub_slot0_header.h.v1.sem_ver.minor = minor;
}

static void emit_boot_ready(void)
{
    struct akira_hook_event evt = { .type = AKIRA_HOOK_BOOT_READY };

    akira_hooks_emit(&evt);
}

static void guard_before(void *arg)
{
    ARG_UNUSED(arg);

    stub_boot_request_upgrade_rc = 0;
    stub_boot_write_img_confirmed_rc = 0;
    stub_boot_write_img_confirmed_calls = 0;
    stub_boot_img_confirmed = true;
    set_slot0(1, 6, 1000);
    memset(&stub_slot1_header, 0, sizeof(stub_slot1_header));
    (void)akira_settings_delete(TRIAL_KEY);
    confirmed_events = 0;
    rollback_events = 0;
    rollback_error = 0;
}

static void guard_after(void *arg)
{
    ARG_UNUSED(arg);

    /* Never leave a trial (and its deadline timer) running between tests. */
    stub_boot_write_img_confirmed_rc = 0;
    (void)akira_boot_guard_confirm();
}

ZTEST(boot_guard, test_confirmed_image_is_not_a_trial)
{
    zassert_ok(akira_boot_guard_init());
    zassert_false(akira_boot_guard_is_trial());
    zassert_false(akira_boot_guard_rolled_back());
    zassert_ok(akira_boot_guard_confirm(), "confirming a confirmed image is a no-op");
    zassert_equal(stub_boot_write_img_confirmed_calls, 0);
}

ZTEST(boot_guard, test_unconfirmed_image_starts_trial_and_records_it)
{
    char rec[64];

    stub_boot_img_confirmed = false;
    zassert_ok(akira_boot_guard_init());
    zassert_true(akira_boot_guard_is_trial());
    zassert_ok(akira_settings_get(TRIAL_KEY, rec, sizeof(rec)));
    zassert_str_equal(rec, "1.6.0+0/1000");
}

ZTEST(boot_guard, test_confirm_ends_trial)
{
    char rec[64];

    stub_boot_img_confirmed = false;
    zassert_ok(akira_boot_guard_init());
    zassert_ok(akira_boot_guard_confirm());

    zassert_false(akira_boot_guard_is_trial());
    zassert_equal(stub_boot_write_img_confirmed_calls, 1);
    zassert_equal(confirmed_events, 1);
    zassert_equal(akira_settings_get(TRIAL_KEY, rec, sizeof(rec)), -ENOENT,
                  "trial record must be cleared once confirmed");
}

ZTEST(boot_guard, test_failed_confirm_keeps_trial)
{
    stub_boot_img_confirmed = false;
    zassert_ok(akira_boot_guard_init());

    stub_boot_write_img_confirmed_rc = -EIO;
    zassert_equal(akira_boot_guard_confirm(), -EIO);
    zassert_true(akira_boot_guard_is_trial());
    zassert_equal(confirmed_events, 0);
}

ZTEST(boot_guard, test_ota_confirm_firmware_goes_through_guard)
{
    char rec[64];

    stub_boot_img_confirmed = false;
    zassert_ok(akira_boot_guard_init());

    /* Shell "ota confirm" and WASM ota_confirm() must end the trial too,
     * not just set the MCUboot flag behind the guard's back. */
    zassert_equal(ota_confirm_firmware(), OTA_OK);
    zassert_false(akira_boot_guard_is_trial());
    zassert_equal(confirmed_events, 1);
    zassert_equal(akira_settings_get(TRIAL_KEY, rec, sizeof(rec)), -ENOENT);
}

ZTEST(boot_guard, test_boot_ready_confirms_after_delay)
{
    stub_boot_img_confirmed = false;
    zassert_ok(akira_boot_guard_init());

    emit_boot_ready();
    zassert_true(akira_boot_guard_is_trial(), "must not confirm before the delay");

    k_sleep(K_SECONDS(CONFIG_AKIRA_BOOT_GUARD_CONFIRM_DELAY_S + 1));
    zassert_false(akira_boot_guard_is_trial());
    zassert_equal(stub_boot_write_img_confirmed_calls, 1);
}

ZTEST(boot_guard, test_rollback_detected_on_next_boot)
{
    char rec[64];

    /* Boot 1: 1.7 trial starts, then "crashes" before confirming. */
    set_slot0(1, 7, 2000);
    stub_boot_img_confirmed = false;
    zassert_ok(akira_boot_guard_init());

    /* Boot 2: MCUboot restored the confirmed 1.6 image. */
    set_slot0(1, 6, 1000);
    stub_boot_img_confirmed = true;
    zassert_ok(akira_boot_guard_init());

    zassert_false(akira_boot_guard_is_trial());
    zassert_true(akira_boot_guard_rolled_back());
    zassert_equal(akira_settings_get(TRIAL_KEY, rec, sizeof(rec)), -ENOENT);

    emit_boot_ready();
    zassert_equal(rollback_events, 1);
    zassert_equal(rollback_error, -ECANCELED);
}

ZTEST(boot_guard, test_trial_confirmed_elsewhere_is_not_a_rollback)
{
    /* The trial image got confirmed without the guard (e.g. mcumgr), so the
     * record survived but the same image is running. */
    stub_boot_img_confirmed = false;
    zassert_ok(akira_boot_guard_init());

    stub_boot_img_confirmed = true;
    zassert_ok(akira_boot_guard_init());

    zassert_false(akira_boot_guard_rolled_back());
    emit_boot_ready();
    zassert_equal(rollback_events, 0);
}

ZTEST(boot_guard, test_manual_rollback_refused_without_previous_image)
{
    /* Confirmed image and an empty secondary slot (e.g. the failed image was
     * discarded after an automatic rollback): nothing to go back to, and no
     * reboot may be scheduled. */
    zassert_ok(akira_boot_guard_init());
    zassert_equal(ota_request_rollback(), OTA_ERROR_INVALID_IMAGE);
}

ZTEST_SUITE(boot_guard, NULL, NULL, guard_before, guard_after, NULL);
```

## src/test_catalog_net.c
```c
/*
 * Copyright (c) 2026 PenEngineering S.R.L
 * SPDX-License-Identifier: GPL-3.0-only
 */

#include <zephyr/ztest.h>
#include <string.h>
#include "catalog_net.h"

ZTEST_SUITE(catalog_net, NULL, NULL, NULL, NULL, NULL);

ZTEST(catalog_net, test_init_sets_capacity)
{
    uint8_t buf[64];
    catalog_ring_init(buf, sizeof(buf));

    uint32_t write_idx, read_idx, capacity, flags;
    memcpy(&write_idx, buf + 0, 4);
    memcpy(&read_idx, buf + 4, 4);
    memcpy(&capacity, buf + 8, 4);
    memcpy(&flags, buf + 12, 4);

    zassert_equal(write_idx, 0, "write_idx must start at 0");
    zassert_equal(read_idx, 0, "read_idx must start at 0");
    zassert_equal(capacity, sizeof(buf) - CATALOG_NET_RING_HDR_SIZE, "capacity is buffer size minus header");
    zassert_equal(flags, 0, "flags must be 0");
}

ZTEST(catalog_net, test_write_then_read_roundtrip)
{
    uint8_t buf[64];
    catalog_ring_init(buf, sizeof(buf));

    const uint8_t msg[] = "GET /catalogue.json";
    int ret = catalog_ring_write(buf, msg, sizeof(msg));
    zassert_equal(ret, 0, "write should succeed");

    uint8_t out[64];
    int n = catalog_ring_read(buf, out, sizeof(out));
    zassert_equal(n, sizeof(msg), "read should return the written length");
    zassert_mem_equal(out, msg, sizeof(msg), "read payload must match written payload");
}

ZTEST(catalog_net, test_read_empty_ring_returns_enodata)
{
    uint8_t buf[64];
    catalog_ring_init(buf, sizeof(buf));

    uint8_t out[64];
    int n = catalog_ring_read(buf, out, sizeof(out));
    zassert_equal(n, -ENODATA, "reading an empty ring must return -ENODATA");
}

ZTEST(catalog_net, test_write_too_large_returns_enospc)
{
    uint8_t buf[32]; /* capacity = 32 - 16 = 16 bytes of data area */
    catalog_ring_init(buf, sizeof(buf));

    uint8_t msg[20]; /* larger than the 16-byte data area even before framing overhead */
    memset(msg, 'A', sizeof(msg));
    int ret = catalog_ring_write(buf, msg, sizeof(msg));
    zassert_equal(ret, -ENOSPC, "oversized write must return -ENOSPC");
}

ZTEST(catalog_net, test_wraparound_roundtrip)
{
    uint8_t buf[32]; /* small ring to force wraparound: 32 - 16 = 16-byte data area */
    catalog_ring_init(buf, sizeof(buf));

    const uint8_t msg1[] = "abc";  /* 2-byte len prefix + 4 bytes = 6 bytes */
    const uint8_t msg2[] = "de";   /* 2-byte len prefix + 3 bytes = 5 bytes */

    zassert_equal(catalog_ring_write(buf, msg1, sizeof(msg1)), 0, "first write");
    uint8_t out[16];
    zassert_equal(catalog_ring_read(buf, out, sizeof(out)), sizeof(msg1), "first read");

    /* Second write should wrap past the end of the 16-byte data area */
    zassert_equal(catalog_ring_write(buf, msg2, sizeof(msg2)), 0, "second write (wraps)");
    int n = catalog_ring_read(buf, out, sizeof(out));
    zassert_equal(n, sizeof(msg2), "second read after wraparound");
    zassert_mem_equal(out, msg2, sizeof(msg2), "wrapped payload must match");
}
```

## src/test_catalogue_parser.c
```c
/*
 * Copyright (c) 2026 PenEngineering S.R.L
 * SPDX-License-Identifier: GPL-3.0-only
 */

#include <zephyr/ztest.h>
#include <string.h>
#include "catalogue_parser.h"

ZTEST_SUITE(catalogue_parser, NULL, NULL, NULL, NULL, NULL);

ZTEST(catalogue_parser, test_parses_two_apps)
{
    const char *json =
        "{"
        "\"generated_at\":\"2026-09-10T00:00:00Z\","
        "\"tag\":\"v1.2.3\","
        "\"apps\":["
        "{\"id\":\"console_apps/badge\",\"name\":\"badge\",\"display_name\":\"Akira Badge\","
        "\"category\":\"console_apps\",\"version\":\"1.1.0\",\"size_bytes\":4096,"
        "\"capabilities\":[\"display.write\"],\"min_akiraos_version\":\"1.5.0\","
        "\"download_url\":\"https://github.com/ArturR0k3r/AkiraSDK/releases/download/v1.2.3/console_apps-badge.akpkg\","
        "\"icon_url\":null},"
        "{\"id\":\"console_apps/level_tool\",\"name\":\"level_tool\",\"display_name\":\"Level Tool\","
        "\"category\":\"console_apps\",\"version\":\"1.0.0\",\"size_bytes\":2048,"
        "\"capabilities\":[],\"min_akiraos_version\":\"1.5.0\","
        "\"download_url\":\"https://github.com/ArturR0k3r/AkiraSDK/releases/download/v1.2.3/console_apps-level_tool.akpkg\","
        "\"icon_url\":null}"
        "]}";

    catalogue_entry_t entries[8];
    int n = catalogue_parse(json, strlen(json), entries, 8);

    zassert_equal(n, 2, "should parse both apps");
    zassert_str_equal(entries[0].name, "badge", "first app name");
    zassert_str_equal(entries[0].version, "1.1.0", "first app version");
    zassert_str_equal(entries[0].download_url,
        "https://github.com/ArturR0k3r/AkiraSDK/releases/download/v1.2.3/console_apps-badge.akpkg",
        "first app download_url");
    zassert_str_equal(entries[1].name, "level_tool", "second app name");
}

ZTEST(catalogue_parser, test_empty_apps_array)
{
    const char *json = "{\"generated_at\":\"x\",\"tag\":\"v1\",\"apps\":[]}";
    catalogue_entry_t entries[8];
    int n = catalogue_parse(json, strlen(json), entries, 8);
    zassert_equal(n, 0, "empty apps array parses to zero entries");
}

ZTEST(catalogue_parser, test_missing_apps_key_is_error)
{
    const char *json = "{\"generated_at\":\"x\",\"tag\":\"v1\"}";
    catalogue_entry_t entries[8];
    int n = catalogue_parse(json, strlen(json), entries, 8);
    zassert_true(n < 0, "missing apps array must return negative errno");
}

ZTEST(catalogue_parser, test_caps_at_max_entries)
{
    /* 3 apps in the JSON, but caller only has room for 2 */
    const char *json =
        "{\"apps\":["
        "{\"name\":\"a\",\"version\":\"1.0.0\",\"download_url\":\"http://x/a\"},"
        "{\"name\":\"b\",\"version\":\"1.0.0\",\"download_url\":\"http://x/b\"},"
        "{\"name\":\"c\",\"version\":\"1.0.0\",\"download_url\":\"http://x/c\"}"
        "]}";
    catalogue_entry_t entries[2];
    int n = catalogue_parse(json, strlen(json), entries, 2);
    zassert_equal(n, 2, "must cap at max_entries, not overflow the array");
}

ZTEST(catalogue_parser, test_malformed_entry_is_skipped_not_fatal)
{
    /* second entry has no closing brace before the array closes -> skip it, keep first and third */
    const char *json =
        "{\"apps\":["
        "{\"name\":\"a\",\"version\":\"1.0.0\",\"download_url\":\"http://x/a\"},"
        "{\"name\":\"b\",\"version\":\"1.0.0\","
        "{\"name\":\"c\",\"version\":\"1.0.0\",\"download_url\":\"http://x/c\"}"
        "]}";
    catalogue_entry_t entries[8];
    int n = catalogue_parse(json, strlen(json), entries, 8);
    zassert_true(n >= 1, "at least the well-formed first entry must parse");
    zassert_str_equal(entries[0].name, "a", "first entry still parses despite a later malformed one");
}

ZTEST(catalogue_parser, test_parses_tags_and_thumbnail)
{
    const char *json =
        "{\"apps\":["
        "{\"name\":\"tetris\",\"version\":\"1.0.0\",\"download_url\":\"http://x/t\","
        "\"tags\":[\"NES\",\"PUZZLE\",\"UNKNOWN_TAG\"],"
        "\"thumbnail_url\":\"https://console.app.akiraos.dev/catalog/thumbnails/retro-tetris.bin\"}"
        "]}";
    catalogue_entry_t entries[8];
    int n = catalogue_parse(json, strlen(json), entries, 8);

    zassert_equal(n, 1, "single app parses");
    zassert_equal(entries[0].tag_mask, CATALOGUE_TAG_NES | CATALOGUE_TAG_PUZZLE,
        "unrecognized tag is ignored, recognized tags set their bit");
    zassert_str_equal(entries[0].thumbnail_url,
        "https://console.app.akiraos.dev/catalog/thumbnails/retro-tetris.bin",
        "thumbnail_url parsed");
}

ZTEST(catalogue_parser, test_missing_tags_and_thumbnail_default_empty)
{
    const char *json =
        "{\"apps\":["
        "{\"name\":\"a\",\"version\":\"1.0.0\",\"download_url\":\"http://x/a\"}"
        "]}";
    catalogue_entry_t entries[8];
    int n = catalogue_parse(json, strlen(json), entries, 8);

    zassert_equal(n, 1, "single app parses");
    zassert_equal(entries[0].tag_mask, 0, "no tags key -> empty mask");
    zassert_str_equal(entries[0].thumbnail_url, "", "no thumbnail_url key -> empty string");
}
```

## src/test_companion_fs_util.c
```c
/*
 * SPDX-License-Identifier: GPL-3.0-only
 */
#include <zephyr/ztest.h>
#include <string.h>
#include "bluetooth/companion_fs_util.h"

ZTEST_SUITE(companion_fs_util, NULL, NULL, NULL, NULL, NULL);

ZTEST(companion_fs_util, test_path_accepts_sd)
{
    zassert_true(comp_fs_path_ok("/SD:"));
    zassert_true(comp_fs_path_ok("/SD:/"));
    zassert_true(comp_fs_path_ok("/SD:/apps/a.wasm"));
    zassert_true(comp_fs_path_ok("/SD:/a..b"));
    zassert_true(comp_fs_path_ok("/SD:/.../x"));
}

ZTEST(companion_fs_util, test_path_rejects)
{
    zassert_false(comp_fs_path_ok(NULL));
    zassert_false(comp_fs_path_ok(""));
    zassert_false(comp_fs_path_ok("/lfs/x"));
    zassert_false(comp_fs_path_ok("/SD:x"));
    zassert_false(comp_fs_path_ok("/SDX:/x"));
    zassert_false(comp_fs_path_ok("/SD:/.."));
    zassert_false(comp_fs_path_ok("/SD:/a/../b"));
    zassert_false(comp_fs_path_ok("/SD:/a/.."));
    zassert_false(comp_fs_path_ok("/SD:/a\"b"));
    zassert_false(comp_fs_path_ok("/SD:/a\\b"));
}

ZTEST(companion_fs_util, test_path_length_limit)
{
    char p[100];
    memset(p, 'a', sizeof(p));
    memcpy(p, "/SD:/", 5);
    p[COMP_FS_PATH_MAX - 1] = '\0';   /* 79 chars: ok */
    zassert_true(comp_fs_path_ok(p));
    p[COMP_FS_PATH_MAX - 1] = 'a';
    p[COMP_FS_PATH_MAX] = '\0';       /* 80 chars: too long */
    zassert_false(comp_fs_path_ok(p));
}

ZTEST(companion_fs_util, test_mutable_excludes_root)
{
    zassert_false(comp_fs_path_mutable_ok("/SD:"));
    zassert_false(comp_fs_path_mutable_ok("/SD:/"));
    zassert_true(comp_fs_path_mutable_ok("/SD:/x"));
    zassert_false(comp_fs_path_mutable_ok("/lfs/x"));
}

ZTEST(companion_fs_util, test_tmp_path)
{
    char out[COMP_FS_PATH_MAX];
    zassert_equal(comp_fs_tmp_path("/SD:/a.txt", out, sizeof(out)), 0);
    zassert_str_equal(out, "/SD:/a.txt.tmp");
    char small[8];
    zassert_equal(comp_fs_tmp_path("/SD:/a.txt", small, sizeof(small)), -ENAMETOOLONG);
}

ZTEST(companion_fs_util, test_fmt_entry)
{
    char out[96];
    int n = comp_fs_fmt_entry(out, sizeof(out), "a.txt", false, 12);
    zassert_equal(n, (int)strlen(out));
    zassert_str_equal(out, "{\"name\":\"a.txt\",\"type\":\"file\",\"size\":12}");
    zassert_true(comp_fs_fmt_entry(out, 10, "a.txt", false, 12) < 0);
    n = comp_fs_fmt_entry(out, sizeof(out), "d", true, 0);
    zassert_str_equal(out, "{\"name\":\"d\",\"type\":\"dir\",\"size\":0}");
}
```

## src/test_display_clip.c
```c
/*
 * Copyright (c) 2026 PenEngineering S.R.L
 * SPDX-License-Identifier: Apache-2.0
 */

/**
 * @file test_display_clip.c
 * @brief Regression tests for akira_display_clip_rect().
 *
 * Guards the fix for the out-of-bounds write in akira_display_bitmap(): the
 * clipped span was computed but never checked for being empty, so a fully
 * off-screen rectangle produced a negative span which, cast to size_t, became a
 * ~4 GB memcpy into the framebuffer.  Coordinates reach that code as
 * attacker-controlled int32_t from any WASM app holding display.write.
 *
 * The vulnerable code lives behind #if !AKIRA_PLATFORM_NATIVE_SIM, so it cannot
 * be driven directly from a native_sim ztest.  Testing the shared clip helper
 * instead is what makes the guard reachable here — which is the main reason the
 * clip logic was extracted rather than patched in place.
 *
 * Two properties matter and pull in opposite directions:
 *   1. fully off-screen / degenerate  -> false (draw nothing)
 *   2. PARTIALLY off-screen           -> true, with clipped bounds
 * Getting (1) by rejecting all negative coordinates would break (2), which is
 * legitimate and relied upon by callers drawing sprites that hang off an edge.
 */

#include <zephyr/ztest.h>
#include <stdint.h>

#include <api/display_clip.h>

/* AkiraConsole Production panel. */
#define XRES 320
#define YRES 240

ZTEST_SUITE(display_clip, NULL, NULL, NULL, NULL, NULL);

/* ------------------------------------------------------------------ */
/* Fully clipped — the cases that caused the OOB write                  */
/* ------------------------------------------------------------------ */

/* The primary trigger. Note x is POSITIVE: a fix that only rejected negative
 * coordinates would leave this exploitable.
 * Pre-fix: x1 = 400, x2 = 320, span = -80 -> (size_t)(-80) * 2 byte memcpy. */
ZTEST(display_clip, test_reject_beyond_right_edge)
{
    int x1, y1, x2, y2;

    zassert_false(akira_display_clip_rect(400, 0, 10, 10, XRES, YRES,
                                          &x1, &y1, &x2, &y2),
                  "rect starting past the right edge must be fully clipped");
}

/* Pre-fix: x1 = 0, x2 = -50, span = -50. */
ZTEST(display_clip, test_reject_beyond_left_edge)
{
    int x1, y1, x2, y2;

    zassert_false(akira_display_clip_rect(-100, 0, 50, 10, XRES, YRES,
                                          &x1, &y1, &x2, &y2),
                  "rect ending before the left edge must be fully clipped");
}

ZTEST(display_clip, test_reject_beyond_vertical_edges)
{
    int x1, y1, x2, y2;

    zassert_false(akira_display_clip_rect(0, 240, 10, 10, XRES, YRES,
                                          &x1, &y1, &x2, &y2),
                  "rect starting past the bottom edge must be fully clipped");
    zassert_false(akira_display_clip_rect(0, -100, 10, 50, XRES, YRES,
                                          &x1, &y1, &x2, &y2),
                  "rect ending above the top edge must be fully clipped");
}

/* x + w / y + h overflow signed int. Signed overflow is UB, so the compiler may
 * assume it never happens and delete a naive bounds check outright. */
ZTEST(display_clip, test_reject_coordinate_overflow)
{
    int x1, y1, x2, y2;

    zassert_false(akira_display_clip_rect(INT32_MAX, 0, 1, 1, XRES, YRES,
                                          &x1, &y1, &x2, &y2),
                  "x + w overflow must not wrap into a valid-looking rect");
    zassert_false(akira_display_clip_rect(0, INT32_MAX, 1, 1, XRES, YRES,
                                          &x1, &y1, &x2, &y2),
                  "y + h overflow must not wrap into a valid-looking rect");
    zassert_false(akira_display_clip_rect(INT32_MIN, 0, 1, 1, XRES, YRES,
                                          &x1, &y1, &x2, &y2),
                  "INT32_MIN origin must be fully clipped");
}

ZTEST(display_clip, test_reject_degenerate_dimensions)
{
    int x1, y1, x2, y2;

    zassert_false(akira_display_clip_rect(0, 0, 0, 10, XRES, YRES,
                                          &x1, &y1, &x2, &y2), "w = 0");
    zassert_false(akira_display_clip_rect(0, 0, 10, 0, XRES, YRES,
                                          &x1, &y1, &x2, &y2), "h = 0");
    zassert_false(akira_display_clip_rect(0, 0, -1, 10, XRES, YRES,
                                          &x1, &y1, &x2, &y2), "w < 0");
    zassert_false(akira_display_clip_rect(0, 0, 10, -1, XRES, YRES,
                                          &x1, &y1, &x2, &y2), "h < 0");
    zassert_false(akira_display_clip_rect(0, 0, 10, 10, 0, 0,
                                          &x1, &y1, &x2, &y2), "zero panel");
}

/* ------------------------------------------------------------------ */
/* Accepted — must still clip rather than reject                        */
/* ------------------------------------------------------------------ */

ZTEST(display_clip, test_fully_on_screen_is_unchanged)
{
    int x1, y1, x2, y2;

    zassert_true(akira_display_clip_rect(10, 10, 50, 50, XRES, YRES,
                                         &x1, &y1, &x2, &y2), NULL);
    zassert_equal(x1, 10, "x1");
    zassert_equal(y1, 10, "y1");
    zassert_equal(x2, 60, "x2 is exclusive: 10 + 50");
    zassert_equal(y2, 60, "y2 is exclusive: 10 + 50");
}

/* The case the originally-suggested fix ("reject x < 0") would have broken.
 * Drawing a sprite that hangs off the left edge is legitimate. */
ZTEST(display_clip, test_straddling_left_edge_is_clipped_not_rejected)
{
    int x1, y1, x2, y2;

    zassert_true(akira_display_clip_rect(-10, 20, 50, 30, XRES, YRES,
                                         &x1, &y1, &x2, &y2),
                 "partially visible rect must still be drawn");
    zassert_equal(x1, 0,  "clipped to the left edge");
    zassert_equal(x2, 40, "-10 + 50 = 40 visible columns");
    zassert_equal(y1, 20, "y untouched");
    zassert_equal(y2, 50, NULL);
}

ZTEST(display_clip, test_straddling_top_edge_is_clipped_not_rejected)
{
    int x1, y1, x2, y2;

    zassert_true(akira_display_clip_rect(20, -10, 30, 50, XRES, YRES,
                                         &x1, &y1, &x2, &y2), NULL);
    zassert_equal(y1, 0,  "clipped to the top edge");
    zassert_equal(y2, 40, "-10 + 50 = 40 visible rows");
}

ZTEST(display_clip, test_straddling_far_edges_is_clamped_to_panel)
{
    int x1, y1, x2, y2;

    zassert_true(akira_display_clip_rect(300, 220, 100, 100, XRES, YRES,
                                         &x1, &y1, &x2, &y2), NULL);
    zassert_equal(x1, 300,  NULL);
    zassert_equal(y1, 220,  NULL);
    zassert_equal(x2, XRES, "clamped to panel width");
    zassert_equal(y2, YRES, "clamped to panel height");
}

/* A rect larger than the panel in every direction still yields the full panel,
 * not an empty or inverted result. */
ZTEST(display_clip, test_covering_whole_panel)
{
    int x1, y1, x2, y2;

    zassert_true(akira_display_clip_rect(-1000, -1000, 5000, 5000, XRES, YRES,
                                         &x1, &y1, &x2, &y2), NULL);
    zassert_equal(x1, 0,    NULL);
    zassert_equal(y1, 0,    NULL);
    zassert_equal(x2, XRES, NULL);
    zassert_equal(y2, YRES, NULL);
}

/* Exact-edge boundaries: the last valid pixel must be accepted and the first
 * invalid one rejected. Off-by-one here is what the whole fix turns on. */
ZTEST(display_clip, test_exact_edge_boundaries)
{
    int x1, y1, x2, y2;

    zassert_true(akira_display_clip_rect(XRES - 1, YRES - 1, 1, 1, XRES, YRES,
                                         &x1, &y1, &x2, &y2),
                 "last on-screen pixel must be drawable");
    zassert_equal(x2, XRES, NULL);
    zassert_equal(y2, YRES, NULL);

    zassert_false(akira_display_clip_rect(XRES, 0, 1, 1, XRES, YRES,
                                          &x1, &y1, &x2, &y2),
                  "first column past the panel must be rejected");
    zassert_false(akira_display_clip_rect(0, YRES, 1, 1, XRES, YRES,
                                          &x1, &y1, &x2, &y2),
                  "first row past the panel must be rejected");
}

/* The helper must not touch the outputs when it returns false — callers are
 * entitled to leave them uninitialised. */
ZTEST(display_clip, test_outputs_untouched_when_fully_clipped)
{
    int x1 = -12345, y1 = -12345, x2 = -12345, y2 = -12345;

    zassert_false(akira_display_clip_rect(400, 0, 10, 10, XRES, YRES,
                                          &x1, &y1, &x2, &y2), NULL);
    zassert_equal(x1, -12345, "x1 must not be written on the reject path");
    zassert_equal(y1, -12345, "y1 must not be written on the reject path");
    zassert_equal(x2, -12345, "x2 must not be written on the reject path");
    zassert_equal(y2, -12345, "y2 must not be written on the reject path");
}
```

## src/test_manifest_parser.c
```c
/*
 * test_manifest_parser.c
 * ztest suite: manifest_parser
 *
 * Tests for src/runtime/manifest_parser.c
 * Exercises manifest_parse_json() and manifest_parse_wasm_section().
 */

#include <zephyr/ztest.h>
#include <string.h>
#include <stdint.h>
#include "manifest_parser.h"
#include "akira_abi_check.h"
#include "security.h" /* cap bit-mask constants */

/* ── helpers ─────────────────────────────────────────────────────────────── */

/**
 * Build a minimal WASM binary that contains a single custom section
 * named ".akira.manifest" with @p json as its payload.
 * @p buf must be large enough (json_len + 32 bytes of overhead).
 */
static void build_wasm_with_manifest(uint8_t *buf, size_t *out_len,
                                     const char *json)
{
    const char *section_name = ".akira.manifest";
    uint8_t name_len = (uint8_t)strlen(section_name); /* 15 */
    size_t json_len = strlen(json);

    /* section body = LEB128(name_len) + name + json */
    uint32_t body = 1u + name_len + (uint32_t)json_len;

    size_t pos = 0;

    /* WASM magic (\0asm) + version (1) */
    buf[pos++] = 0x00;
    buf[pos++] = 0x61;
    buf[pos++] = 0x73;
    buf[pos++] = 0x6D;
    buf[pos++] = 0x01;
    buf[pos++] = 0x00;
    buf[pos++] = 0x00;
    buf[pos++] = 0x00;

    /* Custom section id = 0 */
    buf[pos++] = 0x00;

    /* Section size as LEB128 (up to 2 bytes covers < 16383 bytes) */
    if (body < 128)
    {
        buf[pos++] = (uint8_t)body;
    }
    else
    {
        buf[pos++] = (uint8_t)((body & 0x7F) | 0x80);
        buf[pos++] = (uint8_t)(body >> 7);
    }

    /* Name length (fits in 1 byte) */
    buf[pos++] = name_len;
    /* Name */
    memcpy(&buf[pos], section_name, name_len);
    pos += name_len;
    /* JSON payload */
    memcpy(&buf[pos], json, json_len);
    pos += json_len;

    *out_len = pos;
}

/* ── test cases ──────────────────────────────────────────────────────────── */

ZTEST(manifest_parser, test_valid_json)
{
    const char *json =
        "{\"name\":\"myapp\",\"version\":\"1.0.0\","
        "\"memory_quota\":65536,"
        "\"capabilities\":[\"display.write\",\"storage.read\"]}";

    akira_manifest_t m;
    int rc = manifest_parse_json(json, strlen(json), &m);

    zassert_equal(rc, 0, "parse should succeed, got %d", rc);
    zassert_true(m.valid, "manifest.valid should be true");
    zassert_equal(m.memory_quota, 65536U, "memory_quota mismatch");
    zassert_str_equal(m.name, "myapp", "name mismatch");
    zassert_str_equal(m.version, "1.0.0", "version mismatch");
    zassert_true(m.cap_mask & AKIRA_CAP_DISPLAY_WRITE,
                 "display.write cap missing");
    zassert_true(m.cap_mask & AKIRA_CAP_STORAGE_READ,
                 "storage.read cap missing");
}

ZTEST(manifest_parser, test_invalid_json)
{
    const char *bad = "not_json_at_all";

    akira_manifest_t m;
    int rc = manifest_parse_json(bad, strlen(bad), &m);

    zassert_not_equal(rc, 0, "bad JSON should fail, got rc=%d", rc);
    zassert_false(m.valid, "manifest.valid should be false");
}

ZTEST(manifest_parser, test_truncated_json)
{
    /* Truncated mid-string — parser must not crash */
    const char *trunc = "{\"name\":\"app\",\"capabilities\":[\"display.w";

    akira_manifest_t m;
    /* Return value may be -EINVAL or 0 with partial parse — must not hang */
    manifest_parse_json(trunc, strlen(trunc), &m);
    /* No crash is the primary assertion; valid must not be inconsistently set */
}

ZTEST(manifest_parser, test_bad_capability)
{
    /* Unknown capability strings must be silently ignored (mask stays 0) */
    const char *json =
        "{\"capabilities\":[\"foo.bar\",\"unknown.cap\"]}";

    akira_manifest_t m;
    int rc = manifest_parse_json(json, strlen(json), &m);

    zassert_equal(rc, 0, "parse should succeed");
    zassert_equal(m.cap_mask, 0U,
                  "unknown caps should contribute 0 to mask, got 0x%08x",
                  m.cap_mask);
}

ZTEST(manifest_parser, test_oversize_quota)
{
    /*
     * Largest uint32 value in JSON (4294967295).  Parser must not crash
     * and must set memory_quota to the parsed value without overflowing
     * into adjacent fields.
     */
    const char *json =
        "{\"memory_quota\":4294967295,\"name\":\"big\"}";

    akira_manifest_t m;
    int rc = manifest_parse_json(json, strlen(json), &m);

    /* Parser should succeed or return -EINVAL — either is acceptable.
     * The critical invariant is that name[] is not corrupted. */
    if (rc == 0)
    {
        zassert_str_equal(m.name, "big",
                          "name corrupted by large quota");
    }
}

ZTEST(manifest_parser, test_missing_name)
{
    /* name field omitted — should parse OK with empty name */
    const char *json =
        "{\"version\":\"2.0\",\"capabilities\":[\"timer\"]}";

    akira_manifest_t m;
    int rc = manifest_parse_json(json, strlen(json), &m);

    zassert_equal(rc, 0, "parse should succeed without name");
    zassert_true(m.valid, "manifest.valid should be true");
    zassert_equal(m.name[0], '\0', "name should be empty string");
    zassert_true(m.cap_mask & AKIRA_CAP_TIMER, "timer cap missing");
}

ZTEST(manifest_parser, test_null_inputs)
{
    akira_manifest_t m;

    zassert_not_equal(manifest_parse_json(NULL, 10, &m), 0,
                      "NULL json should fail");
    zassert_not_equal(manifest_parse_json("{}", 2, NULL), 0,
                      "NULL manifest should fail");
    zassert_not_equal(manifest_parse_json("{}", 0, &m), 0,
                      "zero length should fail");
}

ZTEST(manifest_parser, test_wasm_section)
{
    const char *json =
        "{\"name\":\"wtest\",\"version\":\"0.1\","
        "\"memory_quota\":4096,"
        "\"capabilities\":[\"storage.write\",\"timer\"]}";

    uint8_t wasm_buf[256];
    size_t wasm_len = 0;

    build_wasm_with_manifest(wasm_buf, &wasm_len, json);
    zassert_true(wasm_len > 8, "WASM binary must be larger than header");

    akira_manifest_t m;
    int rc = manifest_parse_wasm_section(wasm_buf, wasm_len, &m);

    zassert_equal(rc, 0, "wasm section parse failed: %d", rc);
    zassert_true(m.valid, "manifest.valid should be true");
    zassert_str_equal(m.name, "wtest", "name mismatch");
    zassert_equal(m.memory_quota, 4096U, "memory_quota mismatch");
    zassert_true(m.cap_mask & AKIRA_CAP_STORAGE_WRITE,
                 "storage.write cap missing");
    zassert_true(m.cap_mask & AKIRA_CAP_TIMER, "timer cap missing");
}

ZTEST(manifest_parser, test_wasm_no_manifest_section)
{
    /* A WASM binary with no custom section — should return -ENOENT */
    static const uint8_t minimal_wasm[] = {
        0x00, 0x61, 0x73, 0x6D, /* magic */
        0x01, 0x00, 0x00, 0x00  /* version */
    };

    akira_manifest_t m;
    int rc = manifest_parse_wasm_section(minimal_wasm, sizeof(minimal_wasm), &m);

    zassert_equal(rc, -ENOENT,
                  "expected -ENOENT for missing section, got %d", rc);
}

ZTEST(manifest_parser, test_high_capability_bits)
{
    /* Capabilities above bit 31 must survive parsing; a 16- or 32-bit mask
     * anywhere on the path would silently drop them. */
    const char *json =
        "{\"name\":\"hibits\",\"version\":\"1.0.0\","
        "\"memory_quota\":65536,"
        "\"capabilities\":[\"ai.infer\",\"mqtt\",\"sync\"]}";

    akira_manifest_t m;
    int rc = manifest_parse_json(json, strlen(json), &m);

    zassert_equal(rc, 0, "parse should succeed, got %d", rc);
    zassert_true(m.cap_mask & AKIRA_CAP_AIINFER, "ai.infer (bit 32) missing");
    zassert_true(m.cap_mask & AKIRA_CAP_MQTT, "mqtt (bit 35) missing");
    zassert_true(m.cap_mask & AKIRA_CAP_SYNC, "sync (bit 39) missing");
}

ZTEST(manifest_parser, test_abi_and_min_version_parsed)
{
    const char *json =
        "{\"name\":\"v\",\"abi\":\"1.2\",\"min_akiraos_version\":\"1.6.0\"}";
    akira_manifest_t m;

    zassert_equal(manifest_parse_json(json, strlen(json), &m), 0, "parse failed");
    zassert_true(m.has_abi, "abi flag");
    zassert_equal(m.abi_major, 1, "abi major");
    zassert_equal(m.abi_minor, 2, "abi minor");
    zassert_true(m.has_min_os, "min_os flag");
    zassert_equal(m.min_os[0], 1, "min major");
    zassert_equal(m.min_os[1], 6, "min minor");
}

ZTEST(manifest_parser, test_no_abi_keys)
{
    const char *json = "{\"name\":\"v\"}";
    akira_manifest_t m;

    zassert_equal(manifest_parse_json(json, strlen(json), &m), 0, "parse failed");
    zassert_false(m.has_abi, "no abi key");
    zassert_false(m.has_min_os, "no min_os key");
}

/* ── ABI gate (akira_abi_check) ─────────────────────────────────────────── */

static akira_manifest_t abi_manifest(bool has_abi, int amaj, int amin,
                                     bool has_min, int mj, int mn, int mp)
{
    akira_manifest_t m = { .valid = true, .has_abi = has_abi,
                           .abi_major = amaj, .abi_minor = amin,
                           .has_min_os = has_min };
    m.min_os[0] = mj; m.min_os[1] = mn; m.min_os[2] = mp;
    return m;
}

ZTEST(manifest_parser, test_abi_gate)
{
    const uint16_t fw[3] = {1, 6, 4};

    akira_manifest_t same = abi_manifest(true, 1, 0, false, 0, 0, 0);
    zassert_equal(akira_abi_check(&same, 1, 0, fw), 0, "same ABI must pass");

    akira_manifest_t older_minor = abi_manifest(true, 1, 0, false, 0, 0, 0);
    zassert_equal(akira_abi_check(&older_minor, 1, 3, fw), 0, "older minor must pass");

    akira_manifest_t newer_minor = abi_manifest(true, 1, 5, false, 0, 0, 0);
    zassert_equal(akira_abi_check(&newer_minor, 1, 3, fw), 0, "newer minor warns but passes");

    akira_manifest_t major2 = abi_manifest(true, 2, 0, false, 0, 0, 0);
    zassert_equal(akira_abi_check(&major2, 1, 0, fw), -ENOTSUP, "major mismatch must fail");

    akira_manifest_t none = abi_manifest(false, 0, 0, false, 0, 0, 0);
    zassert_equal(akira_abi_check(&none, 1, 0, fw), 0, "missing ABI is legacy, passes");

    akira_manifest_t need_new = abi_manifest(true, 1, 0, true, 1, 7, 0);
    zassert_equal(akira_abi_check(&need_new, 1, 0, fw), -ENOTSUP,
                  "min_akiraos_version newer than firmware must fail");

    akira_manifest_t need_old = abi_manifest(true, 1, 0, true, 1, 5, 0);
    zassert_equal(akira_abi_check(&need_old, 1, 0, fw), 0,
                  "min_akiraos_version older than firmware passes");

    akira_manifest_t need_patch = abi_manifest(true, 1, 0, true, 1, 6, 9);
    zassert_equal(akira_abi_check(&need_patch, 1, 0, fw), -ENOTSUP,
                  "patch component is compared too");
}

ZTEST_SUITE(manifest_parser, NULL, NULL, NULL, NULL, NULL);
```

## src/test_matter_accessory.c
```c
/*
 * Copyright (c) 2026 PenEngineering S.R.L
 * SPDX-License-Identifier: Apache-2.0
 *
 * Integration test for the Matter accessory (device-as-endpoint) path,
 * driven against the in-firmware mock co-processor
 * (CONFIG_AKIRA_MATTER_COPROC_MOCK). Exercises the full IPC round-trip:
 * endpoint registration, onboarding-code retrieval, attribute reporting,
 * pairing-window open, and inbound-command delivery.
 */

#include <zephyr/ztest.h>
#include <string.h>

#include "runtime/akira_matter_ipc.h"
#include "matter_coproc_mock.h"

/* Matter cluster / device-type IDs used by the test. */
#define DEVTYPE_COLOR_LIGHT 0x0102
#define CLUSTER_ONOFF       0x0006
#define CLUSTER_LEVEL       0x0008
#define CLUSTER_COLOR       0x0300
#define CMD_ON              0x0001

ZTEST(matter_accessory, test_endpoint_add_returns_id)
{
    zassert_ok(akira_matter_ipc_init(), "ipc init failed");

    uint32_t clusters[] = { CLUSTER_ONOFF, CLUSTER_LEVEL, CLUSTER_COLOR };
    uint8_t ep = 0xFF;
    int rc = akira_matter_ipc_endpoint_add(DEVTYPE_COLOR_LIGHT, clusters, 3, &ep);
    zassert_ok(rc, "endpoint_add rc=%d", rc);
    zassert_equal(ep, 1, "first endpoint should be 1, got %u", ep);
}

ZTEST(matter_accessory, test_get_qr_is_not_hardcoded_stub)
{
    zassert_ok(akira_matter_ipc_init(), "ipc init failed");

    char qr[AKIRA_MATTER_IPC_QR_LEN];
    char manual[AKIRA_MATTER_IPC_MANUAL_LEN];
    int rc = akira_matter_ipc_get_qr(qr, sizeof(qr), manual, sizeof(manual));
    zassert_ok(rc, "get_qr rc=%d", rc);

    zassert_true(strncmp(qr, "MT:", 3) == 0, "QR should start with MT: (got '%s')", qr);
    /* The old stub returned a fixed string; the mock returns its own payload. */
    zassert_true(strcmp(qr, "MT:Y.K9042C00KA0648G00") != 0, "QR is the dead stub value");
    zassert_true(strlen(manual) > 0, "manual code empty");
}

ZTEST(matter_accessory, test_inbound_command_delivered)
{
    zassert_ok(akira_matter_ipc_init(), "ipc init failed");

    /* Drain any commands auto-injected by earlier endpoint_add calls so this
     * test is order-independent. */
    struct akira_matter_event evt;
    while (akira_matter_ipc_poll(&evt, K_NO_WAIT) == 0) {
        /* discard */
    }

    /* Simulate a controller (Home Assistant / Google Home) issuing On to EP 7. */
    matter_coproc_mock_inject_command(7, CLUSTER_ONOFF, CMD_ON, NULL, 0);

    int rc = akira_matter_ipc_poll(&evt, K_MSEC(1000));
    zassert_ok(rc, "poll rc=%d (no command delivered)", rc);
    zassert_equal(evt.kind, AKIRA_MATTER_EVT_ACC_CMD, "wrong event kind %u", evt.kind);
    zassert_equal(evt.endpoint_id, 7, "wrong endpoint %u", evt.endpoint_id);
    zassert_equal(evt.cluster_id, CLUSTER_ONOFF, "wrong cluster 0x%x", evt.cluster_id);
    zassert_equal(evt.cmd_id, CMD_ON, "wrong cmd 0x%x", evt.cmd_id);
}

ZTEST(matter_accessory, test_report_and_pairing_succeed)
{
    zassert_ok(akira_matter_ipc_init(), "ipc init failed");

    uint8_t on = 1;
    int rc = akira_matter_ipc_report(1, CLUSTER_ONOFF, 0x0000, &on, 1);
    zassert_ok(rc, "report rc=%d", rc);

    rc = akira_matter_ipc_open_pairing(300);
    zassert_ok(rc, "open_pairing rc=%d", rc);
}

ZTEST(matter_accessory, test_report_rejects_bad_args)
{
    zassert_ok(akira_matter_ipc_init(), "ipc init failed");

    uint8_t v = 0;
    zassert_equal(akira_matter_ipc_report(1, CLUSTER_ONOFF, 0, NULL, 1), -EINVAL);
    zassert_equal(akira_matter_ipc_report(1, CLUSTER_ONOFF, 0, &v, 0), -EINVAL);
}

ZTEST_SUITE(matter_accessory, NULL, NULL, NULL, NULL, NULL);
```
