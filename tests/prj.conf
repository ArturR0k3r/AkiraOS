## CMakeLists.txt
```
# SPDX-License-Identifier: Apache-2.0

cmake_minimum_required(VERSION 3.20.0)

# Make AkiraOS board and DTS roots available
list(APPEND BOARD_ROOT ${CMAKE_CURRENT_LIST_DIR}/..)
list(APPEND DTS_ROOT   ${CMAKE_CURRENT_LIST_DIR}/..)

# The suite compiles the sources under test directly (below), so the akira-os
# module must not also build its libraries into this image.
set(AKIRA_OS_BUILD_LIBRARIES OFF)

find_package(Zephyr REQUIRED HINTS $ENV{ZEPHYR_BASE})
project(akiraos_tests)

# ── Include paths ──────────────────────────────────────────────────────────────
set(AKIRA_SRC ${CMAKE_CURRENT_LIST_DIR}/../src)
set(AKIRA_INC ${CMAKE_CURRENT_LIST_DIR}/../include)

target_include_directories(app PRIVATE
    ${AKIRA_SRC}
    ${AKIRA_SRC}/runtime
    ${AKIRA_SRC}/runtime/security
    ${AKIRA_SRC}/runtime/app_manager
    ${AKIRA_SRC}/connectivity
    ${AKIRA_SRC}/connectivity/ota
    ${AKIRA_SRC}/connectivity/matter
    ${AKIRA_SRC}/connectivity/mqtt
    ${AKIRA_INC}
    ${CMAKE_CURRENT_LIST_DIR}/../AkiraSDK/include
    ${CMAKE_CURRENT_LIST_DIR}/stubs
)

# ── Source files under test ────────────────────────────────────────────────────
target_sources(app PRIVATE
    # Sources under test
    ${AKIRA_SRC}/runtime/manifest_parser.c
    ${AKIRA_SRC}/runtime/akira_abi_check.c
    ${AKIRA_SRC}/runtime/security.c
    ${AKIRA_SRC}/runtime/security/app_signing_v2.c
    ${AKIRA_SRC}/runtime/security/sandbox.c
    ${AKIRA_SRC}/connectivity/ota/ota_manager.c
    ${AKIRA_SRC}/runtime/akira_boot_guard.c
    ${AKIRA_SRC}/runtime/akira_hooks.c
    ${AKIRA_SRC}/runtime/app_resources.c
    ${AKIRA_SRC}/runtime/security/akira_admission.c
    ${AKIRA_SRC}/runtime/security/akira_net_policy.c
    ${AKIRA_SRC}/runtime/security/app_signature_baseline.c
    ${AKIRA_SRC}/lib/crypto/ed25519/curve25519.c
    ${AKIRA_SRC}/lib/crypto/ed25519/akira_ed25519.c
    ${AKIRA_SRC}/lib/crypto/ed25519/ed25519_sign.c

    # Stubs
    stubs/stub_mcuboot.c
    stubs/stub_settings.c

    # Matter accessory path + in-firmware mock co-processor
    ${AKIRA_SRC}/runtime/akira_matter_ipc.c
    ${AKIRA_SRC}/connectivity/matter/matter_coproc_mock.c

    # Home Assistant discovery JSON helpers (transport stubbed in the test)
    ${AKIRA_SRC}/connectivity/mqtt/ha_discovery.c

    # Test suites
    src/test_manifest_parser.c
    src/test_security.c
    src/test_app_lifecycle.c
    src/test_ota_state.c
    src/test_boot_guard.c
    src/test_matter_accessory.c
    src/test_mqtt_ha.c
    src/test_display_clip.c
    src/test_admission.c
    src/test_app_resources.c
    src/test_ed25519_sign.c
    src/test_hardening.c

    # AkiraMesh session table (replay window); HKDF stubbed in the test
    ${AKIRA_SRC}/connectivity/mesh/mesh_session.c
    stubs/stub_mesh_crypto.c
)

# mesh_session.c is gated by CONFIG_AKIRA_MESH_E2E_CRYPTO, whose dependency
# chain (radio, PSA ECDH) is not wanted here: define it for the sources that
# use the session table.
set_source_files_properties(
    ${AKIRA_SRC}/connectivity/mesh/mesh_session.c
    src/test_hardening.c
    stubs/stub_mesh_crypto.c
    PROPERTIES COMPILE_DEFINITIONS
    "CONFIG_AKIRA_MESH_E2E_CRYPTO=1;CONFIG_AKIRA_MESH_MAX_SESSIONS=4"
)

# The baseline app signature provider reads CONFIG_AKIRA_APP_PUBKEY, which
# depends on AKIRA_APP_SIGNING (off in this suite). Give it the RFC 8032
# test-1 public key that test_admission.c signs with.
set_source_files_properties(
    ${AKIRA_SRC}/runtime/security/app_signature_baseline.c
    PROPERTIES COMPILE_DEFINITIONS
    "CONFIG_AKIRA_APP_PUBKEY=\"d75a980182b10ab7d54bfed3c964073a0ee172f3daa62325af021a68f707511a\""
)

# The Matter accessory sources are normally gated by Kconfig symbols whose
# dependency chain (AKIRA_MATTER -> AKIRA_RADIO_MANAGER, SERIAL, ...) is not
# satisfiable on native_sim. Define the two relevant switches directly so the
# accessory path + mock compile against the flat test build (same technique as
# the CONFIG_BOOTLOADER_MCUBOOT define below). The mock replaces the UART, so
# no serial hardware is required.
target_compile_definitions(app PRIVATE
    CONFIG_AKIRA_MATTER_ACCESSORY=1
    CONFIG_AKIRA_MATTER_COPROC_MOCK=1
)

# ota_manager.c guards its flash_area and mcuboot includes behind:
#   #if defined(CONFIG_FLASH_MAP) && defined(CONFIG_BOOTLOADER_MCUBOOT)
# CONFIG_FLASH_MAP=y is set in prj.conf (flash simulator), but
# CONFIG_BOOTLOADER_MCUBOOT cannot be set via Kconfig on native_sim (it would
# select USE_DT_CODE_PARTITION which has unsatisfied SOC dependencies).
# Setting it as a per-file compile definition bypasses Kconfig entirely so
# ota_manager.c compiles with OTA_FLASH_AVAILABLE=1.  The boot_request_upgrade /
# boot_write_img_confirmed symbols are satisfied by stubs/stub_mcuboot.c.
set_source_files_properties(
    ${AKIRA_SRC}/connectivity/ota/ota_manager.c
    src/test_ota_state.c
    PROPERTIES COMPILE_DEFINITIONS
    "CONFIG_BOOTLOADER_MCUBOOT=1;CONFIG_AKIRA_BOOT_GUARD=1;CONFIG_AKIRA_OTA_REFUSE_DOWNGRADE=1"
)

# CONFIG_AKIRA_BOOT_GUARD depends on MCUBOOT_IMG_MANAGER, unavailable here for
# the same reason, so the boot guard gets its symbols the same way. The short
# confirm delay keeps the BOOT_READY auto-confirm test fast.
set_source_files_properties(
    ${AKIRA_SRC}/runtime/akira_boot_guard.c
    src/test_boot_guard.c
    PROPERTIES COMPILE_DEFINITIONS
    "CONFIG_AKIRA_BOOT_GUARD=1;CONFIG_AKIRA_BOOT_GUARD_CONFIRM_DELAY_S=1;CONFIG_AKIRA_BOOT_GUARD_TRIAL_TIMEOUT_S=300;CONFIG_AKIRA_BOOT_GUARD_INIT_PRIORITY=60"
)
```

## Kconfig
```
# SPDX-License-Identifier: Apache-2.0
#
# Test-scope Kconfig for the AkiraOS ztest suite.
#
# Zephyr's kconfig.cmake auto-discovers this file via APPLICATION_SOURCE_DIR.
# The AkiraOS symbols come from the akira-os module (zephyr/Kconfig) and are
# enabled by CONFIG_AKIRA_OS=y in prj.conf.

source "Kconfig.zephyr"
```

## prj.conf
```kconfig
# ── Zephyr test framework ──────────────────────────────────────────────────────
CONFIG_ZTEST=y
# CONFIG_ZTEST_NEW_API does not exist in Zephyr v4; new API is always on

# ── Coverage (gcov) ────────────────────────────────────────────────────────────
CONFIG_COVERAGE=y
CONFIG_COVERAGE_GCOV=y

# ── libc ───────────────────────────────────────────────────────────────────────
CONFIG_NEWLIB_LIBC=y
CONFIG_PICOLIBC=n
CONFIG_EXTERNAL_LIBC=n

# ── Logging ────────────────────────────────────────────────────────────────────
CONFIG_LOG=y
CONFIG_LOG_DEFAULT_LEVEL=2

# ── Kernel / heap ──────────────────────────────────────────────────────────────
CONFIG_HEAP_MEM_POOL_SIZE=65536
CONFIG_MAIN_STACK_SIZE=4096

# ── AkiraOS config ─────────────────────────────────────────────────────────────
CONFIG_AKIRA_OS=y
CONFIG_AKIRA_LOG_LEVEL=2
CONFIG_AKIRA_WASM_RUNTIME=n
CONFIG_AKIRA_AUDIT_LOG_SIZE=16
CONFIG_AKIRA_SANDBOX_EXEC_TIMEOUT_MS=5000
CONFIG_AKIRA_APP_SIGNING=n

# ── Crypto (for app_signing tests) ────────────────────────────────────────────
CONFIG_MBEDTLS=y
CONFIG_MBEDTLS_BUILTIN=y
CONFIG_MBEDTLS_SHA256=y
# Disable the smaller-footprint SHA-256 implementation — it produces wrong
# results on native_sim (at least with Zephyr v4.3.0 / mbedTLS 3.x builtin).
# The standard implementation is slightly larger but correct.
CONFIG_MBEDTLS_SHA256_SMALLER=n
# Ed25519 (akira_ed25519.h) hashes with SHA-512.
CONFIG_MBEDTLS_SHA512=y

# ── Flash + OTA ────────────────────────────────────────────────────────────────
CONFIG_FLASH=y
CONFIG_FLASH_MAP=y
CONFIG_FLASH_SIMULATOR=y
CONFIG_FLASH_SIMULATOR_DOUBLE_WRITES=y
# sys_reboot() for the OTA rollback and boot-guard paths
CONFIG_REBOOT=y

# Do NOT enable CONFIG_BOOTLOADER_MCUBOOT — it selects USE_DT_CODE_PARTITION
# which has unsatisfied dependencies on native_sim.  Without it,
# ota_manager.c compiles with OTA_FLASH_AVAILABLE=0, and the OTA ztest cases
# that require a live flash path call ztest_test_skip() gracefully.

# ── Disable hardware not present on native_sim ─────────────────────────────────
CONFIG_GPIO=n
CONFIG_SPI=n
CONFIG_I2C=n
CONFIG_DISPLAY=n
CONFIG_WIFI=n
CONFIG_BT=n
CONFIG_USB_DEVICE_STACK=n
CONFIG_AKIRA_USB_HID=n
CONFIG_SENSOR=n

# ── Networking (not needed for tests) ─────────────────────────────────────────
CONFIG_NETWORKING=n

# ── Matter accessory IPC (mock co-processor) ──────────────────────────────────
# crc16_reflect() is used by the IPC framing + mock responder.
CONFIG_CRC=y
```

## src/test_admission.c
```c
/*
 * SPDX-License-Identifier: Apache-2.0
 *
 * Extension points added in 1.7: app admission (+ the Ed25519 baseline
 * provider), network egress policy and audit sinks.
 *
 * Test vectors come from PyCA cryptography 44 (an independent Ed25519
 * implementation). The key is RFC 8032 section 7.1 test 1; the baseline
 * provider is built with CONFIG_AKIRA_APP_PUBKEY set to its public half
 * (tests/CMakeLists.txt).
 */

#include <zephyr/ztest.h>
#include <zephyr/kernel.h>
#include <string.h>

#include <akira_admission.h>
#include <akira_audit.h>
#include <akira_ed25519.h>
#include <akira_net_policy.h>

#include "runtime/security/sandbox.h"

static const uint8_t rfc_pk[32] = {
	0xd7, 0x5a, 0x98, 0x01, 0x82, 0xb1, 0x0a, 0xb7, 0xd5, 0x4b, 0xfe, 0xd3,
	0xc9, 0x64, 0x07, 0x3a, 0x0e, 0xe1, 0x72, 0xf3, 0xda, 0xa6, 0x23, 0x25,
	0xaf, 0x02, 0x1a, 0x68, 0xf7, 0x07, 0x51, 0x1a,
};

/* RFC 8032 test 1: signature of the empty message. */
static const uint8_t rfc_sig_empty[64] = {
	0xe5, 0x56, 0x43, 0x00, 0xc3, 0x60, 0xac, 0x72, 0x90, 0x86, 0xe2, 0xcc,
	0x80, 0x6e, 0x82, 0x8a, 0x84, 0x87, 0x7f, 0x1e, 0xb8, 0xe5, 0xd9, 0x74,
	0xd8, 0x73, 0xe0, 0x65, 0x22, 0x49, 0x01, 0x55, 0x5f, 0xb8, 0x82, 0x15,
	0x90, 0xa3, 0x3b, 0xac, 0xc6, 0x1e, 0x39, 0x70, 0x1c, 0xf9, 0xb4, 0x6b,
	0xd2, 0x5b, 0xf5, 0xf0, 0x59, 0x5b, 0xbe, 0x24, 0x65, 0x51, 0x41, 0x43,
	0x8e, 0x7a, 0x10, 0x0b,
};

/* SHA-256('{"name":"hello","version":"1.0.0"}' || 00 61 73 6d 01 00 00 00):
 * the package digest akira-cli signs. */
static const uint8_t pkg_digest[32] = {
	0x12, 0x53, 0x40, 0x19, 0xaa, 0x29, 0x31, 0x12, 0x5f, 0x7b, 0xc6, 0x11,
	0xc6, 0x2e, 0x9f, 0x00, 0x5e, 0x2a, 0xca, 0xc6, 0x82, 0x74, 0x0c, 0xb0,
	0xe2, 0xec, 0x12, 0x90, 0xf9, 0x3d, 0x2a, 0x22,
};

static const uint8_t pkg_sig[64] = {
	0x1b, 0xd2, 0xc2, 0x3f, 0x2c, 0x52, 0xf0, 0x69, 0x39, 0x54, 0x19, 0x53,
	0xcd, 0x53, 0x15, 0xd6, 0xcc, 0x02, 0x88, 0x84, 0xe2, 0x6d, 0x61, 0xba,
	0x78, 0x7c, 0xb9, 0x02, 0x93, 0x96, 0xc3, 0x8a, 0xcb, 0xb4, 0x91, 0xf1,
	0x39, 0x5e, 0xb4, 0x0d, 0x2c, 0xa7, 0x50, 0x99, 0x97, 0xf9, 0xcc, 0x9a,
	0x04, 0x44, 0x0f, 0x13, 0x81, 0x53, 0xbf, 0x38, 0x05, 0x28, 0xee, 0xaf,
	0x70, 0x37, 0x1b, 0x02,
};

static const uint8_t some_hash[32] = { 1, 2, 3 };

/* ===== Ed25519 ===== */

ZTEST(ed25519, test_rfc8032_vector)
{
	zassert_ok(akira_ed25519_verify(NULL, 0, rfc_sig_empty, rfc_pk));
}

ZTEST(ed25519, test_package_digest_signature)
{
	zassert_ok(akira_ed25519_verify(pkg_digest, 32, pkg_sig, rfc_pk));
}

ZTEST(ed25519, test_rejects_tampering)
{
	uint8_t sig[64];
	uint8_t msg[32];
	uint8_t pk[32];

	memcpy(sig, pkg_sig, 64);
	sig[10] ^= 0x01;
	zassert_equal(akira_ed25519_verify(pkg_digest, 32, sig, rfc_pk), -EBADMSG);

	memcpy(msg, pkg_digest, 32);
	msg[31] ^= 0x80;
	zassert_equal(akira_ed25519_verify(msg, 32, pkg_sig, rfc_pk), -EBADMSG);

	memcpy(pk, rfc_pk, 32);
	pk[0] ^= 0x01;
	zassert_equal(akira_ed25519_verify(pkg_digest, 32, pkg_sig, pk), -EBADMSG);

	/* S >= group order (malleability) must be rejected. */
	memcpy(sig, pkg_sig, 64);
	memset(sig + 32, 0xff, 31);
	sig[63] = 0x0f;
	zassert_equal(akira_ed25519_verify(pkg_digest, 32, sig, rfc_pk), -EBADMSG);

	zassert_equal(akira_ed25519_verify(NULL, 32, pkg_sig, rfc_pk), -EINVAL);
}

ZTEST(ed25519, test_pubkey_hex)
{
	uint8_t pk[32];

	zassert_ok(akira_ed25519_pubkey_from_hex(
		"d75a980182b10ab7d54bfed3c964073a0ee172f3daa62325af021a68f707511a", pk));
	zassert_mem_equal(pk, rfc_pk, 32);
	zassert_equal(akira_ed25519_pubkey_from_hex("d75a98", pk), -EINVAL);
	zassert_equal(akira_ed25519_pubkey_from_hex(
		"d75a980182b10ab7d54bfed3c964073a0ee172f3daa62325af021a68f707511a00", pk),
		-EINVAL);
	zassert_equal(akira_ed25519_pubkey_from_hex(
		"z75a980182b10ab7d54bfed3c964073a0ee172f3daa62325af021a68f707511a", pk),
		-EINVAL);
}

/* ===== Admission ===== */

/* Two test providers bracketing the core baseline (prio 100). Both abstain
 * unless a test arms them. */
static struct {
	int early_verdict;
	bool early_attest;
	uint64_t early_clamp;
	int late_verdict;
	int early_calls;
	int late_calls;
} t;

static int early_admit(const struct akira_admission_ctx *ctx,
		       struct akira_admission_result *res, void *user)
{
	ARG_UNUSED(ctx);
	ARG_UNUSED(user);
	t.early_calls++;
	if (t.early_verdict == AKIRA_ADMISSION_DENY) {
		res->reason = "early says no";
	}
	if (t.early_attest) {
		res->attested = true;
		memset(res->signer_id, 0xee, sizeof(res->signer_id));
	}
	res->cap_clamp &= t.early_clamp;
	return t.early_verdict;
}

static int late_admit(const struct akira_admission_ctx *ctx,
		      struct akira_admission_result *res, void *user)
{
	ARG_UNUSED(ctx);
	ARG_UNUSED(res);
	ARG_UNUSED(user);
	t.late_calls++;
	return t.late_verdict;
}

/* Defined late-first to check that order follows prio, not link order. */
AKIRA_APP_ADMISSION_DEFINE(test_late_provider, 200, late_admit, NULL);
AKIRA_APP_ADMISSION_DEFINE(test_early_provider, 10, early_admit, NULL);

static void admission_reset(void *fixture)
{
	ARG_UNUSED(fixture);
	memset(&t, 0, sizeof(t));
	t.early_clamp = UINT64_MAX;
}

static struct akira_admission_ctx install_ctx(void)
{
	struct akira_admission_ctx ctx = {
		.phase = AKIRA_ADMISSION_INSTALL,
		.source = AKIRA_APP_SOURCE_HTTP,
		.name = "hello",
		.version = "1.0.0",
		.binary_sha256 = some_hash,
	};
	return ctx;
}

ZTEST(admission, test_unsigned_is_admitted_unattested)
{
	struct akira_admission_ctx ctx = install_ctx();
	struct akira_admission_result res;

	zassert_ok(akira_admission_evaluate(&ctx, &res));
	zassert_false(res.attested);
	zassert_equal(res.cap_clamp, UINT64_MAX);
	zassert_equal(t.early_calls, 1);
	zassert_equal(t.late_calls, 1);
}

ZTEST(admission, test_baseline_attests_oem_signed_package)
{
	struct akira_admission_ctx ctx = install_ctx();
	struct akira_admission_result res;
	static const uint8_t zero[AKIRA_ADMISSION_SIGNER_ID_LEN];

	ctx.package_digest = pkg_digest;
	ctx.sig_ed25519 = pkg_sig;
	ctx.sig_ed25519_len = sizeof(pkg_sig);

	zassert_ok(akira_admission_evaluate(&ctx, &res));
	zassert_true(res.attested, "OEM-signed package must be attested");
	zassert_true(memcmp(res.signer_id, zero, sizeof(zero)) != 0,
		     "the record must name the signing key");
}

ZTEST(admission, test_bad_signature_is_not_attested)
{
	struct akira_admission_ctx ctx = install_ctx();
	struct akira_admission_result res;
	uint8_t sig[64];

	memcpy(sig, pkg_sig, sizeof(sig));
	sig[0] ^= 0x01;
	ctx.package_digest = pkg_digest;
	ctx.sig_ed25519 = sig;
	ctx.sig_ed25519_len = sizeof(sig);

	zassert_ok(akira_admission_evaluate(&ctx, &res),
		   "a bad signature is not trusted, but another provider might be");
	zassert_false(res.attested);

	ctx.sig_ed25519 = pkg_sig;
	ctx.sig_ed25519_len = 63;
	zassert_ok(akira_admission_evaluate(&ctx, &res));
	zassert_false(res.attested, "a truncated signature never attests");
}

ZTEST(admission, test_deny_stops_evaluation)
{
	struct akira_admission_ctx ctx = install_ctx();
	struct akira_admission_result res;

	t.early_verdict = AKIRA_ADMISSION_DENY;
	ctx.package_digest = pkg_digest;
	ctx.sig_ed25519 = pkg_sig;
	ctx.sig_ed25519_len = sizeof(pkg_sig);

	zassert_equal(akira_admission_evaluate(&ctx, &res), -EACCES);
	zassert_false(res.attested, "a refused app is never attested");
	zassert_str_equal(res.reason, "early says no");
	zassert_equal(t.late_calls, 0, "providers after a DENY must not run");
}

ZTEST(admission, test_late_deny_overrides_earlier_attestation)
{
	struct akira_admission_ctx ctx = install_ctx();
	struct akira_admission_result res;

	t.early_verdict = AKIRA_ADMISSION_ALLOW;
	t.early_attest = true;
	t.late_verdict = AKIRA_ADMISSION_DENY;
	zassert_equal(akira_admission_evaluate(&ctx, &res), -EACCES);
	zassert_false(res.attested);
}

ZTEST(admission, test_clamps_and_first_signer)
{
	struct akira_admission_ctx ctx = install_ctx();
	struct akira_admission_result res;
	uint8_t ee[AKIRA_ADMISSION_SIGNER_ID_LEN];

	t.early_verdict = AKIRA_ADMISSION_ALLOW;
	t.early_attest = true;
	t.early_clamp = 0x00ff;
	ctx.package_digest = pkg_digest;
	ctx.sig_ed25519 = pkg_sig;
	ctx.sig_ed25519_len = sizeof(pkg_sig);

	zassert_ok(akira_admission_evaluate(&ctx, &res));
	zassert_true(res.attested);
	zassert_equal(res.cap_clamp, 0x00ff);
	memset(ee, 0xee, sizeof(ee));
	zassert_mem_equal(res.signer_id, ee, sizeof(ee),
			  "the record names the first provider that attested");
}

ZTEST(admission, test_attest_requires_allow)
{
	struct akira_admission_ctx ctx = install_ctx();
	struct akira_admission_result res;

	t.early_verdict = AKIRA_ADMISSION_ABSTAIN;
	t.early_attest = true; /* ignored without ALLOW */
	zassert_ok(akira_admission_evaluate(&ctx, &res));
	zassert_false(res.attested);
}

ZTEST(admission, test_invalid_verdict_fails_closed)
{
	struct akira_admission_ctx ctx = install_ctx();
	struct akira_admission_result res;

	t.early_verdict = 42;
	zassert_equal(akira_admission_evaluate(&ctx, &res), -EACCES);
}

ZTEST(admission, test_load_trusts_record_from_current_key_only)
{
	struct akira_admission_ctx ictx = install_ctx();
	struct akira_admission_result res;
	struct akira_admission_record rec = { 0 };

	ictx.package_digest = pkg_digest;
	ictx.sig_ed25519 = pkg_sig;
	ictx.sig_ed25519_len = sizeof(pkg_sig);
	zassert_ok(akira_admission_evaluate(&ictx, &res));

	rec.attested = 1;
	memcpy(rec.signer_id, res.signer_id, sizeof(rec.signer_id));

	struct akira_admission_ctx lctx = {
		.phase = AKIRA_ADMISSION_LOAD,
		.name = "hello",
		.binary_sha256 = some_hash,
		.record = &rec,
	};

	zassert_ok(akira_admission_evaluate(&lctx, &res));
	zassert_true(res.attested, "record signed by the configured key re-attests");

	rec.signer_id[0] ^= 0xff;
	zassert_ok(akira_admission_evaluate(&lctx, &res));
	zassert_false(res.attested, "a record naming another key is not trusted");

	lctx.record = NULL;
	zassert_ok(akira_admission_evaluate(&lctx, &res));
	zassert_false(res.attested, "no record, no attestation");
}

ZTEST(admission, test_source_names)
{
	zassert_str_equal(akira_app_source_name(AKIRA_APP_SOURCE_FLEET), "fleet");
	zassert_str_equal(akira_app_source_name(AKIRA_APP_SOURCE_BLE), "ble");
	zassert_str_equal(akira_app_source_name(99), "unknown");
}

ZTEST_SUITE(ed25519, NULL, NULL, NULL, NULL, NULL);
ZTEST_SUITE(admission, NULL, NULL, admission_reset, NULL, NULL);

/* ===== Network policy ===== */

static int net_calls;

static int test_net_policy(const struct akira_net_policy_ctx *ctx, void *user)
{
	ARG_UNUSED(user);
	net_calls++;
	if (ctx->op == AKIRA_NET_OP_BIND && ctx->port < 1024) {
		return -EPERM;
	}
	if (ctx->host && strcmp(ctx->host, "evil.example") == 0) {
		return -EACCES;
	}
	return 0;
}
AKIRA_NET_POLICY_DEFINE(test_net, test_net_policy, NULL);

ZTEST(net_policy, test_dispatch)
{
	struct akira_net_policy_ctx ok = {
		.op = AKIRA_NET_OP_CONNECT, .app_name = "a", .host = "api.example", .port = 443,
	};
	struct akira_net_policy_ctx bad = ok;
	struct akira_net_policy_ctx bind = {
		.op = AKIRA_NET_OP_BIND, .app_name = "a", .port = 80,
	};

	bad.host = "evil.example";
	net_calls = 0;
	zassert_ok(akira_net_policy_check(&ok));
	zassert_equal(akira_net_policy_check(&bad), -EACCES);
	zassert_equal(akira_net_policy_check(&bind), -EPERM,
		      "the provider's errno is returned");
	zassert_equal(net_calls, 3);
	zassert_equal(akira_net_policy_check(NULL), -EINVAL);
}

ZTEST_SUITE(net_policy, NULL, NULL, NULL, NULL, NULL);

/* ===== Audit sinks ===== */

#define SINK_CAP 64
static struct akira_audit_record sunk[SINK_CAP];
static int sunk_n;

static void test_sink(const struct akira_audit_record *rec, void *user)
{
	ARG_UNUSED(user);
	zassert_false(k_is_in_isr(), "sinks never run in ISR context");
	if (sunk_n < SINK_CAP) {
		sunk[sunk_n++] = *rec;
	}
}
AKIRA_AUDIT_SINK_DEFINE(test_audit_sink, test_sink, NULL);

static void *audit_setup(void)
{
	sandbox_init();
	return NULL;
}

static void audit_reset(void *fixture)
{
	ARG_UNUSED(fixture);
	sandbox_init(); /* restarts seq at 0 and empties the ring */
	sunk_n = 0;
}

ZTEST(audit_sink, test_records_reach_sinks_in_order)
{
	akira_audit_emit(AKIRA_AUDIT_ADMISSION_DENIED, "app1", 7);
	akira_audit_emit(AKIRA_AUDIT_VENDOR_FIRST + 3, "acme", 9);
	k_sleep(K_MSEC(50));

	zassert_equal(sunk_n, 2);
	zassert_equal(sunk[0].seq, 0);
	zassert_equal(sunk[0].type, AKIRA_AUDIT_ADMISSION_DENIED);
	zassert_equal(sunk[0].detail, 7);
	zassert_str_equal(sunk[0].app_name, "app1");
	zassert_equal(sunk[1].seq, 1);
	zassert_equal(sunk[1].type, AKIRA_AUDIT_VENDOR_FIRST + 3);
}

ZTEST(audit_sink, test_overflow_reports_dropped)
{
	/* The ring holds CONFIG_AKIRA_AUDIT_LOG_SIZE records. Emit more from a
	 * cooperative context so the sink work cannot run in between. */
	const int extra = 5;
	const int total = CONFIG_AKIRA_AUDIT_LOG_SIZE + extra;

	k_sched_lock();
	for (int i = 0; i < total; i++) {
		akira_audit_emit(AKIRA_AUDIT_APP_LOADED, "flood", (uint32_t)i);
	}
	k_sched_unlock();
	k_sleep(K_MSEC(50));

	zassert_equal(sunk_n, 1 + CONFIG_AKIRA_AUDIT_LOG_SIZE, "got %d", sunk_n);
	zassert_equal(sunk[0].type, AKIRA_AUDIT_DROPPED);
	zassert_equal(sunk[0].detail, extra);
	zassert_equal(sunk[1].seq, extra, "delivery resumes at the oldest kept record");
	zassert_equal(sunk[1].detail, extra);
	zassert_equal(sunk[sunk_n - 1].seq, total - 1);
}

ZTEST_SUITE(audit_sink, NULL, audit_setup, audit_reset, NULL, NULL);
```

## src/test_app_resources.c
```c
/*
 * Copyright (c) 2026 AkiraOS Contributors
 * SPDX-License-Identifier: Apache-2.0
 *
 * ztest suite: app_resources
 *
 * The release-hook registry (akira_app_containment.h): every hook registered
 * with AKIRA_APP_RESOURCE_DEFINE() runs, in its declared order, with the
 * app's slot and name, on every exit path — and running it twice is allowed.
 *
 * Sources exercised: src/runtime/app_resources.c
 */

#include <zephyr/ztest.h>
#include <string.h>

#include <akira_app_containment.h>

#define MAX_CALLS 8

static struct {
    char id;
    int slot;
    char name[16];
} g_calls[MAX_CALLS];
static int g_ncalls;
static int g_nstops;

static void record(char id, int slot, const char *name)
{
    if (g_ncalls < MAX_CALLS) {
        g_calls[g_ncalls].id = id;
        g_calls[g_ncalls].slot = slot;
        strncpy(g_calls[g_ncalls].name, name, sizeof(g_calls[0].name) - 1);
        g_calls[g_ncalls].name[sizeof(g_calls[0].name) - 1] = '\0';
    }
    g_ncalls++;
}

static void release_late(int slot, const char *name) { record('L', slot, name); }
static void release_early(int slot, const char *name) { record('E', slot, name); }
static void release_mid(int slot, const char *name) { record('M', slot, name); }
static void stop_mid(int slot, const char *name)
{
    ARG_UNUSED(name);
    zassert_equal(slot, 3, "on_stop gets the slot");
    g_nstops++;
}

/* Declared out of order on purpose: the two-digit order decides. */
AKIRA_APP_RESOURCE_DEFINE(test_late, 90, NULL, release_late);
AKIRA_APP_RESOURCE_DEFINE(test_early, 05, NULL, release_early);
AKIRA_APP_RESOURCE_DEFINE(test_mid, 50, stop_mid, release_mid);

static void reset(void *fixture)
{
    ARG_UNUSED(fixture);
    memset(g_calls, 0, sizeof(g_calls));
    g_ncalls = 0;
    g_nstops = 0;
}

ZTEST_SUITE(app_resources, NULL, NULL, reset, NULL, NULL);

ZTEST(app_resources, test_release_runs_every_hook_in_order)
{
    akira_app_resources_release(3, "game");

    /* Other suites may register hooks too; ours must appear in order. */
    int e = -1, m = -1, l = -1;

    for (int i = 0; i < MIN(g_ncalls, MAX_CALLS); i++) {
        if (g_calls[i].id == 'E') {
            e = i;
        } else if (g_calls[i].id == 'M') {
            m = i;
        } else if (g_calls[i].id == 'L') {
            l = i;
        }
    }
    zassert_true(e >= 0 && m >= 0 && l >= 0, "every hook ran");
    zassert_true(e < m && m < l, "hooks run in declared order (E=%d M=%d L=%d)", e, m, l);
    zassert_equal(g_calls[m].slot, 3, "hook gets the slot");
    zassert_str_equal(g_calls[m].name, "game", "hook gets the app name");
}

ZTEST(app_resources, test_release_is_repeatable)
{
    akira_app_resources_release(1, "a");
    int first = g_ncalls;

    akira_app_resources_release(1, "a");
    zassert_equal(g_ncalls, 2 * first, "a second release runs every hook again");
}

ZTEST(app_resources, test_null_name_becomes_empty)
{
    akira_app_resources_release(0, NULL);
    zassert_true(g_ncalls >= 3, "hooks ran");
    zassert_str_equal(g_calls[0].name, "", "NULL name is passed as \"\"");
}

ZTEST(app_resources, test_on_stop_only_calls_stop_hooks)
{
    akira_app_resources_on_stop_request(3, "game");
    zassert_equal(g_nstops, 1, "the on_stop hook ran once");
    zassert_equal(g_ncalls, 0, "no release hook ran");
}
```

## src/test_boot_guard.c
```c
/*
 * test_boot_guard.c
 * ztest suite: boot_guard
 *
 * Tests for src/runtime/akira_boot_guard.c: trial-boot detection, confirmation
 * (manual and after BOOT_READY), and rollback detection on the next boot.
 *
 * MCUboot is simulated by stubs/stub_mcuboot.c (image confirmed flag and slot
 * headers), settings by stubs/stub_settings.c. The deadline reboot and
 * akira_boot_guard_reject() are not exercised: sys_reboot() ends native_sim.
 */

#include <zephyr/ztest.h>
#include <zephyr/dfu/mcuboot.h>
#include <errno.h>
#include <string.h>

#include <akira_boot_guard.h>
#include <akira_hooks.h>
#include "settings/settings.h"
#include "ota/ota_manager.h"

/* Exported by stubs/stub_mcuboot.c */
extern int stub_boot_request_upgrade_rc;
extern int stub_boot_write_img_confirmed_rc;
extern int stub_boot_write_img_confirmed_calls;
extern bool stub_boot_img_confirmed;
extern struct mcuboot_img_header stub_slot0_header;
extern struct mcuboot_img_header stub_slot1_header;

#define TRIAL_KEY "ota/trial"

static int confirmed_events;
static int rollback_events;
static int rollback_error;

static void on_ota_event(const struct akira_hook_event *event, void *user_data)
{
    ARG_UNUSED(user_data);

    if (event->type == AKIRA_HOOK_OTA_CONFIRMED) {
        confirmed_events++;
    } else if (event->type == AKIRA_HOOK_OTA_ERROR) {
        rollback_events++;
        rollback_error = event->ota.error;
    }
}

AKIRA_HOOK_DEFINE(test_boot_guard_hook,
                  AKIRA_HOOK_MASK(AKIRA_HOOK_OTA_CONFIRMED) |
                      AKIRA_HOOK_MASK(AKIRA_HOOK_OTA_ERROR),
                  on_ota_event, NULL);

static void set_slot0(uint8_t major, uint8_t minor, uint32_t size)
{
    memset(&stub_slot0_header, 0, sizeof(stub_slot0_header));
    stub_slot0_header.mcuboot_version = 1;
    stub_slot0_header.h.v1.image_size = size;
    stub_slot0_header.h.v1.sem_ver.major = major;
    stub_slot0_header.h.v1.sem_ver.minor = minor;
}

static void emit_boot_ready(void)
{
    struct akira_hook_event evt = { .type = AKIRA_HOOK_BOOT_READY };

    akira_hooks_emit(&evt);
}

static void guard_before(void *arg)
{
    ARG_UNUSED(arg);

    stub_boot_request_upgrade_rc = 0;
    stub_boot_write_img_confirmed_rc = 0;
    stub_boot_write_img_confirmed_calls = 0;
    stub_boot_img_confirmed = true;
    set_slot0(1, 6, 1000);
    memset(&stub_slot1_header, 0, sizeof(stub_slot1_header));
    (void)akira_settings_delete(TRIAL_KEY);
    confirmed_events = 0;
    rollback_events = 0;
    rollback_error = 0;
}

static void guard_after(void *arg)
{
    ARG_UNUSED(arg);

    /* Never leave a trial (and its deadline timer) running between tests. */
    stub_boot_write_img_confirmed_rc = 0;
    (void)akira_boot_guard_confirm();
}

ZTEST(boot_guard, test_confirmed_image_is_not_a_trial)
{
    zassert_ok(akira_boot_guard_init());
    zassert_false(akira_boot_guard_is_trial());
    zassert_false(akira_boot_guard_rolled_back());
    zassert_ok(akira_boot_guard_confirm(), "confirming a confirmed image is a no-op");
    zassert_equal(stub_boot_write_img_confirmed_calls, 0);
}

ZTEST(boot_guard, test_unconfirmed_image_starts_trial_and_records_it)
{
    char rec[64];

    stub_boot_img_confirmed = false;
    zassert_ok(akira_boot_guard_init());
    zassert_true(akira_boot_guard_is_trial());
    zassert_ok(akira_settings_get(TRIAL_KEY, rec, sizeof(rec)));
    zassert_str_equal(rec, "1.6.0+0/1000");
}

ZTEST(boot_guard, test_confirm_ends_trial)
{
    char rec[64];

    stub_boot_img_confirmed = false;
    zassert_ok(akira_boot_guard_init());
    zassert_ok(akira_boot_guard_confirm());

    zassert_false(akira_boot_guard_is_trial());
    zassert_equal(stub_boot_write_img_confirmed_calls, 1);
    zassert_equal(confirmed_events, 1);
    zassert_equal(akira_settings_get(TRIAL_KEY, rec, sizeof(rec)), -ENOENT,
                  "trial record must be cleared once confirmed");
}

ZTEST(boot_guard, test_failed_confirm_keeps_trial)
{
    stub_boot_img_confirmed = false;
    zassert_ok(akira_boot_guard_init());

    stub_boot_write_img_confirmed_rc = -EIO;
    zassert_equal(akira_boot_guard_confirm(), -EIO);
    zassert_true(akira_boot_guard_is_trial());
    zassert_equal(confirmed_events, 0);
}

ZTEST(boot_guard, test_ota_confirm_firmware_goes_through_guard)
{
    char rec[64];

    stub_boot_img_confirmed = false;
    zassert_ok(akira_boot_guard_init());

    /* Shell "ota confirm" and WASM ota_confirm() must end the trial too,
     * not just set the MCUboot flag behind the guard's back. */
    zassert_equal(ota_confirm_firmware(), OTA_OK);
    zassert_false(akira_boot_guard_is_trial());
    zassert_equal(confirmed_events, 1);
    zassert_equal(akira_settings_get(TRIAL_KEY, rec, sizeof(rec)), -ENOENT);
}

ZTEST(boot_guard, test_boot_ready_confirms_after_delay)
{
    stub_boot_img_confirmed = false;
    zassert_ok(akira_boot_guard_init());

    emit_boot_ready();
    zassert_true(akira_boot_guard_is_trial(), "must not confirm before the delay");

    k_sleep(K_SECONDS(CONFIG_AKIRA_BOOT_GUARD_CONFIRM_DELAY_S + 1));
    zassert_false(akira_boot_guard_is_trial());
    zassert_equal(stub_boot_write_img_confirmed_calls, 1);
}

ZTEST(boot_guard, test_rollback_detected_on_next_boot)
{
    char rec[64];

    /* Boot 1: 1.7 trial starts, then "crashes" before confirming. */
    set_slot0(1, 7, 2000);
    stub_boot_img_confirmed = false;
    zassert_ok(akira_boot_guard_init());

    /* Boot 2: MCUboot restored the confirmed 1.6 image. */
    set_slot0(1, 6, 1000);
    stub_boot_img_confirmed = true;
    zassert_ok(akira_boot_guard_init());

    zassert_false(akira_boot_guard_is_trial());
    zassert_true(akira_boot_guard_rolled_back());
    zassert_equal(akira_settings_get(TRIAL_KEY, rec, sizeof(rec)), -ENOENT);

    emit_boot_ready();
    zassert_equal(rollback_events, 1);
    zassert_equal(rollback_error, -ECANCELED);
}

ZTEST(boot_guard, test_trial_confirmed_elsewhere_is_not_a_rollback)
{
    /* The trial image got confirmed without the guard (e.g. mcumgr), so the
     * record survived but the same image is running. */
    stub_boot_img_confirmed = false;
    zassert_ok(akira_boot_guard_init());

    stub_boot_img_confirmed = true;
    zassert_ok(akira_boot_guard_init());

    zassert_false(akira_boot_guard_rolled_back());
    emit_boot_ready();
    zassert_equal(rollback_events, 0);
}

ZTEST(boot_guard, test_manual_rollback_refused_without_previous_image)
{
    /* Confirmed image and an empty secondary slot (e.g. the failed image was
     * discarded after an automatic rollback): nothing to go back to, and no
     * reboot may be scheduled. */
    zassert_ok(akira_boot_guard_init());
    zassert_equal(ota_request_rollback(), OTA_ERROR_INVALID_IMAGE);
}

ZTEST_SUITE(boot_guard, NULL, NULL, guard_before, guard_after, NULL);
```

## src/test_catalog_net.c
```c
/*
 * Copyright (c) 2026 PenEngineering S.R.L
 * SPDX-License-Identifier: Apache-2.0
 */

#include <zephyr/ztest.h>
#include <string.h>
#include "catalog_net.h"

ZTEST_SUITE(catalog_net, NULL, NULL, NULL, NULL, NULL);

ZTEST(catalog_net, test_init_sets_capacity)
{
    uint8_t buf[64];
    catalog_ring_init(buf, sizeof(buf));

    uint32_t write_idx, read_idx, capacity, flags;
    memcpy(&write_idx, buf + 0, 4);
    memcpy(&read_idx, buf + 4, 4);
    memcpy(&capacity, buf + 8, 4);
    memcpy(&flags, buf + 12, 4);

    zassert_equal(write_idx, 0, "write_idx must start at 0");
    zassert_equal(read_idx, 0, "read_idx must start at 0");
    zassert_equal(capacity, sizeof(buf) - CATALOG_NET_RING_HDR_SIZE, "capacity is buffer size minus header");
    zassert_equal(flags, 0, "flags must be 0");
}

ZTEST(catalog_net, test_write_then_read_roundtrip)
{
    uint8_t buf[64];
    catalog_ring_init(buf, sizeof(buf));

    const uint8_t msg[] = "GET /catalogue.json";
    int ret = catalog_ring_write(buf, msg, sizeof(msg));
    zassert_equal(ret, 0, "write should succeed");

    uint8_t out[64];
    int n = catalog_ring_read(buf, out, sizeof(out));
    zassert_equal(n, sizeof(msg), "read should return the written length");
    zassert_mem_equal(out, msg, sizeof(msg), "read payload must match written payload");
}

ZTEST(catalog_net, test_read_empty_ring_returns_enodata)
{
    uint8_t buf[64];
    catalog_ring_init(buf, sizeof(buf));

    uint8_t out[64];
    int n = catalog_ring_read(buf, out, sizeof(out));
    zassert_equal(n, -ENODATA, "reading an empty ring must return -ENODATA");
}

ZTEST(catalog_net, test_write_too_large_returns_enospc)
{
    uint8_t buf[32]; /* capacity = 32 - 16 = 16 bytes of data area */
    catalog_ring_init(buf, sizeof(buf));

    uint8_t msg[20]; /* larger than the 16-byte data area even before framing overhead */
    memset(msg, 'A', sizeof(msg));
    int ret = catalog_ring_write(buf, msg, sizeof(msg));
    zassert_equal(ret, -ENOSPC, "oversized write must return -ENOSPC");
}

ZTEST(catalog_net, test_wraparound_roundtrip)
{
    uint8_t buf[32]; /* small ring to force wraparound: 32 - 16 = 16-byte data area */
    catalog_ring_init(buf, sizeof(buf));

    const uint8_t msg1[] = "abc";  /* 2-byte len prefix + 4 bytes = 6 bytes */
    const uint8_t msg2[] = "de";   /* 2-byte len prefix + 3 bytes = 5 bytes */

    zassert_equal(catalog_ring_write(buf, msg1, sizeof(msg1)), 0, "first write");
    uint8_t out[16];
    zassert_equal(catalog_ring_read(buf, out, sizeof(out)), sizeof(msg1), "first read");

    /* Second write should wrap past the end of the 16-byte data area */
    zassert_equal(catalog_ring_write(buf, msg2, sizeof(msg2)), 0, "second write (wraps)");
    int n = catalog_ring_read(buf, out, sizeof(out));
    zassert_equal(n, sizeof(msg2), "second read after wraparound");
    zassert_mem_equal(out, msg2, sizeof(msg2), "wrapped payload must match");
}
```

## src/test_catalogue_parser.c
```c
/*
 * Copyright (c) 2026 PenEngineering S.R.L
 * SPDX-License-Identifier: Apache-2.0
 */

#include <zephyr/ztest.h>
#include <string.h>
#include "catalogue_parser.h"

ZTEST_SUITE(catalogue_parser, NULL, NULL, NULL, NULL, NULL);

ZTEST(catalogue_parser, test_parses_two_apps)
{
    const char *json =
        "{"
        "\"generated_at\":\"2026-09-10T00:00:00Z\","
        "\"tag\":\"v1.2.3\","
        "\"apps\":["
        "{\"id\":\"console_apps/badge\",\"name\":\"badge\",\"display_name\":\"Akira Badge\","
        "\"category\":\"console_apps\",\"version\":\"1.1.0\",\"size_bytes\":4096,"
        "\"capabilities\":[\"display.write\"],\"min_akiraos_version\":\"1.5.0\","
        "\"download_url\":\"https://github.com/ArturR0k3r/AkiraSDK/releases/download/v1.2.3/console_apps-badge.akpkg\","
        "\"icon_url\":null},"
        "{\"id\":\"console_apps/level_tool\",\"name\":\"level_tool\",\"display_name\":\"Level Tool\","
        "\"category\":\"console_apps\",\"version\":\"1.0.0\",\"size_bytes\":2048,"
        "\"capabilities\":[],\"min_akiraos_version\":\"1.5.0\","
        "\"download_url\":\"https://github.com/ArturR0k3r/AkiraSDK/releases/download/v1.2.3/console_apps-level_tool.akpkg\","
        "\"icon_url\":null}"
        "]}";

    catalogue_entry_t entries[8];
    int n = catalogue_parse(json, strlen(json), entries, 8);

    zassert_equal(n, 2, "should parse both apps");
    zassert_str_equal(entries[0].name, "badge", "first app name");
    zassert_str_equal(entries[0].version, "1.1.0", "first app version");
    zassert_str_equal(entries[0].download_url,
        "https://github.com/ArturR0k3r/AkiraSDK/releases/download/v1.2.3/console_apps-badge.akpkg",
        "first app download_url");
    zassert_str_equal(entries[1].name, "level_tool", "second app name");
}

ZTEST(catalogue_parser, test_empty_apps_array)
{
    const char *json = "{\"generated_at\":\"x\",\"tag\":\"v1\",\"apps\":[]}";
    catalogue_entry_t entries[8];
    int n = catalogue_parse(json, strlen(json), entries, 8);
    zassert_equal(n, 0, "empty apps array parses to zero entries");
}

ZTEST(catalogue_parser, test_missing_apps_key_is_error)
{
    const char *json = "{\"generated_at\":\"x\",\"tag\":\"v1\"}";
    catalogue_entry_t entries[8];
    int n = catalogue_parse(json, strlen(json), entries, 8);
    zassert_true(n < 0, "missing apps array must return negative errno");
}

ZTEST(catalogue_parser, test_caps_at_max_entries)
{
    /* 3 apps in the JSON, but caller only has room for 2 */
    const char *json =
        "{\"apps\":["
        "{\"name\":\"a\",\"version\":\"1.0.0\",\"download_url\":\"http://x/a\"},"
        "{\"name\":\"b\",\"version\":\"1.0.0\",\"download_url\":\"http://x/b\"},"
        "{\"name\":\"c\",\"version\":\"1.0.0\",\"download_url\":\"http://x/c\"}"
        "]}";
    catalogue_entry_t entries[2];
    int n = catalogue_parse(json, strlen(json), entries, 2);
    zassert_equal(n, 2, "must cap at max_entries, not overflow the array");
}

ZTEST(catalogue_parser, test_malformed_entry_is_skipped_not_fatal)
{
    /* second entry has no closing brace before the array closes -> skip it, keep first and third */
    const char *json =
        "{\"apps\":["
        "{\"name\":\"a\",\"version\":\"1.0.0\",\"download_url\":\"http://x/a\"},"
        "{\"name\":\"b\",\"version\":\"1.0.0\","
        "{\"name\":\"c\",\"version\":\"1.0.0\",\"download_url\":\"http://x/c\"}"
        "]}";
    catalogue_entry_t entries[8];
    int n = catalogue_parse(json, strlen(json), entries, 8);
    zassert_true(n >= 1, "at least the well-formed first entry must parse");
    zassert_str_equal(entries[0].name, "a", "first entry still parses despite a later malformed one");
}

ZTEST(catalogue_parser, test_parses_tags_and_thumbnail)
{
    const char *json =
        "{\"apps\":["
        "{\"name\":\"tetris\",\"version\":\"1.0.0\",\"download_url\":\"http://x/t\","
        "\"tags\":[\"NES\",\"PUZZLE\",\"UNKNOWN_TAG\"],"
        "\"thumbnail_url\":\"https://console.app.akiraos.dev/catalog/thumbnails/retro-tetris.bin\"}"
        "]}";
    catalogue_entry_t entries[8];
    int n = catalogue_parse(json, strlen(json), entries, 8);

    zassert_equal(n, 1, "single app parses");
    zassert_equal(entries[0].tag_mask, CATALOGUE_TAG_NES | CATALOGUE_TAG_PUZZLE,
        "unrecognized tag is ignored, recognized tags set their bit");
    zassert_str_equal(entries[0].thumbnail_url,
        "https://console.app.akiraos.dev/catalog/thumbnails/retro-tetris.bin",
        "thumbnail_url parsed");
}

ZTEST(catalogue_parser, test_missing_tags_and_thumbnail_default_empty)
{
    const char *json =
        "{\"apps\":["
        "{\"name\":\"a\",\"version\":\"1.0.0\",\"download_url\":\"http://x/a\"}"
        "]}";
    catalogue_entry_t entries[8];
    int n = catalogue_parse(json, strlen(json), entries, 8);

    zassert_equal(n, 1, "single app parses");
    zassert_equal(entries[0].tag_mask, 0, "no tags key -> empty mask");
    zassert_str_equal(entries[0].thumbnail_url, "", "no thumbnail_url key -> empty string");
}
```

## src/test_companion_fs_util.c
```c
/*
 * SPDX-License-Identifier: Apache-2.0
 */
#include <zephyr/ztest.h>
#include <string.h>
#include "bluetooth/companion_fs_util.h"

ZTEST_SUITE(companion_fs_util, NULL, NULL, NULL, NULL, NULL);

ZTEST(companion_fs_util, test_path_accepts_sd)
{
    zassert_true(comp_fs_path_ok("/SD:"));
    zassert_true(comp_fs_path_ok("/SD:/"));
    zassert_true(comp_fs_path_ok("/SD:/apps/a.wasm"));
    zassert_true(comp_fs_path_ok("/SD:/a..b"));
    zassert_true(comp_fs_path_ok("/SD:/.../x"));
}

ZTEST(companion_fs_util, test_path_rejects)
{
    zassert_false(comp_fs_path_ok(NULL));
    zassert_false(comp_fs_path_ok(""));
    zassert_false(comp_fs_path_ok("/lfs/x"));
    zassert_false(comp_fs_path_ok("/SD:x"));
    zassert_false(comp_fs_path_ok("/SDX:/x"));
    zassert_false(comp_fs_path_ok("/SD:/.."));
    zassert_false(comp_fs_path_ok("/SD:/a/../b"));
    zassert_false(comp_fs_path_ok("/SD:/a/.."));
    zassert_false(comp_fs_path_ok("/SD:/a\"b"));
    zassert_false(comp_fs_path_ok("/SD:/a\\b"));
}

ZTEST(companion_fs_util, test_path_length_limit)
{
    char p[100];
    memset(p, 'a', sizeof(p));
    memcpy(p, "/SD:/", 5);
    p[COMP_FS_PATH_MAX - 1] = '\0';   /* 79 chars: ok */
    zassert_true(comp_fs_path_ok(p));
    p[COMP_FS_PATH_MAX - 1] = 'a';
    p[COMP_FS_PATH_MAX] = '\0';       /* 80 chars: too long */
    zassert_false(comp_fs_path_ok(p));
}

ZTEST(companion_fs_util, test_mutable_excludes_root)
{
    zassert_false(comp_fs_path_mutable_ok("/SD:"));
    zassert_false(comp_fs_path_mutable_ok("/SD:/"));
    zassert_true(comp_fs_path_mutable_ok("/SD:/x"));
    zassert_false(comp_fs_path_mutable_ok("/lfs/x"));
}

ZTEST(companion_fs_util, test_tmp_path)
{
    char out[COMP_FS_PATH_MAX];
    zassert_equal(comp_fs_tmp_path("/SD:/a.txt", out, sizeof(out)), 0);
    zassert_str_equal(out, "/SD:/a.txt.tmp");
    char small[8];
    zassert_equal(comp_fs_tmp_path("/SD:/a.txt", small, sizeof(small)), -ENAMETOOLONG);
}

ZTEST(companion_fs_util, test_fmt_entry)
{
    char out[96];
    int n = comp_fs_fmt_entry(out, sizeof(out), "a.txt", false, 12);
    zassert_equal(n, (int)strlen(out));
    zassert_str_equal(out, "{\"name\":\"a.txt\",\"type\":\"file\",\"size\":12}");
    zassert_true(comp_fs_fmt_entry(out, 10, "a.txt", false, 12) < 0);
    n = comp_fs_fmt_entry(out, sizeof(out), "d", true, 0);
    zassert_str_equal(out, "{\"name\":\"d\",\"type\":\"dir\",\"size\":0}");
}
```

## src/test_ed25519_sign.c
```c
/*
 * SPDX-License-Identifier: Apache-2.0
 *
 * Ed25519 key derivation and signing (src/lib/crypto/ed25519/ed25519_sign.c),
 * used by the WASM crypto API. Ed25519 is deterministic, so every signature
 * must match the reference byte for byte. Vectors: RFC 8032 section 7.1
 * tests 1 and 2, and PyCA cryptography 44 for the rest.
 */

#include <zephyr/ztest.h>
#include <string.h>

#include <akira_ed25519.h>
#include "lib/crypto/ed25519/ed25519_sign.h"

/* RFC 8032 test 1 */
static const uint8_t t1_seed[32] = {
	0x9d, 0x61, 0xb1, 0x9d, 0xef, 0xfd, 0x5a, 0x60, 0xba, 0x84, 0x4a, 0xf4,
	0x92, 0xec, 0x2c, 0xc4, 0x44, 0x49, 0xc5, 0x69, 0x7b, 0x32, 0x69, 0x19,
	0x70, 0x3b, 0xac, 0x03, 0x1c, 0xae, 0x7f, 0x60,
};
static const uint8_t t1_pub[32] = {
	0xd7, 0x5a, 0x98, 0x01, 0x82, 0xb1, 0x0a, 0xb7, 0xd5, 0x4b, 0xfe, 0xd3,
	0xc9, 0x64, 0x07, 0x3a, 0x0e, 0xe1, 0x72, 0xf3, 0xda, 0xa6, 0x23, 0x25,
	0xaf, 0x02, 0x1a, 0x68, 0xf7, 0x07, 0x51, 0x1a,
};
static const uint8_t t1_sig[64] = {
	0xe5, 0x56, 0x43, 0x00, 0xc3, 0x60, 0xac, 0x72, 0x90, 0x86, 0xe2, 0xcc,
	0x80, 0x6e, 0x82, 0x8a, 0x84, 0x87, 0x7f, 0x1e, 0xb8, 0xe5, 0xd9, 0x74,
	0xd8, 0x73, 0xe0, 0x65, 0x22, 0x49, 0x01, 0x55, 0x5f, 0xb8, 0x82, 0x15,
	0x90, 0xa3, 0x3b, 0xac, 0xc6, 0x1e, 0x39, 0x70, 0x1c, 0xf9, 0xb4, 0x6b,
	0xd2, 0x5b, 0xf5, 0xf0, 0x59, 0x5b, 0xbe, 0x24, 0x65, 0x51, 0x41, 0x43,
	0x8e, 0x7a, 0x10, 0x0b,
};

/* RFC 8032 test 2: one-byte message 0x72 */
static const uint8_t t2_seed[32] = {
	0x4c, 0xcd, 0x08, 0x9b, 0x28, 0xff, 0x96, 0xda, 0x9d, 0xb6, 0xc3, 0x46,
	0xec, 0x11, 0x4e, 0x0f, 0x5b, 0x8a, 0x31, 0x9f, 0x35, 0xab, 0xa6, 0x24,
	0xda, 0x8c, 0xf6, 0xed, 0x4f, 0xb8, 0xa6, 0xfb,
};
static const uint8_t t2_pub[32] = {
	0x3d, 0x40, 0x17, 0xc3, 0xe8, 0x43, 0x89, 0x5a, 0x92, 0xb7, 0x0a, 0xa7,
	0x4d, 0x1b, 0x7e, 0xbc, 0x9c, 0x98, 0x2c, 0xcf, 0x2e, 0xc4, 0x96, 0x8c,
	0xc0, 0xcd, 0x55, 0xf1, 0x2a, 0xf4, 0x66, 0x0c,
};
static const uint8_t t2_sig[64] = {
	0x92, 0xa0, 0x09, 0xa9, 0xf0, 0xd4, 0xca, 0xb8, 0x72, 0x0e, 0x82, 0x0b,
	0x5f, 0x64, 0x25, 0x40, 0xa2, 0xb2, 0x7b, 0x54, 0x16, 0x50, 0x3f, 0x8f,
	0xb3, 0x76, 0x22, 0x23, 0xeb, 0xdb, 0x69, 0xda, 0x08, 0x5a, 0xc1, 0xe4,
	0x3e, 0x15, 0x99, 0x6e, 0x45, 0x8f, 0x36, 0x13, 0xd0, 0xf1, 0x1d, 0x8c,
	0x38, 0x7b, 0x2e, 0xae, 0xb4, 0x30, 0x2a, 0xee, 0xb0, 0x0d, 0x29, 0x16,
	0x12, 0xbb, 0x0c, 0x00,
};

/* PyCA: seed = SHA-256("akira-ed25519-test"), message = bytes 0..999 mod 256 */
static const uint8_t t3_seed[32] = {
	0x90, 0xe0, 0x8d, 0xb0, 0x72, 0x83, 0x79, 0xd8, 0x29, 0x9c, 0xb1, 0x56,
	0x3c, 0xca, 0xf9, 0xc2, 0x97, 0x13, 0x23, 0x74, 0x13, 0xfc, 0x0d, 0x78,
	0x93, 0xbe, 0x9b, 0xcf, 0x66, 0xbb, 0x9b, 0x3d,
};
static const uint8_t t3_pub[32] = {
	0xda, 0x28, 0x3d, 0xc7, 0xd1, 0x42, 0xe8, 0x1f, 0x57, 0x5a, 0x11, 0xb3,
	0x30, 0x2b, 0x14, 0x12, 0x95, 0x10, 0x27, 0xe5, 0x66, 0xb3, 0xf1, 0x61,
	0xaa, 0x5e, 0xa8, 0x9d, 0x2d, 0x94, 0x8a, 0xbc,
};
static const uint8_t t3_sig[64] = {
	0xc1, 0x27, 0xa2, 0x57, 0x38, 0x6a, 0x8c, 0xd0, 0x8f, 0x1e, 0xe1, 0x86,
	0xd7, 0xac, 0xd2, 0xfb, 0x95, 0xa6, 0xb2, 0x2b, 0xc8, 0xae, 0xf5, 0xd9,
	0x2b, 0x8b, 0x6e, 0xcb, 0x14, 0xf4, 0x79, 0xf2, 0x1e, 0x6b, 0xe9, 0xd9,
	0x62, 0xc8, 0x14, 0x89, 0xc3, 0xd7, 0x38, 0xc1, 0x78, 0x62, 0x53, 0x5e,
	0x5d, 0xa3, 0xc2, 0x28, 0x8b, 0x50, 0xe4, 0x37, 0xb7, 0x41, 0xef, 0x70,
	0xa5, 0x47, 0xd1, 0x0d,
};

ZTEST(ed25519_sign, test_pubkey_from_seed)
{
	uint8_t pub[32];

	zassert_ok(akira_ed25519_pubkey_from_seed(t1_seed, pub));
	zassert_mem_equal(pub, t1_pub, 32);
	zassert_ok(akira_ed25519_pubkey_from_seed(t2_seed, pub));
	zassert_mem_equal(pub, t2_pub, 32);
	zassert_ok(akira_ed25519_pubkey_from_seed(t3_seed, pub));
	zassert_mem_equal(pub, t3_pub, 32);
}

ZTEST(ed25519_sign, test_rfc8032_signatures)
{
	static const uint8_t m2 = 0x72;
	uint8_t sig[64];

	zassert_ok(akira_ed25519_sign(NULL, 0, t1_seed, sig));
	zassert_mem_equal(sig, t1_sig, 64);
	zassert_ok(akira_ed25519_sign(&m2, 1, t2_seed, sig));
	zassert_mem_equal(sig, t2_sig, 64);
}

ZTEST(ed25519_sign, test_long_message_signature)
{
	static uint8_t msg[1000];
	uint8_t sig[64];

	for (size_t i = 0; i < sizeof(msg); i++) {
		msg[i] = (uint8_t)i;
	}
	zassert_ok(akira_ed25519_sign(msg, sizeof(msg), t3_seed, sig));
	zassert_mem_equal(sig, t3_sig, 64);
	zassert_ok(akira_ed25519_verify(msg, sizeof(msg), sig, t3_pub));
}

/* Round trip through the verifier with seeds no vector covers. */
ZTEST(ed25519_sign, test_sign_verify_round_trip)
{
	uint8_t seed[32];
	uint8_t pub[32];
	uint8_t sig[64];
	uint8_t msg[48];

	for (int n = 0; n < 8; n++) {
		for (int i = 0; i < 32; i++) {
			seed[i] = (uint8_t)(n * 37 + i * 11 + (n == 7 ? 0xff : 0));
		}
		for (int i = 0; i < (int)sizeof(msg); i++) {
			msg[i] = (uint8_t)(n ^ (i * 3));
		}
		zassert_ok(akira_ed25519_pubkey_from_seed(seed, pub));
		zassert_ok(akira_ed25519_sign(msg, sizeof(msg), seed, sig));
		zassert_ok(akira_ed25519_verify(msg, sizeof(msg), sig, pub));
		msg[n] ^= 0x01;
		zassert_equal(akira_ed25519_verify(msg, sizeof(msg), sig, pub),
			      -EBADMSG);
	}
}

ZTEST(ed25519_sign, test_null_arguments)
{
	uint8_t out[64];

	zassert_equal(akira_ed25519_pubkey_from_seed(NULL, out), -EINVAL);
	zassert_equal(akira_ed25519_pubkey_from_seed(t1_seed, NULL), -EINVAL);
	zassert_equal(akira_ed25519_sign(NULL, 1, t1_seed, out), -EINVAL);
	zassert_equal(akira_ed25519_sign(NULL, 0, NULL, out), -EINVAL);
	zassert_equal(akira_ed25519_sign(NULL, 0, t1_seed, NULL), -EINVAL);
}

ZTEST_SUITE(ed25519_sign, NULL, NULL, NULL, NULL, NULL);
```
