## boards/esp32s3_supermini_esp32s3_procpu.conf
```kconfig
# =============================================================================
# ESP32-S3 Super Mini Board Configuration for AkiraOS
# ESP32-S3 Mini N4R2: 4MB Flash, 2MB PSRAM (Quad SPI)
# =============================================================================
# MINIMAL CONFIG: BT, WiFi, and heavy subsystems DISABLED.
# Goal: get USB CDC ACM console working first, then re-enable features.
# =============================================================================

###############################################################################
# Flash Size Override (N4R2 = 4MB, prj.conf defaults to 16MB)
###############################################################################
CONFIG_ESPTOOLPY_FLASHSIZE_4MB=y
CONFIG_ESPTOOLPY_FLASHMODE_DIO=y
CONFIG_ESPTOOLPY_FLASHFREQ_40M=y

###############################################################################
# PSRAM (External SPIRAM) - 2MB Quad SPI PSRAM
###############################################################################
CONFIG_ESP_SPIRAM=y
CONFIG_SPIRAM_TYPE_ESPPSRAM16=y
CONFIG_SPIRAM_MODE_QUAD=y
CONFIG_SPIRAM_SPEED_40M=y
CONFIG_ESP_SPIRAM_MEMTEST=n
CONFIG_MEMC=y

###############################################################################
# Thread Local Storage - REQUIRED for ESP32-S3
###############################################################################
CONFIG_THREAD_LOCAL_STORAGE=y

###############################################################################
# Memory Configuration
###############################################################################
CONFIG_HEAP_MEM_POOL_SIZE=32768
CONFIG_MAIN_STACK_SIZE=3072
CONFIG_SYSTEM_WORKQUEUE_STACK_SIZE=1536
CONFIG_SHELL_STACK_SIZE=3072

###############################################################################
# Disable WiFi, BT, Networking (save ~100KB+ DRAM)
###############################################################################
CONFIG_WIFI=n
CONFIG_BT=n
CONFIG_NETWORKING=n

###############################################################################
# Disable heavy subsystems to fit in DRAM
###############################################################################
# MCUboot / OTA - disable for now
CONFIG_BOOTLOADER_MCUBOOT=n
CONFIG_MCUBOOT_IMG_MANAGER=n
CONFIG_IMG_MANAGER=n
CONFIG_IMG_ENABLE_IMAGE_CHECK=n
CONFIG_IMG_ERASE_PROGRESSIVELY=n
CONFIG_STREAM_FLASH=n

# Crypto - disable (not needed without networking/OTA)
CONFIG_MBEDTLS=n
CONFIG_BASE64=n
CONFIG_ENTROPY_GENERATOR=n

# Display - disable for now
CONFIG_DISPLAY=n
CONFIG_MIPI_DBI=n

# FAT filesystem - disable (keep LittleFS only)
CONFIG_DISK_ACCESS=n
CONFIG_FAT_FILESYSTEM_ELM=n
CONFIG_DISK_DRIVERS=n

# POSIX - disable
CONFIG_POSIX_API=n

# WASM runtime - disable for minimal boot
CONFIG_AKIRA_WASM_RUNTIME=n
CONFIG_AKIRA_WASM_API=n
CONFIG_AKIRA_RUNTIME_CUSTOM=n
CONFIG_AKIRA_APP_MANAGER=n

# Websocket - disable
CONFIG_WEBSOCKET_CLIENT=n

# Shell backend telnet - disable (no network)
CONFIG_SHELL_BACKEND_TELNET=n

# Input - disable for now
CONFIG_INPUT=n
CONFIG_INPUT_GPIO_KEYS=n

# SMF - disable if not needed
# CONFIG_SMF=n

# Dynamic threads - disable
CONFIG_DYNAMIC_THREAD=n

# Disable features not needed for minimal boot
CONFIG_AKIRA_BT_HID=n
CONFIG_AKIRA_BT_SHELL=n
CONFIG_AKIRA_BT_ECHO=n
CONFIG_AKIRA_HTTP_SERVER=n
CONFIG_AKIRA_OTA=n
CONFIG_AKIRA_OTA_HTTP=n
CONFIG_AKIRA_EMBEDDED_WEB=n
CONFIG_AKIRA_USB_HID=n
CONFIG_AKIRA_HID=n
CONFIG_AKIRA_HID_KEYBOARD=n
CONFIG_AKIRA_HID_GAMEPAD=n
CONFIG_AKIRA_SETTINGS=n

###############################################################################
# Peripherals (keep minimal)
###############################################################################
CONFIG_SPI=y
CONFIG_I2C=y
CONFIG_GPIO=y

###############################################################################
# USB CDC ACM Console
###############################################################################
CONFIG_USBD_CDC_ACM_CLASS=y
CONFIG_UART_LINE_CTRL=y
CONFIG_UDC_DWC2_STACK_SIZE=4096
CONFIG_USBD_THREAD_STACK_SIZE=4096

###############################################################################
# Logging
###############################################################################
CONFIG_LOG_MODE_IMMEDIATE=y
CONFIG_LOG_BUFFER_SIZE=256
CONFIG_LOG_DEFAULT_LEVEL=3

###############################################################################
# Reduce shell memory usage
###############################################################################
CONFIG_SHELL_HISTORY=n
CONFIG_SHELL_TAB=n
CONFIG_SHELL_TAB_AUTOCOMPLETION=n
CONFIG_SHELL_WILDCARD=n
CONFIG_SHELL_HELP=y
CONFIG_FILE_SYSTEM_SHELL=n
```

## boards/nrf5340dk_nrf5340_cpuapp.conf
```kconfig
CONFIG_WIFI=y
CONFIG_WIFI_ESP_AT=y
CONFIG_WIFI_ESP_AT_MDM_RX_BUF_COUNT=40
CONFIG_WIFI_ESP_AT_PASSIVE_MODE=y
CONFIG_WIFI_ESP_AT_IP_DHCP=y
CONFIG_WIFI_ESP_AT_DNS_USE=y

# The following is needed for zsock_recvfrom to function properly, otherwise DNS lookup will fail
CONFIG_WIFI_ESP_AT_CIPDINFO_USE=y

#CONFIG_WIFI_LOG_LEVEL_DBG=y
#CONFIG_MODEM_LOG_LEVEL_DBG=y
#CONFIG_MODEM_CONTEXT_VERBOSE_DEBUG=y

CONFIG_TEST_RANDOM_GENERATOR=y

# Need this when storage is on flash
CONFIG_MPU_ALLOW_FLASH_WRITE=y

# Need this when storage is on MX25R64
CONFIG_NORDIC_QSPI_NOR=y
CONFIG_NORDIC_QSPI_NOR_FLASH_LAYOUT_PAGE_SIZE=4096

#CONFIG_PM_DEVICE=y
CONFIG_ARM_MPU=y

#CONFIG_SENSOR=y
CONFIG_GPIO=y
CONFIG_I2C=y
#CONFIG_APDS9960_TRIGGER_GLOBAL_THREAD=y
```

## boards/nrf54l15dk_nrf54l15_cpuapp.conf
```kconfig
# BOARD_ZEPHYR: nrf54l15dk/nrf54l15/cpuapp
# BOARD_CHIP: nrf54l15
# BOARD_DESC: Nordic nRF54L15 DK

# Nordic nRF54L15 DK Specific Configuration
# Board: nrf54l15dk/nrf54l15/cpuapp
# SoC: Nordic nRF54L15 (ARM Cortex-M33 @ 128MHz + RISC-V coprocessor)
#
# Note: XIAO nRF54L15 is not yet in Zephyr 4.2.1.
# Using nRF54L15DK as reference platform for nRF54L15 development.

# Memory Configuration - nRF54L15 has 256KB RAM
CONFIG_HEAP_MEM_POOL_SIZE=32768
CONFIG_MAIN_STACK_SIZE=2048
CONFIG_SYSTEM_WORKQUEUE_STACK_SIZE=1024

# Bluetooth (nRF54L15 supports BLE 6.0)
CONFIG_BT=y
CONFIG_BT_PERIPHERAL=y
CONFIG_BT_DEVICE_NAME="AkiraOS-nRF54L15"

# WiFi: not available on nRF54L15
CONFIG_WIFI=n

# IEEE 802.15.4 / Thread / Zigbee support
CONFIG_NET_L2_IEEE802154=y
CONFIG_IEEE802154=y

# GPIO and basic peripherals
CONFIG_GPIO=y

# No SD card slot — disable DISK_ACCESS and SD-based app install
CONFIG_DISK_ACCESS=n
CONFIG_AKIRA_APP_SOURCE_SD=n

# I2C for sensors
CONFIG_I2C=y
CONFIG_SENSOR=y

# SPI
CONFIG_SPI=y

# PWM for LEDs
CONFIG_PWM=y

# ADC
CONFIG_ADC=y

# Flash storage — board-specific NVS and Settings in addition to prj.conf flash
CONFIG_NVS=y

# Settings storage
CONFIG_SETTINGS=y
CONFIG_SETTINGS_NVS=y

# Watchdog
CONFIG_WATCHDOG=y
CONFIG_AKIRA_WDT=y
CONFIG_AKIRA_WASM_WDT=y

# ADC — WASM API (CONFIG_ADC=y already set above)
CONFIG_AKIRA_WASM_ADC=y
CONFIG_AKIRA_WASM_ADC_VREF_MV=3600
CONFIG_AKIRA_WASM_ADC_RESOLUTION=12

# Power Management (nRF54L15 is ultra-low power)
CONFIG_PM=y
CONFIG_PM_DEVICE=y

# USB CDC ACM for console (board has built-in USB)
CONFIG_USB_DEVICE_STACK=y
CONFIG_USB_CDC_ACM=y
CONFIG_UART_LINE_CTRL=y

# Logging — reduced level to save RAM (overrides prj.conf default=3)
CONFIG_LOG_DEFAULT_LEVEL=2
CONFIG_LOG_MODE_MINIMAL=y

# Shell — minimal mode to save RAM
CONFIG_SHELL_MINIMAL=y
CONFIG_SHELL_BACKEND_TELNET=n
CONFIG_SHELL_TELNET_SUPPORT_COMMAND=n
CONFIG_NET_SOCKETS_OFFLOAD=n

# Size optimizations for RAM-constrained nRF54L15
CONFIG_SIZE_OPTIMIZATIONS=y

###############################################################################
# App Manager
###############################################################################
# (CONFIG_AKIRA_APP_MANAGER is enabled in prj.conf)

# NOTE: WAMR optimizations (mini loader, minimal mode) are controlled by
# the WAMR CMake build configuration, not Kconfig options.
```

## boards/sensors.conf
```kconfig
# Configuration overlay for sensor testing
# Add this to prj.conf or use as overlay

# Enable sensor drivers
CONFIG_AKIRA_NRF24L01=y
CONFIG_AKIRA_LSM6DS3=y
CONFIG_AKIRA_INA219=y

# Enable Akira Module System
CONFIG_AKIRA_MODULE=y

# Enable sensor modules
CONFIG_AKIRA_MODULE_NRF24L01=y
CONFIG_AKIRA_MODULE_LSM6DS3=y
CONFIG_AKIRA_MODULE_INA219=y

# Enable required communication interfaces
CONFIG_AKIRA_MODULE_COMM_SPI=y
CONFIG_AKIRA_MODULE_COMM_I2C=y

# SPI Configuration (for NRF24L01)
CONFIG_SPI=y

# I2C Configuration (for LSM6DS3 and INA219)
CONFIG_I2C=y

# GPIO (for NRF24L01 control pins)
CONFIG_GPIO=y
```

## boards/steval_stwinbx1.conf
```kconfig
# ST STEVAL-STWINBX1 Specific Configuration
# Board: steval_stwinbx1
# SoC: STM32U585AI (ARM Cortex-M33 @ 160MHz)

# Memory Configuration
CONFIG_HEAP_MEM_POOL_SIZE=131072
CONFIG_MAIN_STACK_SIZE=4096
CONFIG_SYSTEM_WORKQUEUE_STACK_SIZE=2048

# Bluetooth (via BlueNRG-M2SA module on SPI3)
# BT_SPI is auto-selected based on devicetree hci_spi node
CONFIG_BT=y
CONFIG_BT_HCI=y
CONFIG_BT_HCI_VS=y
CONFIG_BT_BLUENRG_ACI=y
CONFIG_BT_PERIPHERAL=y
CONFIG_BT_DEVICE_NAME="AkiraOS-STWINBX1"

# GPIO and basic peripherals
CONFIG_GPIO=y

# I2C for sensors (STTS22H, IIS2MDC, LPS22DF)
CONFIG_I2C=y

# SPI for sensors (IIS2DLPC, ISM330DHCX, IIS2ICLX)
CONFIG_SPI=y

# Sensor support - STWINBX1 has many sensors
CONFIG_SENSOR=y

# Individual sensor drivers
# Temperature
CONFIG_STTS22H=y

# IMU - 6-axis accelerometer/gyroscope with ML Core
CONFIG_ISM330DHCX=y
CONFIG_ISM330DHCX_TRIGGER_GLOBAL_THREAD=y

# Accelerometer
CONFIG_IIS2DLPC=y
CONFIG_IIS2DLPC_TRIGGER_GLOBAL_THREAD=y

# Inclinometer with ML Core
CONFIG_IIS2ICLX=y

# Magnetometer
CONFIG_IIS2MDC=y
CONFIG_IIS2MDC_TRIGGER_GLOBAL_THREAD=y

# Pressure sensor
# CONFIG_LPS22DF=y  # Use ILPS22QS if available

# ADC
CONFIG_ADC=y

# DAC - Disabled to save flash
# CONFIG_DAC=y

# PWM
CONFIG_PWM=y

# USB (Type-C)
CONFIG_USB_DEVICE_STACK=y
CONFIG_USB_CDC_ACM=y
CONFIG_UART_LINE_CTRL=y

# Flash storage
CONFIG_FLASH=y
CONFIG_FLASH_MAP=y
CONFIG_NVS=y

# SD Card (microSD socket)
CONFIG_DISK_ACCESS=y
CONFIG_SDMMC_STACK=y
CONFIG_FILE_SYSTEM=y
CONFIG_FAT_FILESYSTEM_ELM=y

# Settings storage
CONFIG_SETTINGS=y
CONFIG_SETTINGS_NVS=y

# CAN FD - Disabled to save flash
# CONFIG_CAN=y
# CONFIG_CAN_FD_MODE=y

# Watchdog
CONFIG_WATCHDOG=y

# RTC - disabled until clock source is properly configured in overlay
# CONFIG_RTC=y

# Power Management
CONFIG_PM=y
CONFIG_PM_DEVICE=y


# Crypto hardware acceleration
CONFIG_MBEDTLS=y
CONFIG_MBEDTLS_BUILTIN=y


# Logging - reduced to save flash
CONFIG_LOG=y
CONFIG_LOG_DEFAULT_LEVEL=2

# Shell
CONFIG_SHELL=y
CONFIG_SHELL_BACKEND_SERIAL=y

# Size optimizations for flash-constrained MCUboot slot
CONFIG_SIZE_OPTIMIZATIONS=y
CONFIG_SHELL_MINIMAL=y
CONFIG_LOG_MODE_MINIMAL=y

###############################################################################
# App Manager - Enabled with minimal WAMR for flash-constrained STM32U585AI
###############################################################################
CONFIG_AKIRA_APP_MANAGER=y

# WAMR optimizations for reduced flash footprint
CONFIG_AKIRA_WAMR_MINI_LOADER=y
CONFIG_AKIRA_WAMR_MINIMAL=y
```

## snippets/akira-reference/boards/b_u585i_iot02a.conf
```kconfig
# BOARD_ZEPHYR: b_u585i_iot02a
# BOARD_CHIP: stm32
# BOARD_DESC: STM32U5 IoT Discovery Kit (B-U585I-IOT02A)

# B-U585I-IOT02A Board Configuration
# Large partition build (904KB slot)

# Console (board-specific: SERIAL, PRINTK, EARLY_CONSOLE not in prj.conf)
CONFIG_SERIAL=y
CONFIG_PRINTK=y
CONFIG_EARLY_CONSOLE=y

# Logging — use immediate mode (board-specific override)
CONFIG_LOG_MODE_IMMEDIATE=y

# Memory (768KB SRAM)
CONFIG_HEAP_MEM_POOL_SIZE=262144
CONFIG_MAIN_STACK_SIZE=8192
CONFIG_ISR_STACK_SIZE=4096

# Crypto
CONFIG_CRYPTO=y
# TINYCRYPT not available in this Zephyr configuration; disable to avoid Kconfig warnings
# CONFIG_TINYCRYPT=y
# CONFIG_TINYCRYPT_AES=y
# CONFIG_TINYCRYPT_SHA256=y

# Settings
CONFIG_SETTINGS=y

# Shell
CONFIG_SHELL_BACKEND_TELNET=y

# USB
# CONFIG_USB_DEVICE_STACK=y
# CONFIG_USB_DEVICE_PRODUCT="AkiraOS B-U585I-IOT02A"
# CONFIG_USB_CDC_ACM=y
# CONFIG_UART_LINE_CTRL=y

# OTA over USB - Disabled as it is not yet supported and tested on B-U585I-IOT02A
CONFIG_AKIRA_OTA_USB=n    

# Networking (Ethernet — no WiFi offload, static config)
CONFIG_NET_L2_ETHERNET=y
CONFIG_NET_SOCKETS_OFFLOAD=n

# LittleFS (board override — prj.conf enables both FAT+LittleFS; keep only LittleFS here)
CONFIG_FAT_FILESYSTEM_ELM=n
CONFIG_FILE_SYSTEM_LITTLEFS=y
# No SD card slot on this board — disable DISK_ACCESS and SD app source
CONFIG_DISK_ACCESS=n
CONFIG_AKIRA_APP_SOURCE_SD=n

# Disable WiFi and ESP32-specific features
CONFIG_WIFI=n
CONFIG_ESP_SPIRAM=n

# Network socket service stack - increased for OTA and upload operations
CONFIG_NET_SOCKETS_SERVICE_STACK_SIZE=4096

# MCUboot signing key for imgtool (STM32 boards sign images via Zephyr's imgtool)
CONFIG_MCUBOOT_SIGNATURE_KEY_FILE="bootloader/mcuboot/root-rsa-2048.pem"
```

## snippets/akira-reference/boards/esp32_devkitc_procpu.conf
```kconfig
# BOARD_ZEPHYR: esp32_devkitc/esp32/procpu
# BOARD_CHIP: esp32
# BOARD_DESC: ESP32 DevKitC

# ESP32 DevKitC

# WiFi Configuration
CONFIG_WIFI=y
CONFIG_WIFI_ESP32=y
CONFIG_NET_L2_WIFI_MGMT=y
CONFIG_ESP32_WIFI_STA_AUTO_DHCPV4=y
# ESP32-WROOM-32 has no external PSRAM — SPIRAM/PSRAM options must be off.
# If using an ESP32-WROVER module (which has 4MB/8MB PSRAM), you can
# re-enable: CONFIG_ESP_SPIRAM, CONFIG_MEMC, CONFIG_AKIRA_FONTS_IN_PSRAM.

###############################################################################
# DRAM budget: ~300 KB total, WiFi stack alone uses ~100 KB.
# Aggressive DRAM reduction is required — total savings target: ~215 KB.
###############################################################################

# WASM runtime enabled with a reduced heap to fit in DRAM.
# ESP32-WROOM-32 has ~300 KB usable DRAM; WiFi + mbedTLS consume ~150 KB.
# Tune CONFIG_WAMR_HEAP_SIZE downward if link-time DRAM overflow is reported.
# Set to 0 and also set CONFIG_AKIRA_WASM_RUNTIME=n to disable WASM entirely.
CONFIG_WAMR_HEAP_SIZE=32768

# Reduce kernel heap from 64 KB (prj.conf default) to 8 KB — saves 57 KB.
# The DevKitC is a development board; large dynamic allocations are not needed.
CONFIG_HEAP_MEM_POOL_SIZE=8192

# Telnet shell backend disabled — saves stack + internal buffers (~4 KB).
CONFIG_SHELL_BACKEND_TELNET=n
CONFIG_SHELL_TELNET_SUPPORT_COMMAND=n

# Tighten network buffers (prj.conf sets 12/10 × 256 B; cut to 4 × 128 B).
CONFIG_NET_BUF_RX_COUNT=4
CONFIG_NET_BUF_TX_COUNT=4
CONFIG_NET_PKT_RX_COUNT=4
CONFIG_NET_PKT_TX_COUNT=4
CONFIG_NET_MAX_CONN=2

# OTA over HTTP is impractical without PSRAM (no buffer for the full image).
CONFIG_AKIRA_OTA=n
CONFIG_AKIRA_OTA_HTTP=n

# Embedded web server not useful for headless DevKitC.
CONFIG_AKIRA_HTTP_SERVER=n

# Settings encryption requires mbedTLS AES; disable to slim BSS.
CONFIG_AKIRA_SETTINGS_ENCRYPTION=n


# Default stack sizes
CONFIG_MAIN_STACK_SIZE=4096

# Shell and size optimizations for headless DevKitC
CONFIG_SHELL_HISTORY=n
CONFIG_SHELL_MINIMAL=y
CONFIG_SIZE_OPTIMIZATIONS=y
```
