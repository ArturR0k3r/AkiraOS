## boards/esp32h2_devkitm_esp32h2.conf
```kconfig
# BOARD_ZEPHYR: esp32h2_devkitm/esp32h2
# BOARD_CHIP: esp32h2
# BOARD_DESC: ESP32-H2 DevKitM (RISC-V)
# ESP32-H2: RISC-V @ 96MHz, 320KB SRAM, 2-4MB Flash
# Radios: BLE 5.3 + IEEE 802.15.4 (Thread/Zigbee) — NO WiFi
#
# IMPORTANT: ESP32-H2 SOC support requires Zephyr 4.3.0.
# Run `west update` before building for this target.
# Verify board target name: `west boards | grep esp32h2`

###############################################################################
# Memory Configuration — 320KB SRAM is very constrained
# No WiFi stack frees ~100KB vs C6/C3 — helps but still tight.
###############################################################################
CONFIG_HEAP_MEM_POOL_SIZE=32768
CONFIG_MAIN_STACK_SIZE=3072
CONFIG_SYSTEM_WORKQUEUE_STACK_SIZE=1536
CONFIG_SHELL_STACK_SIZE=3072
CONFIG_WAMR_HEAP_SIZE=65536

###############################################################################
# Thread Local Storage — MANDATORY for WAMR on RISC-V
# Without this, Zephyr does not manage the RISC-V thread pointer (tp) register,
# leaving garbage values that cause WAMR to crash on TLS variable access.
###############################################################################
CONFIG_THREAD_LOCAL_STORAGE=y

###############################################################################
# NO WiFi — H2 has no WiFi radio hardware
# Do NOT add CONFIG_WIFI_ESP32, CONFIG_NET_L2_WIFI_MGMT, or
# CONFIG_NET_SOCKETS_OFFLOAD here. They will not compile on H2.
###############################################################################
CONFIG_WIFI=n
CONFIG_NET_SOCKETS_OFFLOAD=n

# Shell: no Telnet backend (requires TCP/WiFi)
CONFIG_SHELL_BACKEND_TELNET=n
CONFIG_SHELL_TELNET_SUPPORT_COMMAND=n

# HTTP server requires WiFi/TCP connectivity — disable on H2
CONFIG_AKIRA_HTTP_SERVER=n

###############################################################################
# Networking — Thread (IEEE 802.15.4 + IPv6 mesh)
# Reduced buffer counts to save RAM; keep TCP+IPv4 enabled to avoid
# conflicts with prj.conf settings that depend on them.
###############################################################################
CONFIG_NETWORKING=y
CONFIG_NET_IPV6=y
CONFIG_NET_UDP=y
CONFIG_NET_PKT_RX_COUNT=4
CONFIG_NET_PKT_TX_COUNT=4
CONFIG_NET_BUF_RX_COUNT=8
CONFIG_NET_BUF_TX_COUNT=8

###############################################################################
# Bluetooth BLE 5.3
###############################################################################
CONFIG_BT=y
CONFIG_BT_PERIPHERAL=y
CONFIG_BT_DEVICE_NAME="AkiraOS-H2"

###############################################################################
# IEEE 802.15.4 — Thread / Zigbee (H2's primary connectivity feature)
###############################################################################
CONFIG_NET_L2_IEEE802154=y
CONFIG_IEEE802154=y

###############################################################################
# Peripherals
###############################################################################
CONFIG_SPI=y
CONFIG_I2C=y
CONFIG_SENSOR=y
CONFIG_ADC=y
CONFIG_WATCHDOG=y
CONFIG_PWM=n

###############################################################################
# Flash and Storage — XIP from Flash
###############################################################################
CONFIG_FLASH=y
CONFIG_FLASH_MAP=y
CONFIG_FLASH_PAGE_LAYOUT=y
CONFIG_NVS=y
CONFIG_SETTINGS=y
CONFIG_SETTINGS_NVS=y
CONFIG_STREAM_FLASH=y
CONFIG_BOOTLOADER_MCUBOOT=y
CONFIG_MCUBOOT_IMG_MANAGER=y
CONFIG_IMG_MANAGER=y
CONFIG_IMG_ENABLE_IMAGE_CHECK=y
CONFIG_IMG_ERASE_PROGRESSIVELY=y

###############################################################################
# LittleFS — WASM app storage on internal flash
###############################################################################
CONFIG_FILE_SYSTEM=y
CONFIG_FILE_SYSTEM_LITTLEFS=y
CONFIG_FS_LITTLEFS_FC_HEAP_SIZE=256

###############################################################################
# SD Card — optional; disable if RAM overflows at link time
# (first cut if linker reports DRAM overflow: set CONFIG_AKIRA_SD_CARD=n)
###############################################################################
CONFIG_SDHC=y
CONFIG_DISK_ACCESS=y
CONFIG_FAT_FILESYSTEM_ELM=y
CONFIG_FS_FATFS_LFN=y
CONFIG_FS_FATFS_MAX_LFN=255
CONFIG_FS_FATFS_CUSTOM_MOUNT_POINT_COUNT=1
CONFIG_FS_FATFS_CUSTOM_MOUNT_POINTS="SD"
CONFIG_AKIRA_SD_CARD=y
CONFIG_AKIRA_APP_SOURCE_SD=y

###############################################################################
# Shell — minimal mode to conserve RAM
###############################################################################
CONFIG_SHELL_MINIMAL=y
CONFIG_SHELL_TAB=n
CONFIG_SHELL_TAB_AUTOCOMPLETION=n
CONFIG_SHELL_WILDCARD=n
CONFIG_SHELL_HELP=y
CONFIG_SHELL_HELP_ON_WRONG_ARGUMENT_COUNT=n

###############################################################################
# Logging — immediate mode (MINIMAL conflicts with prj.conf LOG_PRINTK;
# LOG_BUFFER_SIZE is only valid in DEFERRED mode)
###############################################################################
CONFIG_LOG_MODE_IMMEDIATE=y
CONFIG_LOG_DEFAULT_LEVEL=2
CONFIG_LOG_MAX_LEVEL=3

###############################################################################
# WAMR — AOT DISABLED
###############################################################################
CONFIG_WAMR_AOT_SUPPORT=n

###############################################################################
# App Manager — minimal due to RAM constraints
###############################################################################
CONFIG_AKIRA_APP_MANAGER=y
CONFIG_MAX_CONTAINERS=2
CONFIG_AKIRA_WASM_APP_STACK_SIZE=3072

###############################################################################
# Size optimizations
###############################################################################
CONFIG_SIZE_OPTIMIZATIONS=y
```

## boards/esp32s3_devkitm_esp32s3_procpu.conf
```kconfig
###############################################################################
# ESP32-S3 DevKitM Board Configuration
# ESP32-S3 N16R8 Module: 16MB Flash, 8MB PSRAM (OPI)
# v1.3.4: Stack Profile = BALANCED (default for this board)
###############################################################################

###############################################################################
# Stack Profile (BALANCED for ESP32-S3 with PSRAM backup)
###############################################################################
CONFIG_AKIRA_PROFILE_BALANCED=y

###############################################################################
# PSRAM (External SPIRAM) - 8MB OPI PSRAM
###############################################################################
CONFIG_ESP_SPIRAM=y
# 8MB PSRAM = 8388608 bytes
CONFIG_ESP_SPIRAM_SIZE=8388608
CONFIG_ESP_SPIRAM_HEAP_SIZE=4194304
CONFIG_SPIRAM_MODE_OCT=y
CONFIG_SPIRAM_TYPE_ESPPSRAM64=y
# Note: ESP32-S3 only supports 40MHz SPIRAM speed
CONFIG_SPIRAM_SPEED_40M=y
CONFIG_MEMC=y
CONFIG_SHARED_MULTI_HEAP=y
# Skip memtest for faster boot
CONFIG_ESP_SPIRAM_MEMTEST=n

###############################################################################
# Memory Configuration (with PSRAM) - Keep DRAM usage low
###############################################################################
# Reduce internal DRAM heap - use PSRAM for large allocs
# v1.3.4: Reduced from 12288 to 8192 (saves 4KB) - PSRAM handles large allocations
CONFIG_HEAP_MEM_POOL_SIZE=8192
CONFIG_MAIN_STACK_SIZE=2048
CONFIG_SYSTEM_WORKQUEUE_STACK_SIZE=768
CONFIG_SHELL_STACK_SIZE=2048
# Reduce ISR stack and idle stack
CONFIG_ISR_STACK_SIZE=1536
CONFIG_IDLE_STACK_SIZE=256

###############################################################################
# WiFi - Enable with AKIRA_WIFI for auto-deps
###############################################################################
CONFIG_AKIRA_WIFI=y
CONFIG_WIFI_ESP32=y
CONFIG_ESP32_WIFI_STA_AUTO_DHCPV4=y
# Move WiFi/NET buffers to PSRAM to free DRAM
CONFIG_ESP32_WIFI_NET_ALLOC_SPIRAM=y
# Disable AMPDU to reduce memory
CONFIG_ESP32_WIFI_AMPDU_TX_ENABLED=n
CONFIG_ESP32_WIFI_AMPDU_RX_ENABLED=n

###############################################################################
# Network Buffer Configuration - reduced for low DRAM
###############################################################################
CONFIG_NET_BUF_DATA_SIZE=128
CONFIG_NET_PKT_RX_COUNT=6
CONFIG_NET_PKT_TX_COUNT=6
CONFIG_NET_BUF_RX_COUNT=12
CONFIG_NET_BUF_TX_COUNT=12
# Reduce TCP/UDP buffers
CONFIG_NET_TCP_RECV_QUEUE_TIMEOUT=200

###############################################################################
# SPI & I2C for peripherals
###############################################################################
CONFIG_SPI=y
CONFIG_I2C=y
CONFIG_SENSOR=y

###############################################################################
# Display
###############################################################################
CONFIG_MIPI_DBI=y

###############################################################################
# PSRAM Features
###############################################################################
# v1.3.4: Place large static buffers in PSRAM (8MB available)
# This keeps DRAM free for kernel allocations and stack
CONFIG_AKIRA_FONTS_IN_PSRAM=y
CONFIG_AKIRA_FRAMEBUFFER_IN_PSRAM=y
CONFIG_OCRE_WAMR_HEAP_BUFFER_IN_PSRAM=y

###############################################################################
# OCRE Memory (with PSRAM - larger buffers)
###############################################################################
CONFIG_OCRE_WAMR_HEAP_BUFFER_SIZE=1048576
CONFIG_OCRE_CONTAINER_DEFAULT_STACK_SIZE=3072
CONFIG_OCRE_CONTAINER_DEFAULT_HEAP_SIZE=4096
CONFIG_MAX_CONTAINERS=4

###############################################################################
# ESP32-S3 Flash Configuration
###############################################################################
CONFIG_ESPTOOLPY_FLASHSIZE_16MB=y
CONFIG_ESPTOOLPY_FLASHMODE_DIO=y
CONFIG_ESPTOOLPY_FLASHFREQ_40M=y

###############################################################################
# Logging - Immediate mode for debugging
###############################################################################
CONFIG_LOG_MODE_IMMEDIATE=y

###############################################################################
# Settings Backend (NVS for ESP32)
###############################################################################
CONFIG_SETTINGS_NVS=y

###############################################################################
# Optional Features (uncomment to enable)
###############################################################################
# CONFIG_AKIRA_HTTP_SERVER=y
# CONFIG_AKIRA_EMBEDDED_WEB=y
# CONFIG_SHELL_BACKEND_TELNET=y
# CONFIG_AKIRA_OTA_HTTP=y

CONFIG_AKIRA_BT_ECHO=y
```

## boards/esp32s3_devkitm_esp32s3_procpu_NO_PSRAM.conf
```kconfig
# ESP32-S3 DevKitM (NO PSRAM) Configuration
# Variant of esp32s3_devkitm_esp32s3_procpu with external PSRAM disabled

###############################################################################
# PSRAM (External SPIRAM) DISABLED
###############################################################################
CONFIG_ESP_SPIRAM=n
# CONFIG_ESP_SPIRAM_SIZE is undefined
# CONFIG_SPIRAM_MODE_OCT is undefined
CONFIG_AKIRA_PSRAM=n
# CONFIG_SPIRAM_TYPE_ESPPSRAM64 is undefined
# CONFIG_SPIRAM_SPEED_* are undefined

# Disable MEMC driver - not needed without PSRAM
CONFIG_MEMC=n

# Ensure we do not try to place rodata in PSRAM
CONFIG_SPIRAM_RODATA=n

# PSRAM memtest irrelevant
CONFIG_ESP_SPIRAM_MEMTEST=n

###############################################################################
# Thread Local Storage - REQUIRED for ESP32-S3 WAMR
###############################################################################
CONFIG_THREAD_LOCAL_STORAGE=y

###############################################################################
# Memory Configuration (no PSRAM)
###############################################################################
# Increase internal DRAM allocations to compensate for missing PSRAM
CONFIG_HEAP_MEM_POOL_SIZE=131072
CONFIG_MAIN_STACK_SIZE=4096
CONFIG_SYSTEM_WORKQUEUE_STACK_SIZE=2048
CONFIG_SHELL_STACK_SIZE=4096

# Shared Multi-Heap disabled (no external heap)
#CONFIG_SHARED_MULTI_HEAP=n

###############################################################################
# ESP32-S3 WiFi/BT
###############################################################################
CONFIG_WIFI=y
CONFIG_ESP32_WIFI_STA_AUTO_DHCPV4=y

# SPI for display
CONFIG_SPI=y

# Sensor support
CONFIG_I2C=y
CONFIG_SENSOR=y

###############################################################################
# App Manager & PSRAM-dependent features disabled
###############################################################################
CONFIG_AKIRA_APP_MANAGER=n
CONFIG_AKIRA_FONTS_IN_PSRAM=n
CONFIG_AKIRA_FRAMEBUFFER_IN_PSRAM=n

# WAMR Heap: use internal default (smaller) when no PSRAM available
CONFIG_WAMR_HEAP_SIZE=262144

# Limit max containers to save memory
CONFIG_MAX_CONTAINERS=2

###############################################################################
# Logging
###############################################################################
CONFIG_LOG_MODE_IMMEDIATE=y

CONFIG_AKIRA_BT_ECHO=y
CONFIG_AKIRA_EMBEDDED_WEB=n

###############################################################################
# USB Stack
###############################################################################
CONFIG_UDC_DWC2_STACK_SIZE=4096
CONFIG_USBD_THREAD_STACK_SIZE=4096
```

## boards/esp32s3_supermini/Kconfig.esp32s3_supermini
```kconfig
# ESP32-S3 Super Mini board configuration

# Copyright (c) 2026 AkiraOS
# SPDX-License-Identifier: Apache-2.0

config BOARD_ESP32S3_SUPERMINI
	select SOC_ESP32S3_MINI_N4R2
	select SOC_ESP32S3_PROCPU if BOARD_ESP32S3_SUPERMINI_ESP32S3_PROCPU
	select SOC_ESP32S3_APPCPU if BOARD_ESP32S3_SUPERMINI_ESP32S3_APPCPU
```

## boards/esp32s3_supermini/board.yml
```yaml
board:
  name: esp32s3_supermini
  full_name: ESP32-S3 Super Mini
  vendor: generic
  socs:
  - name: esp32s3
```
