## snippets/akira-reference/boards/esp32s3_devkitm_esp32s3_procpu.conf
```kconfig
# BOARD_ZEPHYR: esp32s3_devkitm/esp32s3/procpu
# BOARD_CHIP: esp32s3
# BOARD_DESC: ESP32-S3 DevKitM

# ESP32-S3 Specific Configuration
# ESP32-S3 N16R8 Module: 16MB Flash, 8MB PSRAM (OPI)

###############################################################################
# PSRAM (External SPIRAM) Configuration - 8MB OPI PSRAM
###############################################################################
CONFIG_ESP_SPIRAM=y
CONFIG_ESP_SPIRAM_SIZE=8388608
CONFIG_ESP_SPIRAM_HEAP_SIZE=2097152
CONFIG_SPIRAM_MODE_OCT=y
CONFIG_AKIRA_PSRAM=y
CONFIG_SPIRAM_TYPE_ESPPSRAM64=y
CONFIG_SPIRAM_SPEED_80M=y

# Enable MEMC driver - REQUIRED for PSRAM configuration
# This allows WAMR heap buffer to be placed in PSRAM instead of internal DRAM
CONFIG_MEMC=y

# Optional: Move read-only data to PSRAM to free internal DRAM 
CONFIG_SPIRAM_RODATA=n

# Skip PSRAM memtest for faster boot (enable for debugging)
CONFIG_ESP_SPIRAM_MEMTEST=n

###############################################################################
# Thread Local Storage
###############################################################################
# THREAD_LOCAL_STORAGE depends on ARCH_HAS_THREAD_LOCAL_STORAGE which is not
# set for Xtensa in Zephyr 4.x (upstream gap). Enabling it would pull in
# picolibc's z_errno_wrap while we use Newlib, causing a linker error.
# WAMR manages THREADPTR initialization independently of Zephyr TLS.
# CONFIG_THREAD_LOCAL_STORAGE is intentionally not set here.

###############################################################################
# Memory Configuration (with PSRAM)
###############################################################################
# Keep internal DRAM heap smaller - use PSRAM for large allocations
CONFIG_HEAP_MEM_POOL_SIZE=65536
CONFIG_MAIN_STACK_SIZE=4096
CONFIG_SYSTEM_WORKQUEUE_STACK_SIZE=2048
# Shell needs larger stack for WASM operations
CONFIG_SHELL_STACK_SIZE=4096

# WiFi Configuration
CONFIG_WIFI=y
CONFIG_WIFI_ESP32=y
CONFIG_ESP_WIFI_HEAP_SPIRAM=y
CONFIG_ESP32_WIFI_STA_AUTO_DHCPV4=y
CONFIG_NET_L2_WIFI_MGMT=y
CONFIG_SHELL_BACKEND_TELNET=y
CONFIG_SHELL_TELNET_SUPPORT_COMMAND=y
CONFIG_NET_SOCKETS_OFFLOAD=y

# Shared Multi-Heap for PSRAM allocation
CONFIG_SHARED_MULTI_HEAP=y

###############################################################################
# SPI, I2C, Sensors
###############################################################################
CONFIG_SPI=y

# Sensor support
CONFIG_I2C=y
CONFIG_SENSOR=y

###############################################################################
# Display — disabled on generic ESP32-S3 DevKitM (no display hardware)
###############################################################################
CONFIG_DISPLAY=n
CONFIG_MIPI_DBI=n
CONFIG_MIPI_DBI_SPI=n

# Disable AMPDU (reduces memory usage)
CONFIG_ESP32_WIFI_AMPDU_TX_ENABLED=n
CONFIG_ESP32_WIFI_AMPDU_RX_ENABLED=n

###############################################################################
# Network Buffer Configuration
###############################################################################
CONFIG_NET_PKT_RX_COUNT=8
CONFIG_NET_PKT_TX_COUNT=8
CONFIG_NET_BUF_RX_COUNT=16
CONFIG_NET_BUF_TX_COUNT=16

###############################################################################
# App Manager - Enabled with PSRAM support
###############################################################################
# With 8MB PSRAM, we can enable App Manager
# WASM runtime (WAMR) heaps will use PSRAM

# Display assets disabled (no display hardware on DevKitM)
CONFIG_AKIRA_FONTS_IN_PSRAM=n
CONFIG_AKIRA_FRAMEBUFFER_IN_PSRAM=n

###############################################################################
# WAMR Memory Configuration - Using PSRAM for large buffers
###############################################################################
# With CONFIG_MEMC=y and ESP32-S3 PSRAM support,
# the WAMR heap buffer is placed in external SPIRAM
# This allows much larger WAMR heap without consuming internal DRAM
# Configure WAMR heap size for PSRAM placement
CONFIG_WAMR_HEAP_SIZE=1048576

# Limit max containers to save memory
CONFIG_MAX_CONTAINERS=4

###############################################################################
# Logging - Use immediate mode for debugging
###############################################################################
CONFIG_LOG_MODE_IMMEDIATE=y

CONFIG_AKIRA_EMBEDDED_WEB=y

###############################################################################
# SD Card Support — SPI-SDHC via GPIO11/12/13/14
# MOSI=GPIO11, SCK=GPIO12, MISO=GPIO13, CS=GPIO14
# DTS node spi_sdhc0 on SPI2 (see akiraconsole_esp32s3_procpu.overlay)
# DISK_DRIVER_SDMMC is auto-selected by DTS (zephyr,sdmmc-disk node enabled)
###############################################################################
CONFIG_AKIRA_SD_CARD=y
CONFIG_SDHC=y
CONFIG_SDMMC_STACK=y
CONFIG_FAT_FILESYSTEM_ELM=y
CONFIG_FS_FATFS_LFN=y
CONFIG_FS_FATFS_MAX_LFN=255
CONFIG_FS_FATFS_CUSTOM_MOUNT_POINT_COUNT=1
CONFIG_FS_FATFS_CUSTOM_MOUNT_POINTS="SD"
CONFIG_AKIRA_APP_SOURCE_SD=y
CONFIG_AKIRA_SD_XIP=y

# Network socket service stack - increased for OTA and upload operations
CONFIG_NET_SOCKETS_SERVICE_STACK_SIZE=4096
```

## snippets/akira-reference/boards/nucleo_l476rg.conf
```kconfig
# BOARD_ZEPHYR: nucleo_l476rg
# BOARD_CHIP: stm32
# BOARD_DESC: ST Nucleo L476RG

# SPDX-License-Identifier: Apache-2.0

# enable uart driver
CONFIG_SERIAL=y

# enable GPIO
CONFIG_GPIO=y

# console
CONFIG_CONSOLE=y
CONFIG_UART_CONSOLE=y

#enable MPU
CONFIG_ARM_MPU=y

# Enable HW stack protection
CONFIG_HW_STACK_PROTECTION=y

# =============================================================================
# Memory budget overrides for STM32L476RG (96KB SRAM)
# =============================================================================

# Reduce kernel heap from 64KB to 8KB — biggest single RAM saver
CONFIG_HEAP_MEM_POOL_SIZE=8192

# Reduce thread stacks
CONFIG_MAIN_STACK_SIZE=2048
CONFIG_SYSTEM_WORKQUEUE_STACK_SIZE=512
CONFIG_IDLE_STACK_SIZE=256

# Reduce net buffers (no WiFi/Ethernet on Nucleo)
CONFIG_NET_BUF_RX_COUNT=4
CONFIG_NET_BUF_TX_COUNT=4
CONFIG_NET_PKT_RX_COUNT=4
CONFIG_NET_PKT_TX_COUNT=4
CONFIG_NET_BUF_DATA_SIZE=64
CONFIG_NET_MAX_CONN=4
CONFIG_NET_TCP_MAX_SEND_WINDOW_SIZE=512
CONFIG_NET_TCP_MAX_RECV_WINDOW_SIZE=512

# No SD card on Nucleo — disable FAT filesystem
CONFIG_FAT_FILESYSTEM_ELM=n
CONFIG_FS_FATFS_LFN=n
CONFIG_DISK_ACCESS=n

# No WiFi/BT — disable WebSocket and OTA transports that need them
CONFIG_WEBSOCKET_CLIENT=n
CONFIG_HTTP_SERVER=n

# Reduce app slots and WASM containers to fit SRAM
CONFIG_AKIRA_APP_MAX_INSTALLED=4
CONFIG_AKIRA_APP_MAX_RUNNING=1
CONFIG_MAX_CONTAINERS=1
CONFIG_AKIRA_WASM_APP_STACK_SIZE=2048

# No HTTP/mDNS — no WiFi/Ethernet on Nucleo
CONFIG_AKIRA_HTTP_SERVER=n
CONFIG_AKIRA_MDNS=n

# Reduce shell memory usage
CONFIG_SHELL_HISTORY=n
CONFIG_SHELL_TAB_AUTOCOMPLETION=n
CONFIG_SHELL_CMD_BUFF_SIZE=64

# Reduce log buffer
CONFIG_LOG_BUFFER_SIZE=256

# Disable stack statistics to save a little RAM
CONFIG_SYS_HEAP_RUNTIME_STATS=n

# MCUboot signing key for imgtool (STM32 boards sign images via Zephyr's imgtool)
CONFIG_MCUBOOT_SIGNATURE_KEY_FILE="bootloader/mcuboot/root-rsa-2048.pem"
```

## snippets/akira-reference/boards/rpi_pico.conf
```kconfig
# BOARD_ZEPHYR: rpi_pico
# BOARD_CHIP: rp2040
# BOARD_DESC: Raspberry Pi Pico (RP2040, dual Cortex-M0+)
# BOARD_ALIAS: pico rp2040

# =============================================================================
# RP2040 — 264 KB SRAM, dual Cortex-M0+ @ 133 MHz, no WiFi, no PSRAM
# Shell via USB CDC-ACM (built-in USB), not UART.
# =============================================================================

###############################################################################
# Memory — tight, no PSRAM
###############################################################################
CONFIG_AKIRA_PSRAM=n
CONFIG_HEAP_MEM_POOL_SIZE=32768
CONFIG_MAIN_STACK_SIZE=4096
CONFIG_SYSTEM_WORKQUEUE_STACK_SIZE=2048
CONFIG_WAMR_HEAP_SIZE=65536

###############################################################################
# USB CDC-ACM for shell (RP2040 has hardware USB, no UART on standard Pico)
###############################################################################
CONFIG_USB_DEVICE_STACK=y
CONFIG_USB_CDC_ACM=y
CONFIG_UART_CONSOLE=n
CONFIG_USB_DEVICE_MANUFACTURER="Akira"
CONFIG_USB_DEVICE_PRODUCT="AkiraOS"

###############################################################################
# No WiFi on bare Pico (use Pico W config for WiFi)
###############################################################################
CONFIG_WIFI=n
CONFIG_NET_L2_WIFI_MGMT=n

###############################################################################
# Bluetooth — not available on bare Pico (no radio)
###############################################################################
CONFIG_BT=n

###############################################################################
# GPIO and basic peripherals
###############################################################################
CONFIG_GPIO=y
CONFIG_I2C=y
CONFIG_SPI=y
CONFIG_ADC=y
CONFIG_PWM=y

###############################################################################
# No SD card slot on bare Pico
###############################################################################
CONFIG_DISK_ACCESS=n
CONFIG_AKIRA_APP_SOURCE_SD=n

###############################################################################
# Flash storage — RP2040 has 2 MB QSPI flash, use LittleFS
###############################################################################
CONFIG_FLASH=y
CONFIG_FLASH_MAP=y
CONFIG_NVS=y
CONFIG_SETTINGS=y
CONFIG_SETTINGS_NVS=y

###############################################################################
# Watchdog
###############################################################################
CONFIG_WATCHDOG=y
CONFIG_AKIRA_WDT=y
CONFIG_AKIRA_WASM_WDT=y

###############################################################################
# Power management — basic only (no DSP/radio sleep states)
###############################################################################
CONFIG_PM=y
CONFIG_PM_DEVICE=y

###############################################################################
# Logging — minimal to save RAM
###############################################################################
CONFIG_LOG_DEFAULT_LEVEL=2
CONFIG_LOG_MODE_MINIMAL=y

###############################################################################
# Shell — minimal mode to save RAM
###############################################################################
CONFIG_SHELL_MINIMAL=y
CONFIG_SHELL_HISTORY=n
CONFIG_SHELL_BACKEND_TELNET=n

###############################################################################
# Cortex-M0+ has no hardware FPU and no unaligned memory access
# WAMR must run in interpreter mode (no AOT for Cortex-M0+)
###############################################################################
CONFIG_WAMR_AOT_SUPPORT=n

###############################################################################
# Size optimisations for RAM-constrained board
###############################################################################
CONFIG_SIZE_OPTIMIZATIONS=y
```
