## boards/akiraconsole/Kconfig.akiraconsole
```kconfig
# Akira Console board configuration
# Copyright (c) 2026 AkiraOS
# SPDX-License-Identifier: Apache-2.0

config BOARD_AKIRACONSOLE
	select SOC_ESP32S3_MINI_N4R2
	select SOC_ESP32S3_PROCPU if BOARD_AKIRACONSOLE_ESP32S3_PROCPU
	select SOC_ESP32S3_APPCPU if BOARD_AKIRACONSOLE_ESP32S3_APPCPU
```

## boards/akiraconsole/akiraconsole_esp32s3_procpu_defconfig
```kconfig
# Akira Console - ESP32-S3 ProCPU Configuration
# Derived from esp32s3_devkitm_esp32s3_procpu
# Enable PSRAM and DevKitM-friendly defaults

CONFIG_ESP_SPIRAM=y
CONFIG_ESP_SPIRAM_SIZE=8388608
CONFIG_ESP_SPIRAM_HEAP_SIZE=2097152
CONFIG_SPIRAM_MODE_OCT=y
CONFIG_AKIRA_PSRAM=y
CONFIG_SPIRAM_TYPE_ESPPSRAM64=y
CONFIG_SPIRAM_SPEED_80M=y
CONFIG_MEMC=y
CONFIG_SPIRAM_RODATA=n
CONFIG_ESP_SPIRAM_MEMTEST=n
CONFIG_THREAD_LOCAL_STORAGE=y
CONFIG_HEAP_MEM_POOL_SIZE=65536
CONFIG_MAIN_STACK_SIZE=4096
CONFIG_SYSTEM_WORKQUEUE_STACK_SIZE=2048
CONFIG_SHELL_STACK_SIZE=4096
CONFIG_SHARED_MULTI_HEAP=y
CONFIG_WIFI=y
CONFIG_ESP32_WIFI_STA_AUTO_DHCPV4=y
CONFIG_SPI=y
CONFIG_I2C=y
CONFIG_SENSOR=y
CONFIG_ESP32_WIFI_AMPDU_TX_ENABLED=n
CONFIG_ESP32_WIFI_AMPDU_RX_ENABLED=n
CONFIG_NET_BUF_DATA_SIZE=128
CONFIG_NET_PKT_RX_COUNT=8
CONFIG_NET_PKT_TX_COUNT=8
CONFIG_NET_BUF_RX_COUNT=16
CONFIG_NET_BUF_TX_COUNT=16
CONFIG_AKIRA_APP_MANAGER=y
CONFIG_AKIRA_FONTS_IN_PSRAM=y
CONFIG_AKIRA_FRAMEBUFFER_IN_PSRAM=y
CONFIG_WAMR_HEAP_SIZE=1048576
CONFIG_MAX_CONTAINERS=4
CONFIG_LOG_MODE_IMMEDIATE=y
CONFIG_AKIRA_BT_ECHO=y
CONFIG_AKIRA_EMBEDDED_WEB=y
CONFIG_UDC_DWC2_STACK_SIZE=4096
CONFIG_USBD_THREAD_STACK_SIZE=4096
```

## boards/akiraconsole/board.yml
```yaml
board:
  name: akiraconsole
  full_name: Akira Console (ESP32-S3 DevKitM ProCPU)
  vendor: akira
  socs:
  - name: esp32s3
```

## boards/esp32_devkitc_wroom.conf
```kconfig
# SPDX-License-Identifier: Apache-2.0

CONFIG_BOARD_AKIRA_CONSOLE=y
CONFIG_SOC_ESP32=y
CONFIG_SOC_SERIES_ESP32=y

# Enable console
CONFIG_CONSOLE=y
CONFIG_UART_CONSOLE=y

# Enable GPIO
CONFIG_GPIO=y

# Enable clock control
CONFIG_CLOCK_CONTROL=y

# Enable USB device
CONFIG_USB_DEVICE_STACK=y

# Enable flash
CONFIG_FLASH=y

# Enable WiFi
CONFIG_WIFI=y
CONFIG_NET_L2_WIFI_MGMT=y
CONFIG_NETWORKING=y

# Enable minimal libc
CONFIG_MINIMAL_LIBC=y

# Clock configuration
CONFIG_SYS_CLOCK_HW_CYCLES_PER_SEC=240000000

# Enable FPU
CONFIG_FPU=y

# Display configuration
CONFIG_DISPLAY=y
CONFIG_DISPLAY_LOG_LEVEL_DBG=y
CONFIG_ILI9341=y

# SPI configuration
CONFIG_SPI=y
CONFIG_SPI_ESP32=y
CONFIG_SPI_2=y

# Font support
CONFIG_FONT_TERMINUS_16=y
CONFIG_FONT_TERMINUS_BOLD_16=y

# LVGL (optional if you want a GUI library)
CONFIG_LVGL=y
CONFIG_LV_USE_LOG=y
CONFIG_LV_USE_LABEL=y
CONFIG_LV_USE_BTN=y


CONFIG_FLASH_MAP=y
CONFIG_FLASH_PAGE_LAYOUT=y
CONFIG_FILE_SYSTEM=y
CONFIG_FILE_SYSTEM_LITTLEFS=y


CONFIG_ESP32_WIFI_SSID="your_wifi"
CONFIG_ESP32_WIFI_PASSWORD="your_password"
CONFIG_NETWORKING=y
CONFIG_NET_IPV4=y
CONFIG_NET_DHCPV4=y
```

## boards/esp32_devkitc_wroom_procpu.conf
```kconfig
# SPDX-License-Identifier: Apache-2.0

# To ensure that specific nodes are enabled
CONFIG_GPIO_ESP32=y
# Enable GPIO
CONFIG_GPIO=y
# Enable clock control
CONFIG_CLOCK_CONTROL=y
# Enable USB device
CONFIG_USB_DEVICE_STACK=y
# Enable flash
CONFIG_FLASH=y
# Enable WiFi
CONFIG_WIFI=y
CONFIG_NET_L2_WIFI_MGMT=y
# Enable minimal libc
CONFIG_MINIMAL_LIBC=y
# Clock configuration
CONFIG_SYS_CLOCK_HW_CYCLES_PER_SEC=240000000
# Enable FPU
CONFIG_FPU=y
# Display configuration
CONFIG_DISPLAY=y
CONFIG_DISPLAY_INIT_PRIORITY=90

# For ili9xxx displays like ILI9340/ILI9341
# CONFIG_ILI9XXX=y
# CONFIG_ILI9XXX_MIPI_DBI=y

# CONFIG_FRAMEBUFFER=y
# CONFIG_DISPLAY_FRAME_BUFFER_RGB888=y

# LVGL (optional if you want a GUI library)
CONFIG_LVGL=n
CONFIG_LV_Z_BITS_PER_PIXEL=24
CONFIG_LV_USE_LOG=n
CONFIG_LV_USE_LABEL=n
CONFIG_LV_USE_BTN=n

# File system
CONFIG_FLASH_MAP=y
CONFIG_FLASH_PAGE_LAYOUT=y
CONFIG_FILE_SYSTEM=y
CONFIG_FILE_SYSTEM_LITTLEFS=y

# Debug info
CONFIG_DEBUG=y
CONFIG_DEBUG_INFO=y
CONFIG_DEBUG_THREAD_INFO=y
CONFIG_DISPLAY_LOG_LEVEL_DBG=y
CONFIG_GPIO_LOG_LEVEL_DBG=y
CONFIG_SPI_LOG_LEVEL_DBG=y
CONFIG_LOG=y
CONFIG_LOG_DEFAULT_LEVEL=4


# Disable unused networking to save memory
CONFIG_NETWORKING=n
CONFIG_NET_SOCKETS=n
CONFIG_MBEDTLS=n
```

## boards/esp32c3_devkitm.conf
```kconfig
# ESP32-C3 DevKitM Specific Configuration
# RISC-V single-core @ 160MHz with WiFi + BLE 5.0

# Memory configuration (ESP32-C3 has limited SRAM ~400KB)
# Reduced heap to fit in memory
CONFIG_HEAP_MEM_POOL_SIZE=32768
CONFIG_MAIN_STACK_SIZE=3072
CONFIG_SYSTEM_WORKQUEUE_STACK_SIZE=1536

# ESP32-C3 WiFi
CONFIG_WIFI=y
CONFIG_ESP32_WIFI_STA_AUTO_DHCPV4=y

# Bluetooth (ESP32-C3 supports BLE 5.0) - DISABLED to save RAM
# Enable one of WiFi or BT, not both, due to RAM constraints
CONFIG_BT=n
# CONFIG_BT_PERIPHERAL=y
# CONFIG_BT_DEVICE_NAME="AkiraOS-C3"

# SPI for display
CONFIG_SPI=y

# I2C for sensors
CONFIG_I2C=y
CONFIG_SENSOR=y

# GPIO
CONFIG_GPIO=y

# ADC - disabled to save space
CONFIG_ADC=n

# Flash/Storage
CONFIG_FLASH=y
CONFIG_FLASH_MAP=y

# Watchdog
CONFIG_WATCHDOG=y

# PWM - disabled to save space
CONFIG_PWM=n

# Console
CONFIG_CONSOLE=y
CONFIG_UART_CONSOLE=y

# Reduce logging to save RAM
CONFIG_LOG_BUFFER_SIZE=256
CONFIG_LOG_DEFAULT_LEVEL=1
CONFIG_LOG_MAX_LEVEL=2

# Disable features to save RAM
CONFIG_SHELL_HISTORY=n
CONFIG_SHELL_TAB=n
CONFIG_SHELL_TAB_AUTOCOMPLETION=n
CONFIG_SHELL_WILDCARD=n
CONFIG_SHELL_HELP=y
CONFIG_SHELL_HELP_ON_WRONG_ARGUMENT_COUNT=n

# Reduce network buffer sizes
CONFIG_NET_BUF_DATA_SIZE=128
CONFIG_NET_PKT_RX_COUNT=8
CONFIG_NET_PKT_TX_COUNT=8
CONFIG_NET_BUF_RX_COUNT=8
CONFIG_NET_BUF_TX_COUNT=8

###############################################################################
# App Manager - Enabled with minimal WAMR for RAM-constrained ESP32-C3
###############################################################################
CONFIG_AKIRA_APP_MANAGER=y

# WAMR optimizations for reduced memory footprint
CONFIG_AKIRA_WAMR_MINI_LOADER=y
CONFIG_AKIRA_WAMR_MINIMAL=y

# Reduced memory settings for WASM runtime
CONFIG_OCRE_WAMR_HEAP_BUFFER_SIZE=8192
CONFIG_OCRE_CONTAINER_DEFAULT_STACK_SIZE=2048
CONFIG_OCRE_CONTAINER_DEFAULT_HEAP_SIZE=8192
CONFIG_MAX_CONTAINERS=2
```

## boards/esp32c3_supermini.conf
```kconfig
###############################################################################
# ESP32-C3 SuperMini Board Configuration
# RISC-V single-core @ 160MHz, 4MB Flash, ~400KB SRAM, WiFi + BLE 5.0
###############################################################################

###############################################################################
# Memory Configuration - VERY LIMITED SRAM (~400KB total)
###############################################################################
# Minimal DRAM heap - most allocations via stack or fixed buffers
CONFIG_HEAP_MEM_POOL_SIZE=8192
CONFIG_MAIN_STACK_SIZE=2560
CONFIG_SYSTEM_WORKQUEUE_STACK_SIZE=768
CONFIG_SHELL_STACK_SIZE=2048
CONFIG_ISR_STACK_SIZE=1536
CONFIG_IDLE_STACK_SIZE=256

###############################################################################
# WiFi - Auto-enabled via AKIRA_WIFI (defined in prj.conf)
###############################################################################
CONFIG_WIFI_ESP32=y
CONFIG_ESP32_WIFI_STA_AUTO_DHCPV4=y
# Disable AMPDU to reduce memory on this RAM-constrained board
CONFIG_ESP32_WIFI_AMPDU_TX_ENABLED=n
CONFIG_ESP32_WIFI_AMPDU_RX_ENABLED=n

###############################################################################
# Bluetooth (BLE 5.0) - Tuned for minimal RAM usage
###############################################################################
# Reduced BT buffer sizes to save SRAM
CONFIG_BT_BUF_ACL_RX_SIZE=128
CONFIG_BT_BUF_ACL_TX_SIZE=128
CONFIG_BT_L2CAP_TX_MTU=128
CONFIG_BT_RX_STACK_SIZE=1280
CONFIG_BT_HCI_TX_STACK_SIZE=640
CONFIG_BT_ATT_PREPARE_COUNT=1
CONFIG_BT_KEYS_OVERWRITE_OLDEST=y

###############################################################################
# Network Buffer Configuration - minimal for ESP32-C3
###############################################################################
CONFIG_NET_BUF_DATA_SIZE=128
CONFIG_NET_PKT_RX_COUNT=4
CONFIG_NET_PKT_TX_COUNT=4
CONFIG_NET_BUF_RX_COUNT=8
CONFIG_NET_BUF_TX_COUNT=8

###############################################################################
# SPI & I2C for peripherals
###############################################################################
CONFIG_SPI=y
CONFIG_I2C=y
CONFIG_SENSOR=y

###############################################################################
# OCRE Memory - ESP32-C3 not recommended for WAMR due to RAM constraints
###############################################################################
CONFIG_MAX_CONTAINERS=1
CONFIG_OCRE_CONTAINER_DEFAULT_STACK_SIZE=2048
CONFIG_OCRE_CONTAINER_DEFAULT_HEAP_SIZE=2048

###############################################################################
# ESP32-C3 Flash Configuration
###############################################################################
CONFIG_ESPTOOLPY_FLASHSIZE_4MB=y
CONFIG_ESPTOOLPY_FLASHMODE_DIO=y
CONFIG_ESPTOOLPY_FLASHFREQ_40M=y

###############################################################################
# Logging - Minimal for RAM-constrained device
###############################################################################
CONFIG_LOG_MODE_IMMEDIATE=y
CONFIG_LOG_DEFAULT_LEVEL=1

###############################################################################
# Settings Backend (NVS for ESP32)
###############################################################################
CONFIG_SETTINGS_NVS=y

###############################################################################
# Note: This board has limited SRAM. Recommended configuration:
# - Disable unused features in prj.conf with CONFIG_AKIRA_*=n
# - Use native_sim for testing complex features
# - Consider ESP32-S3 for WiFi + WAMR + Bluetooth + Storage
###############################################################################

CONFIG_AKIRA_WAMR_MINI_LOADER=y
CONFIG_AKIRA_WAMR_MINIMAL=y

# Reduced memory settings for WASM runtime
CONFIG_OCRE_WAMR_HEAP_BUFFER_SIZE=8192
CONFIG_OCRE_CONTAINER_DEFAULT_STACK_SIZE=2048
CONFIG_OCRE_CONTAINER_DEFAULT_HEAP_SIZE=8192
CONFIG_MAX_CONTAINERS=2
# Enable placing WAMR heap buffer in PSRAM when PSRAM is present.
# If this board has SPIRAM attached, uncomment the next line to place the
# OCRE WAMR heap buffer in external RAM.
# CONFIG_OCRE_WAMR_HEAP_BUFFER_IN_PSRAM=y
CONFIG_MULTI_HEAP=y
CONFIG_SHARED_MULTI_HEAP=y
```

## boards/esp32c6_devkitc_esp32c6_hpcore.conf
```kconfig
# BOARD_ZEPHYR: esp32c6_devkitc/esp32c6/hpcore
# BOARD_CHIP: esp32c6
# BOARD_DESC: ESP32-C6 DevKitC (RISC-V HP Core)
# ESP32-C6: RISC-V @ 160MHz, 512KB SRAM, 8MB Flash (WROOM-N8 module)
# Radios: WiFi 6 (802.11ax), BLE 5.3, IEEE 802.15.4 (Thread/Zigbee)

###############################################################################
# Memory Configuration — 512KB SRAM (better than C3's 400KB)
###############################################################################
CONFIG_HEAP_MEM_POOL_SIZE=65536
CONFIG_MAIN_STACK_SIZE=4096
CONFIG_SYSTEM_WORKQUEUE_STACK_SIZE=2048
CONFIG_SHELL_STACK_SIZE=4096
CONFIG_WAMR_HEAP_SIZE=131072

###############################################################################
# Thread Local Storage — MANDATORY for WAMR on RISC-V
# Without this, Zephyr does not manage the RISC-V thread pointer (tp) register,
# leaving garbage values that cause WAMR to crash on TLS variable access.
###############################################################################
CONFIG_THREAD_LOCAL_STORAGE=y

###############################################################################
# WiFi 6 (802.11ax)
###############################################################################
CONFIG_WIFI=y
CONFIG_WIFI_ESP32=y
CONFIG_NET_L2_WIFI_MGMT=y
CONFIG_ESP32_WIFI_STA_AUTO_DHCPV4=y
CONFIG_NET_SOCKETS_OFFLOAD=y
CONFIG_SHELL_BACKEND_TELNET=y
CONFIG_SHELL_TELNET_SUPPORT_COMMAND=y

# Disable AMPDU to reduce memory usage
CONFIG_ESP32_WIFI_AMPDU_TX_ENABLED=n
CONFIG_ESP32_WIFI_AMPDU_RX_ENABLED=n

###############################################################################
# Bluetooth BLE 5.3
# C6 has enough SRAM to run WiFi + BLE simultaneously (unlike C3)
###############################################################################
CONFIG_BT=y
CONFIG_BT_PERIPHERAL=y
CONFIG_BT_DEVICE_NAME="AkiraOS-C6"

###############################################################################
# IEEE 802.15.4 — Thread / Zigbee radio
###############################################################################
CONFIG_NET_L2_IEEE802154=y
CONFIG_IEEE802154=y

###############################################################################
# Peripherals
###############################################################################
CONFIG_SPI=y
CONFIG_I2C=y
CONFIG_SENSOR=y
CONFIG_ADC=y
CONFIG_WATCHDOG=y
CONFIG_PWM=y

###############################################################################
# Flash and Storage — XIP from Flash
# Code and WASM binaries execute directly from flash via hardware cache.
# LittleFS partition on flash is the primary WASM app store.
###############################################################################
CONFIG_FLASH=y
CONFIG_FLASH_MAP=y
CONFIG_FLASH_PAGE_LAYOUT=y
CONFIG_NVS=y
CONFIG_SETTINGS=y
CONFIG_SETTINGS_NVS=y
CONFIG_STREAM_FLASH=y
CONFIG_BOOTLOADER_MCUBOOT=y
CONFIG_MCUBOOT_IMG_MANAGER=y
CONFIG_IMG_MANAGER=y
CONFIG_IMG_ENABLE_IMAGE_CHECK=y
CONFIG_IMG_ERASE_PROGRESSIVELY=y

###############################################################################
# LittleFS — WASM app storage on internal flash (XIP-from-Flash path)
###############################################################################
CONFIG_FILE_SYSTEM=y
CONFIG_FILE_SYSTEM_LITTLEFS=y
CONFIG_FS_LITTLEFS_FC_HEAP_SIZE=512

###############################################################################
# SD Card — hardware-agnostic via DT zephyr,sdhc-spi-slot binding
# CS GPIO is defined in the overlay (cs-gpios), not in source code.
# Disable CONFIG_AKIRA_SD_CARD here if no SD hardware is connected.
###############################################################################
CONFIG_SDHC=y
CONFIG_DISK_ACCESS=y
CONFIG_FAT_FILESYSTEM_ELM=y
CONFIG_FS_FATFS_LFN=y
CONFIG_FS_FATFS_MAX_LFN=255
CONFIG_FS_FATFS_CUSTOM_MOUNT_POINT_COUNT=1
CONFIG_FS_FATFS_CUSTOM_MOUNT_POINTS="SD"
CONFIG_AKIRA_SD_CARD=y
CONFIG_AKIRA_APP_SOURCE_SD=y

###############################################################################
# Network buffers
###############################################################################
CONFIG_NET_PKT_RX_COUNT=10
CONFIG_NET_PKT_TX_COUNT=10
CONFIG_NET_BUF_RX_COUNT=16
CONFIG_NET_BUF_TX_COUNT=16

###############################################################################
# WAMR — AOT DISABLED on RISC-V
# C6 has no PSRAM; AOT code would need to live in limited SRAM.
# Interpreter mode on RISCV32 is well-supported and sufficient.
###############################################################################
CONFIG_WAMR_AOT_SUPPORT=n

###############################################################################
# App Manager
###############################################################################
CONFIG_AKIRA_APP_MANAGER=y
CONFIG_MAX_CONTAINERS=4
CONFIG_AKIRA_WASM_APP_STACK_SIZE=4096

###############################################################################
# Logging
###############################################################################
CONFIG_LOG_BUFFER_SIZE=512
CONFIG_LOG_DEFAULT_LEVEL=3
CONFIG_LOG_MAX_LEVEL=4
```
