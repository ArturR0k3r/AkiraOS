## CMakeLists.txt
```
# SPDX-License-Identifier: Apache-2.0
#
# Minimal product firmware built on AkiraOS as a Zephyr module.
#
# This directory stands in for a product repository: it references no AkiraOS
# source file by path. AkiraOS comes from the akira-os module
# (CONFIG_AKIRA_OS=y in prj.conf), its boards from the module's board_root and
# the per-board AkiraOS setup from the akira-board snippet.

cmake_minimum_required(VERSION 3.20.0)

# AkiraOS services (akira-profile-minimal) and per-board setup (akira-board),
# both from the akira-os module. Listed profile-first so a board conf can
# override a profile default; snippets passed with `west build -S` come after.
set(AKIRA_SNIPPETS akira-profile-minimal akira-board)

find_package(Zephyr REQUIRED HINTS $ENV{ZEPHYR_BASE})
project(akira_out_of_tree_product)

target_sources(app PRIVATE src/main.c)
target_link_libraries(app PRIVATE akira_os)
```

## sample.yaml
```
sample:
  name: AkiraOS out-of-tree product
  description: Product firmware that consumes AkiraOS as a Zephyr module
tests:
  akiraos.sample.out_of_tree_product:
    build_only: true
    platform_allow:
      - native_sim
    integration_platforms:
      - native_sim
    tags: akiraos module
```

## prj.conf
```kconfig
# SPDX-License-Identifier: Apache-2.0
#
# Product configuration. AkiraOS services come from the akira-profile-minimal
# snippet (see CMakeLists.txt); this file only enables AkiraOS and any
# product-specific options. Board hardware comes from the akira-board snippet.
CONFIG_AKIRA_OS=y
```

## boards/native_sim.conf
```kconfig
# BOARD_ZEPHYR: native_sim
# BOARD_CHIP: native
# BOARD_DESC: Native Simulator (default)

# EXTERNAL_LIBC uses host glibc (removes -ffreestanding/-nostdinc),
# needed for C++ STL headers in TFLite Micro (TFLM uses <algorithm> etc.).
# WAMR works fine on host glibc.
CONFIG_EXTERNAL_LIBC=y
CONFIG_EXTERNAL_LIBCPP=y
CONFIG_NEWLIB_LIBC=n
CONFIG_PICOLIBC=n
# CONFIG_UART_NATIVE_POSIX_PORT_1_ENABLE is deprecated, using default UART config
CONFIG_NATIVE_UART_0_ON_STDINOUT=y
CONFIG_UART_NATIVE_POSIX=y
CONFIG_FLASH_SIMULATOR=y
CONFIG_ENTROPY_GENERATOR=y
CONFIG_TEST_RANDOM_GENERATOR=y

CONFIG_NATIVE_SIM_SLOWDOWN_TO_REAL_TIME=y

# Enable POSIX API for native_sim (required for simulator driver with pthreads)
CONFIG_POSIX_TIMERS=y

# Network configuration for native_sim
CONFIG_ETH_NATIVE_POSIX=y
CONFIG_NET_L2_ETHERNET=y
CONFIG_NET_DRIVERS=y

# Network configuration
CONFIG_NET_CONFIG_SETTINGS=y
CONFIG_NET_CONFIG_MY_IPV4_ADDR="192.168.1.10"
CONFIG_NET_CONFIG_MY_IPV4_GW="192.168.1.1"
CONFIG_NET_CONFIG_MY_IPV4_NETMASK="255.255.255.0"
CONFIG_NET_DHCPV4=n

# Network shell support
CONFIG_NET_SHELL=y

CONFIG_SENSOR=y

# Disable hardware not available on native_sim
CONFIG_SPI=n
CONFIG_GPIO=n
CONFIG_WIFI=n
CONFIG_DISPLAY=n
CONFIG_MIPI_DBI=n
CONFIG_INPUT=n
CONFIG_INPUT_GPIO_KEYS=n
CONFIG_PINCTRL=n
CONFIG_I2C=n
CONFIG_SHELL_BACKEND_TELNET=n
CONFIG_NET_SOCKETS_OFFLOAD=n


# Disable MCUboot for native_sim (not applicable)
CONFIG_BOOTLOADER_MCUBOOT=n
CONFIG_MCUBOOT_IMG_MANAGER=n
CONFIG_IMG_MANAGER=n
CONFIG_IMG_ENABLE_IMAGE_CHECK=n
CONFIG_IMG_ERASE_PROGRESSIVELY=n

# Disable USB HID for native_sim (no USB hardware)
CONFIG_AKIRA_USB_HID=n
CONFIG_AKIRA_USB=n
CONFIG_USB_DEVICE_STACK=n

# Disable BT-dependent WASM APIs for native_sim (no BT stack)
CONFIG_AKIRA_WASM_BLE=n
CONFIG_AKIRA_WASM_HID=n

# IPC and Lifecycle are BT-independent — safe to enable on native_sim
CONFIG_AKIRA_WASM_LIFECYCLE=y
CONFIG_AKIRA_WASM_IPC=y

# Disable OTA for native_sim (requires MCUboot and flash partitions)
CONFIG_AKIRA_OTA=n
CONFIG_AKIRA_OTA_HTTP=n

# Disable HTTP server for native_sim (depends on OTA)
CONFIG_AKIRA_HTTP_SERVER=n

# Flash is needed for native_sim
CONFIG_FLASH_SIMULATOR=y
CONFIG_FLASH_MAP=y
CONFIG_FLASH_PAGE_LAYOUT=y
CONFIG_STREAM_FLASH=n

# AkiraClaw edge AI inference
CONFIG_AKIRA_AIINFER=n
CONFIG_AKIRA_WASM_AIINFER=n
CONFIG_AKIRA_TFLITE_MICRO=n
CONFIG_AKIRA_AIINFER_ARENA_KB=64
CONFIG_AKIRA_AIINFER_MAX_HANDLES=2
```

## src/main.c
```c
/*
 * SPDX-License-Identifier: Apache-2.0
 *
 * Product firmware entry point: run product-specific setup, then hand over to
 * the standard AkiraOS boot sequence.
 */

#include <zephyr/logging/log.h>
#include <akira.h>

LOG_MODULE_REGISTER(product_main, LOG_LEVEL_INF);

int main(void)
{
    LOG_INF("Product firmware starting on AkiraOS %s", AKIRA_VERSION_STRING);

    /* Product-specific initialisation (sensors, board bring-up) goes here. */

    return akira_start();
}
```
